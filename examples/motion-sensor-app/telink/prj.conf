## CMakeLists.txt
```
#
#    Copyright (c) 2025 Project CHIP Authors
#
#    Licensed under the Apache License, Version 2.0 (the "License");
#    you may not use this file except in compliance with the License.
#    You may obtain a copy of the License at
#
#        http://www.apache.org/licenses/LICENSE-2.0
#
#    Unless required by applicable law or agreed to in writing, software
#    distributed under the License is distributed on an "AS IS" BASIS,
#    WITHOUT WARRANTIES OR CONDITIONS OF ANY KIND, either express or implied.
#    See the License for the specific language governing permissions and
#    limitations under the License.
#

cmake_minimum_required(VERSION 3.13.1)

get_filename_component(CHIP_ROOT ${CMAKE_CURRENT_SOURCE_DIR}/third_party/connectedhomeip REALPATH)
get_filename_component(TELINK_COMMON ${CHIP_ROOT}/examples/platform/telink REALPATH)
get_filename_component(GEN_DIR ${CHIP_ROOT}/zzz_generated/ REALPATH)

include(${TELINK_COMMON}/common.cmake)
include(${CHIP_ROOT}/config/telink/app/enable-gnu-std.cmake)
include(${CHIP_ROOT}/src/app/chip_data_model.cmake)

project(chip-telink-motion-sensor-example)

target_include_directories(app PRIVATE
                           include
                           ${GEN_DIR}/app-common
                           ${GEN_DIR}/motion-sensor-app
                           ${TELINK_COMMON}/common/include
                           ${TELINK_COMMON}/util/include
                           ${TELINK_COMMON}/zephyr_ext)

target_sources(app PRIVATE
               src/AppTask.cpp
               src/MotionSensorManager.cpp
               src/ZclCallbacks.cpp
               ${TELINK_COMMON}/common/src/mainCommon.cpp
               ${TELINK_COMMON}/common/src/AppTaskCommon.cpp
               ${TELINK_COMMON}/util/src/LEDManager.cpp
               ${TELINK_COMMON}/util/src/ButtonManager.cpp
               ${TELINK_COMMON}/util/src/ThreadUtil.cpp
               ${TELINK_COMMON}/util/src/PWMManager.cpp
               ${TELINK_COMMON}/zephyr_ext/zephyr_key_matrix.c
               ${TELINK_COMMON}/zephyr_ext/zephyr_key_pool.c
               ${TELINK_COMMON}/zephyr_ext/zephyr_led_pool.c
               ${TELINK_COMMON}/zephyr_ext/zephyr_pwm_pool.c
               ${TELINK_COMMON}/zephyr_ext/zephyr_ws2812.c)

chip_configure_data_model(app
    ZAP_FILE ${CMAKE_CURRENT_SOURCE_DIR}/../motion-sensor-common/motion-sensor-app.zap
)

if(CONFIG_BOOTLOADER_MCUBOOT)
  target_sources(app PRIVATE ${TELINK_COMMON}/util/src/OTAUtil.cpp)
endif()
```

## Kconfig
```
#
#    Copyright (c) 2025 Project CHIP Authors
#
#    Licensed under the Apache License, Version 2.0 (the "License");
#    you may not use this file except in compliance with the License.
#    You may obtain a copy of the License at
#
#        http://www.apache.org/licenses/LICENSE-2.0
#
#    Unless required by applicable law or agreed to in writing, software
#    distributed under the License is distributed on an "AS IS" BASIS,
#    WITHOUT WARRANTIES OR CONDITIONS OF ANY KIND, either express or implied.
#    See the License for the specific language governing permissions and
#    limitations under the License.
#
mainmenu "Matter Telink Motion Sensor Example Application"

rsource "../../../config/telink/chip-module/Kconfig.defaults"
source "Kconfig.zephyr"
```

## prj.conf
```kconfig
#
#    Copyright (c) 2025 Project CHIP Authors
#
#    Licensed under the Apache License, Version 2.0 (the "License");
#    you may not use this file except in compliance with the License.
#    You may obtain a copy of the License at
#
#        http://www.apache.org/licenses/LICENSE-2.0
#
#    Unless required by applicable law or agreed to in writing, software
#    distributed under the License is distributed on an "AS IS" BASIS,
#    WITHOUT WARRANTIES OR CONDITIONS OF ANY KIND, either express or implied.
#    See the License for the specific language governing permissions and
#    limitations under the License.
#

# This sample uses Kconfig.defaults to set options common for all
# samples. This file should contain only options specific for this sample
# or overrides of default values.

# Enable CHIP
CONFIG_CHIP=y
CONFIG_STD_CPP17=y

# 32775 == 0x8007 (example motion-sensor-app)
CONFIG_CHIP_DEVICE_PRODUCT_ID=32775

# Bluetooth Low Energy configuration
CONFIG_BT_DEVICE_NAME="TelinkSensor"

# Disable Matter OTA DFU
CONFIG_CHIP_OTA_REQUESTOR=n
CONFIG_CHIP_DEVICE_SOFTWARE_VERSION=1

# Disable CHIP shell support
CONFIG_CHIP_LIB_SHELL=n

# Disable factory data support
CONFIG_CHIP_FACTORY_DATA=n
CONFIG_CHIP_FACTORY_DATA_BUILD=n
CONFIG_CHIP_FACTORY_DATA_MERGE_WITH_FIRMWARE=n

# Enable Power Management
CONFIG_PM=y
```

## include/AppConfig.h
```c
/*
 *
 *    Copyright (c) 2025 Project CHIP Authors
 *    All rights reserved.
 *
 *    Licensed under the Apache License, Version 2.0 (the "License");
 *    you may not use this file except in compliance with the License.
 *    You may obtain a copy of the License at
 *
 *        http://www.apache.org/licenses/LICENSE-2.0
 *
 *    Unless required by applicable law or agreed to in writing, software
 *    distributed under the License is distributed on an "AS IS" BASIS,
 *    WITHOUT WARRANTIES OR CONDITIONS OF ANY KIND, either express or implied.
 *    See the License for the specific language governing permissions and
 *    limitations under the License.
 */

#pragma once

// ---- Motion sensor example config ----
#define APP_SET_DEVICE_INFO_PROVIDER 1
#define APP_SET_NETWORK_COMM_ENDPOINT_SEC 0
```

## include/AppTask.h
```c
/*
 *
 *    Copyright (c) 2025 Project CHIP Authors
 *    All rights reserved.
 *
 *    Licensed under the Apache License, Version 2.0 (the "License");
 *    you may not use this file except in compliance with the License.
 *    You may obtain a copy of the License at
 *
 *        http://www.apache.org/licenses/LICENSE-2.0
 *
 *    Unless required by applicable law or agreed to in writing, software
 *    distributed under the License is distributed on an "AS IS" BASIS,
 *    WITHOUT WARRANTIES OR CONDITIONS OF ANY KIND, either express or implied.
 *    See the License for the specific language governing permissions and
 *    limitations under the License.
 */

#pragma once

#include "AppTaskCommon.h"
#include "MotionSensorManager.h"

class AppTask : public AppTaskCommon
{
public:
    void PostMotionActionRequest(MotionSensorManager::Action aAction);

    void UpdateClusterState();
    void UpdateDeviceState();

    bool IsSyncClusterToButtonAction();
    void SetSyncClusterToButtonAction(bool value);

    void SetIlluminance(uint16_t lux);

private:
    friend AppTask & GetAppTask();
    friend class AppTaskCommon;

    CHIP_ERROR Init();
    void LinkLeds(LedManager & ledManager);

    static void OnMotionStateChanged(MotionSensorManager::State aState);

    static void UpdateClusterStateInternal(intptr_t arg);
    static void UpdateDeviceStateInternal(intptr_t arg);

    static void MotionActionEventHandler(AppEvent * aEvent);

    bool mSyncClusterToButtonAction = false;
    uint16_t mLux                   = 100; // initial brightness

    static AppTask sAppTask;
};

inline AppTask & GetAppTask()
{
    return AppTask::sAppTask;
}

inline bool AppTask::IsSyncClusterToButtonAction()
{
    return mSyncClusterToButtonAction;
}

inline void AppTask::SetSyncClusterToButtonAction(bool value)
{
    mSyncClusterToButtonAction = value;
}
```

## include/CHIPProjectConfig.h
```c
/*
 *
 *    Copyright (c) 2025 Project CHIP Authors
 *    All rights reserved.
 *
 *    Licensed under the Apache License, Version 2.0 (the "License");
 *    you may not use this file except in compliance with the License.
 *    You may obtain a copy of the License at
 *
 *        http://www.apache.org/licenses/LICENSE-2.0
 *
 *    Unless required by applicable law or agreed to in writing, software
 *    distributed under the License is distributed on an "AS IS" BASIS,
 *    WITHOUT WARRANTIES OR CONDITIONS OF ANY KIND, either express or implied.
 *    See the License for the specific language governing permissions and
 *    limitations under the License.
 */

/**
 *    @file
 *          Example project configuration file for CHIP.
 *
 *          This is a place to put application or project-specific overrides
 *          to the default configuration values for general CHIP features.
 *
 */

#pragma once

// Use a default pairing code if one hasn't been provisioned in flash.
#define CHIP_DEVICE_CONFIG_USE_TEST_SETUP_PIN_CODE 20202021
#define CHIP_DEVICE_CONFIG_USE_TEST_SETUP_DISCRIMINATOR 0xF00
```

## include/MotionSensorManager.h
```c
/*
 *
 *    Copyright (c) 2025 Project CHIP Authors
 *    All rights reserved.
 *
 *    Licensed under the Apache License, Version 2.0 (the "License");
 *    you may not use this file except in compliance with the License.
 *    You may obtain a copy of the License at
 *
 *        http://www.apache.org/licenses/LICENSE-2.0
 *
 *    Unless required by applicable law or agreed to in writing, software
 *    distributed under the License is distributed on an "AS IS" BASIS,
 *    WITHOUT WARRANTIES OR CONDITIONS OF ANY KIND, either express or implied.
 *    See the License for the specific language governing permissions and
 *    limitations under the License.
 */

#pragma once

#include "AppEventCommon.h"
#include <stdbool.h>
#include <stdint.h>

class MotionSensorManager
{
public:
    enum class State : uint8_t
    {
        kMotionUndetected = 0,
        kMotionDetected
    };

    enum class Action : uint8_t
    {
        kSetUndetected = 0,
        kSetDetected
    };

    int Init();
    bool IsMotionDetected() const;

    void InitiateAction(Action aAction);

    using CallbackStateChanged = void (*)(State aState);
    void SetCallback(CallbackStateChanged cb);

    static void HandleAction(AppEvent * aEvent);
    static MotionSensorManager sMotionSensor;

private:
    State mState                   = State::kMotionUndetected;
    CallbackStateChanged mCallback = nullptr;
};

inline MotionSensorManager & MotionSensorMgr()
{
    return MotionSensorManager::sMotionSensor;
}
```

## src/AppTask.cpp
```c
/*
 *
 *    Copyright (c) 2025 Project CHIP Authors
 *    All rights reserved.
 *
 *    Licensed under the Apache License, Version 2.0 (the "License");
 *    you may not use this file except in compliance with the License.
 *    You may obtain a copy of the License at
 *
 *        http://www.apache.org/licenses/LICENSE-2.0
 *
 *    Unless required by applicable law or agreed to in writing, software
 *    distributed under the License is distributed on an "AS IS" BASIS,
 *    WITHOUT WARRANTIES OR CONDITIONS OF ANY KIND, either express or implied.
 *    See the License for the specific language governing permissions and
 *    limitations under the License.
 */

#include "AppTask.h"
#include "LEDManager.h"

#include <app-common/zap-generated/attributes/Accessors.h>
#include <zephyr/kernel.h>
#include <zephyr/logging/log.h>

LOG_MODULE_DECLARE(app, CONFIG_CHIP_APP_LOG_LEVEL);

AppTask AppTask::sAppTask;

// sequence of lux values for button toggling
static const uint16_t kLuxSteps[] = { 100, 300, 600, 1000, 1500, 2000 };
static constexpr size_t kLuxCount = sizeof(kLuxSteps) / sizeof(uint16_t);

CHIP_ERROR AppTask::Init()
{
    SetExampleButtonCallbacks(MotionActionEventHandler);
    InitCommonParts();

    LedManager::getInstance().setLed(LedManager::EAppLed_App0, MotionSensorMgr().IsMotionDetected());

    MotionSensorMgr().SetCallback(OnMotionStateChanged);

    UpdateDeviceState();
    return CHIP_NO_ERROR;
}

void AppTask::OnMotionStateChanged(MotionSensorManager::State aState)
{
    bool detected = (aState == MotionSensorManager::State::kMotionDetected);

    LedManager::getInstance().setLed(LedManager::EAppLed_App0, detected);

    if (sAppTask.IsSyncClusterToButtonAction())
        sAppTask.UpdateClusterState();
}

void AppTask::PostMotionActionRequest(MotionSensorManager::Action aAction)
{
    AppEvent event;
    event.Type               = AppEvent::kEventType_DeviceAction;
    event.DeviceEvent.Action = static_cast<uint8_t>(aAction);
    event.Handler            = MotionActionEventHandler;

    sAppTask.PostEvent(&event);
}

void AppTask::MotionActionEventHandler(AppEvent * aEvent)
{
    MotionSensorManager::Action action;

    if (aEvent->Type == AppEvent::kEventType_Button)
    {
        // toggle occupancy
        if (MotionSensorMgr().IsMotionDetected())
            action = MotionSensorManager::Action::kSetUndetected;
        else
            action = MotionSensorManager::Action::kSetDetected;

        // toggle lux
        static size_t idx = 0;
        idx               = (idx + 1) % kLuxCount;
        sAppTask.mLux     = kLuxSteps[idx];

        sAppTask.SetSyncClusterToButtonAction(true);
    }
    else
    {
        action = static_cast<MotionSensorManager::Action>(aEvent->DeviceEvent.Action);
    }

    MotionSensorMgr().InitiateAction(action);
    sAppTask.SetIlluminance(sAppTask.mLux);
}

void AppTask::SetIlluminance(uint16_t lux)
{
    chip::app::Clusters::IlluminanceMeasurement::Attributes::MeasuredValue::Set(2, lux);
    ChipLogProgress(NotSpecified, "Illuminance SET: %u", lux);
}

void AppTask::UpdateClusterStateInternal(intptr_t)
{
    using Bitmap = chip::app::Clusters::OccupancySensing::OccupancyBitmap;

    chip::BitMask<Bitmap> mask;
    if (MotionSensorMgr().IsMotionDetected())
        mask.Set(Bitmap::kOccupied);
    else
        mask.ClearAll();

    chip::app::Clusters::OccupancySensing::Attributes::Occupancy::Set(1, mask);

    chip::app::Clusters::IlluminanceMeasurement::Attributes::MeasuredValue::Set(2, sAppTask.mLux);
}

void AppTask::UpdateClusterState()
{
    PlatformMgr().ScheduleWork(UpdateClusterStateInternal, 0);
}

void AppTask::UpdateDeviceStateInternal(intptr_t)
{
    chip::BitMask<chip::app::Clusters::OccupancySensing::OccupancyBitmap> mask;
    chip::app::Clusters::OccupancySensing::Attributes::Occupancy::Get(1, &mask);

    bool occupied = mask.Raw() & 0x01;
    LedManager::getInstance().setLed(LedManager::EAppLed_App0, occupied);

    chip::app::DataModel::Nullable<uint16_t> lux;
    chip::app::Clusters::IlluminanceMeasurement::Attributes::MeasuredValue::Get(2, lux);

    if (!lux.IsNull())
        ChipLogProgress(NotSpecified, "Lux: %u", lux.Value());
}

void AppTask::UpdateDeviceState()
{
    PlatformMgr().ScheduleWork(UpdateDeviceStateInternal, 0);
}

void AppTask::LinkLeds(LedManager & ledManager)
{
#if CONFIG_CHIP_ENABLE_APPLICATION_STATUS_LED
    ledManager.linkLed(LedManager::EAppLed_Status, 0);
    ledManager.linkLed(LedManager::EAppLed_App0, 1);
#else
    ledManager.linkLed(LedManager::EAppLed_App0, 0);
#endif
}
```

## src/MotionSensorManager.cpp
```c
/*
 *
 *    Copyright (c) 2025 Project CHIP Authors
 *    All rights reserved.
 *
 *    Licensed under the Apache License, Version 2.0 (the "License");
 *    you may not use this file except in compliance with the License.
 *    You may obtain a copy of the License at
 *
 *        http://www.apache.org/licenses/LICENSE-2.0
 *
 *    Unless required by applicable law or agreed to in writing, software
 *    distributed under the License is distributed on an "AS IS" BASIS,
 *    WITHOUT WARRANTIES OR CONDITIONS OF ANY KIND, either express or implied.
 *    See the License for the specific language governing permissions and
 *    limitations under the License.
 */

#include "MotionSensorManager.h"
#include "AppTask.h"

#include <zephyr/logging/log.h>
LOG_MODULE_DECLARE(app, CONFIG_CHIP_APP_LOG_LEVEL);

MotionSensorManager MotionSensorManager::sMotionSensor;

int MotionSensorManager::Init()
{
    mState    = State::kMotionUndetected;
    mCallback = nullptr;
    return 0;
}

bool MotionSensorManager::IsMotionDetected() const
{
    return mState == State::kMotionDetected;
}

void MotionSensorManager::SetCallback(CallbackStateChanged cb)
{
    mCallback = cb;
}

void MotionSensorManager::InitiateAction(Action aAction)
{
    AppEvent event;
    event.Type               = AppEvent::kEventType_DeviceAction;
    event.DeviceEvent.Action = static_cast<uint8_t>(aAction);
    event.Handler            = HandleAction;

    GetAppTask().PostEvent(&event);
}

void MotionSensorManager::HandleAction(AppEvent * aEvent)
{
    Action action = static_cast<Action>(aEvent->DeviceEvent.Action);

    State newState = sMotionSensor.mState;

    if (action == Action::kSetDetected)
        newState = State::kMotionDetected;
    else if (action == Action::kSetUndetected)
        newState = State::kMotionUndetected;

    if (newState != sMotionSensor.mState)
        sMotionSensor.mState = newState;

    if (sMotionSensor.mCallback)
        sMotionSensor.mCallback(sMotionSensor.mState);
    else
        LOG_WRN("MotionSensor callback not set");
}
```

## src/ZclCallbacks.cpp
```c
/*
 *
 *    Copyright (c) 2025 Project CHIP Authors
 *    All rights reserved.
 *
 *    Licensed under the Apache License, Version 2.0 (the "License");
 *    you may not use this file except in compliance with the License.
 *    You may obtain a copy of the License at
 *
 *        http://www.apache.org/licenses/LICENSE-2.0
 *
 *    Unless required by applicable law or agreed to in writing, software
 *    distributed under the License is distributed on an "AS IS" BASIS,
 *    WITHOUT WARRANTIES OR CONDITIONS OF ANY KIND, either express or implied.
 *    See the License for the specific language governing permissions and
 *    limitations under the License.
 */

#include "AppTask.h"

#include <app-common/zap-generated/ids/Attributes.h>
#include <app-common/zap-generated/ids/Clusters.h>
#include <app/ConcreteAttributePath.h>
#include <lib/support/logging/CHIPLogging.h>

using namespace chip;
using namespace chip::app::Clusters;

LOG_MODULE_DECLARE(app, CONFIG_CHIP_APP_LOG_LEVEL);

void MatterPostAttributeChangeCallback(const chip::app::ConcreteAttributePath & attributePath, uint8_t, uint16_t, uint8_t * value)
{
    if (attributePath.mClusterId == OccupancySensing::Id &&
        attributePath.mAttributeId == OccupancySensing::Attributes::Occupancy::Id)
    {
        ChipLogProgress(Zcl, "Occupancy changed externally: %u", *value);

        if (!GetAppTask().IsSyncClusterToButtonAction())
        {
            GetAppTask().PostMotionActionRequest((*value & 0x01) ? MotionSensorManager::Action::kSetDetected
                                                                 : MotionSensorManager::Action::kSetUndetected);
        }
        GetAppTask().SetSyncClusterToButtonAction(false);
    }
}

void emberAfOccupancySensingClusterInitCallback(chip::EndpointId)
{
    ChipLogProgress(Zcl, "Occupancy cluster init");
    GetAppTask().UpdateClusterState();
}
```
