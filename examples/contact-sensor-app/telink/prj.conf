## CMakeLists.txt
```
#
#    Copyright (c) 2022-2026 Project CHIP Authors
#
#    Licensed under the Apache License, Version 2.0 (the "License");
#    you may not use this file except in compliance with the License.
#    You may obtain a copy of the License at
#
#        http://www.apache.org/licenses/LICENSE-2.0
#
#    Unless required by applicable law or agreed to in writing, software
#    distributed under the License is distributed on an "AS IS" BASIS,
#    WITHOUT WARRANTIES OR CONDITIONS OF ANY KIND, either express or implied.
#    See the License for the specific language governing permissions and
#    limitations under the License.
#

cmake_minimum_required(VERSION 3.20)

get_filename_component(CHIP_ROOT ${CMAKE_CURRENT_SOURCE_DIR}/third_party/connectedhomeip REALPATH)
get_filename_component(TELINK_COMMON ${CHIP_ROOT}/examples/platform/telink REALPATH)
get_filename_component(GEN_DIR ${CHIP_ROOT}/zzz_generated/ REALPATH)

include(${TELINK_COMMON}/common.cmake)
include(${CHIP_ROOT}/config/telink/app/enable-gnu-std.cmake)
include(${CHIP_ROOT}/src/app/chip_data_model.cmake)

project(chip-telink-contact-sensor-example)

target_include_directories(app PRIVATE
                           include
                           ${GEN_DIR}/app-common
                           ${GEN_DIR}/contact-sensor-app
                           ${TELINK_COMMON}/common/include
                           ${TELINK_COMMON}/util/include
                           ${TELINK_COMMON}/zephyr_ext)

target_sources(app PRIVATE
               src/AppTask.cpp
               src/ContactSensorManager.cpp
               src/ZclCallbacks.cpp
               ${CHIP_ROOT}/src/app/persistence/DeferredAttributePersistenceProvider.cpp
               ${TELINK_COMMON}/common/src/mainCommon.cpp
               ${TELINK_COMMON}/common/src/AppTaskCommon.cpp
               ${TELINK_COMMON}/util/src/LEDManager.cpp
               ${TELINK_COMMON}/util/src/ButtonManager.cpp
               ${TELINK_COMMON}/util/src/ThreadUtil.cpp
               ${TELINK_COMMON}/util/src/PWMManager.cpp
               ${TELINK_COMMON}/zephyr_ext/zephyr_key_matrix.c
               ${TELINK_COMMON}/zephyr_ext/zephyr_key_pool.c
               ${TELINK_COMMON}/zephyr_ext/zephyr_led_pool.c
               ${TELINK_COMMON}/zephyr_ext/zephyr_pwm_pool.c
               ${TELINK_COMMON}/zephyr_ext/zephyr_ws2812.c
               ${TELINK_COMMON}/zephyr_ext/zephyr_pm_observer.c)

chip_configure_data_model(app
    ZAP_FILE ${CMAKE_CURRENT_SOURCE_DIR}/../contact-sensor-common/contact-sensor-app.zap
)

if(CONFIG_BOOTLOADER_MCUBOOT)
  target_sources(app PRIVATE ${TELINK_COMMON}/util/src/OTAUtil.cpp)
endif()

if(CONFIG_OPENTHREAD_SNTP_CLIENT)
  target_sources(app PRIVATE
                   ${TELINK_COMMON}/util/src/ThreadTimeSync.cpp)
endif()

if(CONFIG_MCUMGR_TRANSPORT_BT)
  zephyr_library_link_libraries(MCUBOOT_BOOTUTIL)
    target_sources(app PRIVATE ${TELINK_COMMON}/util/src/DFUOverSMP.cpp)
endif()
```

## Kconfig
```
#
#    Copyright (c) 2023 Project CHIP Authors
#
#    Licensed under the Apache License, Version 2.0 (the "License");
#    you may not use this file except in compliance with the License.
#    You may obtain a copy of the License at
#
#        http://www.apache.org/licenses/LICENSE-2.0
#
#    Unless required by applicable law or agreed to in writing, software
#    distributed under the License is distributed on an "AS IS" BASIS,
#    WITHOUT WARRANTIES OR CONDITIONS OF ANY KIND, either express or implied.
#    See the License for the specific language governing permissions and
#    limitations under the License.
#
mainmenu "Matter Telink Contact Sensor Example Application"

rsource "../../../config/telink/chip-module/Kconfig.defaults"
source "Kconfig.zephyr"
```

## prj.conf
```kconfig
#
#    Copyright (c) 2022-2026 Project CHIP Authors
#
#    Licensed under the Apache License, Version 2.0 (the "License");
#    you may not use this file except in compliance with the License.
#    You may obtain a copy of the License at
#
#        http://www.apache.org/licenses/LICENSE-2.0
#
#    Unless required by applicable law or agreed to in writing, software
#    distributed under the License is distributed on an "AS IS" BASIS,
#    WITHOUT WARRANTIES OR CONDITIONS OF ANY KIND, either express or implied.
#    See the License for the specific language governing permissions and
#    limitations under the License.
#

# This sample uses Kconfig.defaults to set options common for all
# samples. This file should contain only options specific for this sample
# or overrides of default values.

# Enable CHIP
CONFIG_CHIP=y
CONFIG_STD_CPP20=y

# 32774 == 0x8006 (example contact-sensor-app)
CONFIG_CHIP_DEVICE_PRODUCT_ID=32774

# Bluetooth Low Energy configuration
CONFIG_BT_DEVICE_NAME="TelinkSensor"

# Disable Matter OTA DFU
CONFIG_CHIP_OTA_REQUESTOR=n
CONFIG_CHIP_DFU_OVER_BT_SMP=n
CONFIG_CHIP_DFU_OVER_BT_SMP_BUILD=n

CONFIG_CHIP_DEVICE_SOFTWARE_VERSION=1

# Disable CHIP shell support
CONFIG_CHIP_LIB_SHELL=n

# Disable factory data support
CONFIG_CHIP_FACTORY_DATA=n
CONFIG_CHIP_FACTORY_DATA_BUILD=n
CONFIG_CHIP_FACTORY_DATA_MERGE_WITH_FIRMWARE=n
CONFIG_CHIP_CERTIFICATION_DECLARATION_STORAGE=n

# Enable Power Management
CONFIG_PM=y
# Enable ADC
CONFIG_ADC=y

# compress ota
CONFIG_COMPRESS_LZMA=n
CONFIG_LZMA=n

# ICD SETTING INFO
CONFIG_CHIP_ICD_SLOW_POLL_INTERVAL=7500
CONFIG_CHIP_ICD_FAST_POLLING_INTERVAL=200
CONFIG_CHIP_ICD_ACTIVE_MODE_THRESHOLD=300
CONFIG_CHIP_ICD_IDLE_MODE_DURATION=900

# Secure programming requires CONFIG_CHIP_FACTORY_DATA and
# CONFIG_CHIP_CERTIFICATION_DECLARATION_STORAGE to be enabled.
CONFIG_SECURE_PROGRAMMING=n

# Enable CHIP-ID via ble
CONFIG_EXPOSE_CHIP_ID_VIA_BLE=n

# Enable Deferred Store Attribute
CONFIG_DEFERRED_ATTR_STORAGE=n
```

## boards/tl3238x_retention.conf
```kconfig
# Disable Matter OTA DFU
CONFIG_CHIP_OTA_REQUESTOR=n
CONFIG_CHIP_DFU_OVER_BT_SMP=n
CONFIG_CHIP_DFU_OVER_BT_SMP_BUILD=n

# Enable ADC
CONFIG_ADC=y

# LZMA compression library support
CONFIG_LZMA=n
# Disable Telink-specific LZMA firmware decompression for bootloader
CONFIG_COMPRESS_LZMA=n

#matter switch mode
# config NORMAL_MODE    0 independent matter mode
# ACTION_DUAL_MODE      1 matter action switch mode ,such as by button
# AUTO_SWITCH_DUAL_MODE 2 matter auto-switch mode ,such as by scan QR code.
CONFIG_DUAL_MODE=0
```

## boards/tl3238x_retention_dual_mode_ota_lzma.conf
```kconfig
# CONFIG_CHIP_DEVICE_SERIAL_NUMBER="TelinkLightSwitch-tl3238c"

# Disable Matter OTA DFU
CONFIG_CHIP_OTA_REQUESTOR=y
CONFIG_CHIP_DFU_OVER_BT_SMP=y
CONFIG_CHIP_DFU_OVER_BT_SMP_BUILD=y

# Enable ADC
CONFIG_ADC=y

#compress ota
CONFIG_LZMA=y
CONFIG_COMPRESS_LZMA=y

#matter switch mode
# config NORMAL_MODE    0 independent matter mode
# ACTION_DUAL_MODE      1 matter action switch mode ,such as by button
# AUTO_SWITCH_DUAL_MODE 2 matter auto-switch mode ,such as by scan QR code.
CONFIG_DUAL_MODE=1
```

## boards/tl3238x_retention_ota_lzma.conf
```kconfig
# CONFIG_CHIP_DEVICE_SERIAL_NUMBER="TelinkLightSwitch-tl3238c"

# Disable Matter OTA DFU
CONFIG_CHIP_OTA_REQUESTOR=y
CONFIG_CHIP_DFU_OVER_BT_SMP=y
CONFIG_CHIP_DFU_OVER_BT_SMP_BUILD=y

# Enable ADC
CONFIG_ADC=y

# LZMA compression library support
CONFIG_LZMA=y
# Enable Telink-specific LZMA firmware decompression for bootloader
CONFIG_COMPRESS_LZMA=y

#matter switch mode
# config NORMAL_MODE    0 independent matter mode
# ACTION_DUAL_MODE      1 matter action switch mode ,such as by button
# AUTO_SWITCH_DUAL_MODE 2 matter auto-switch mode ,such as by scan QR code.
CONFIG_DUAL_MODE=0
```

## boards/tl5218x_retention.conf
```kconfig
# CONFIG_CHIP_DEVICE_SERIAL_NUMBER="TelinkContactSensor-tl5218x"

# Disable Matter OTA DFU
CONFIG_CHIP_OTA_REQUESTOR=n
CONFIG_CHIP_DFU_OVER_BT_SMP=n
CONFIG_CHIP_DFU_OVER_BT_SMP_BUILD=n

# Enable ADC
CONFIG_ADC=n

# LZMA compression library support
CONFIG_LZMA=n
# Disable Telink-specific LZMA firmware decompression for bootloader
CONFIG_COMPRESS_LZMA=n

#matter switch mode
# config NORMAL_MODE    0 independent matter mode
# ACTION_DUAL_MODE      1 matter action switch mode ,such as by button
# AUTO_SWITCH_DUAL_MODE 2 matter auto-switch mode ,such as by scan QR code.
CONFIG_DUAL_MODE=0
```

## boards/tl5218x_retention_dual_mode_ota_lzma.conf
```kconfig
# CONFIG_CHIP_DEVICE_SERIAL_NUMBER="TelinkContactSensor-tl5218x"

# Disable Matter OTA DFU
CONFIG_CHIP_OTA_REQUESTOR=y
CONFIG_CHIP_DFU_OVER_BT_SMP=y
CONFIG_CHIP_DFU_OVER_BT_SMP_BUILD=y

# Enable ADC
CONFIG_ADC=n

#compress ota
CONFIG_LZMA=y
CONFIG_COMPRESS_LZMA=y

#matter switch mode
# config NORMAL_MODE    0 independent matter mode
# ACTION_DUAL_MODE      1 matter action switch mode ,such as by button
# AUTO_SWITCH_DUAL_MODE 2 matter auto-switch mode ,such as by scan QR code.
CONFIG_DUAL_MODE=1
```

## boards/tl5218x_retention_ota.conf
```kconfig
# CONFIG_CHIP_DEVICE_SERIAL_NUMBER="TelinkContactSensor-tl5218x"

# Disable Matter OTA DFU
CONFIG_CHIP_OTA_REQUESTOR=y
CONFIG_CHIP_DFU_OVER_BT_SMP=y
CONFIG_CHIP_DFU_OVER_BT_SMP_BUILD=y

# Enable ADC
CONFIG_ADC=n

# LZMA compression library support
CONFIG_LZMA=n
# Disable Telink-specific LZMA firmware decompression for bootloader
CONFIG_COMPRESS_LZMA=n

#matter switch mode
# config NORMAL_MODE    0 independent matter mode
# ACTION_DUAL_MODE      1 matter action switch mode ,such as by button
# AUTO_SWITCH_DUAL_MODE 2 matter auto-switch mode ,such as by scan QR code.
CONFIG_DUAL_MODE=0
```

## src/main.cpp
```c
/*
 *
 *    Copyright (c) 2022 Project CHIP Authors
 *    All rights reserved.
 *
 *    Licensed under the Apache License, Version 2.0 (the "License");
 *    you may not use this file except in compliance with the License.
 *    You may obtain a copy of the License at
 *
 *        http://www.apache.org/licenses/LICENSE-2.0
 *
 *    Unless required by applicable law or agreed to in writing, software
 *    distributed under the License is distributed on an "AS IS" BASIS,
 *    WITHOUT WARRANTIES OR CONDITIONS OF ANY KIND, either express or implied.
 *    See the License for the specific language governing permissions and
 *    limitations under the License.
 */

#include "AppTask.h"

#include <lib/support/CHIPMem.h>
#include <platform/CHIPDeviceLayer.h>

#include <zephyr/kernel.h>

LOG_MODULE_REGISTER(app);

using namespace ::chip;
using namespace ::chip::Inet;
using namespace ::chip::DeviceLayer;

int main(void)
{
    CHIP_ERROR err = CHIP_NO_ERROR;

    err = chip::Platform::MemoryInit();
    if (err != CHIP_NO_ERROR)
    {
        LOG_ERR("MemoryInit fail");
        goto exit;
    }

    err = PlatformMgr().InitChipStack();
    if (err != CHIP_NO_ERROR)
    {
        LOG_ERR("InitChipStack fail");
        goto exit;
    }

    err = PlatformMgr().StartEventLoopTask();
    if (err != CHIP_NO_ERROR)
    {
        LOG_ERR("StartEventLoopTask fail");
        goto exit;
    }

    err = ThreadStackMgr().InitThreadStack();
    if (err != CHIP_NO_ERROR)
    {
        LOG_ERR("InitThreadStack fail");
        goto exit;
    }

#ifdef CONFIG_OPENTHREAD_MTD_SED
    err = ConnectivityMgr().SetThreadDeviceType(ConnectivityManager::kThreadDeviceType_SleepyEndDevice);
#elif CONFIG_OPENTHREAD_MTD
    err = ConnectivityMgr().SetThreadDeviceType(ConnectivityManager::kThreadDeviceType_MinimalEndDevice);
#else
    err = ConnectivityMgr().SetThreadDeviceType(ConnectivityManager::kThreadDeviceType_Router);
#endif
    if (err != CHIP_NO_ERROR)
    {
        LOG_ERR("SetThreadDeviceType fail");
        goto exit;
    }

    err = GetAppTask().StartApp();

exit:
    LOG_ERR("Exit err %" CHIP_ERROR_FORMAT, err.Format());
    return (err == CHIP_NO_ERROR) ? EXIT_SUCCESS : EXIT_FAILURE;
}
```

## include/AppConfig.h
```c
/*
 *
 *    Copyright (c) 2022 Project CHIP Authors
 *    All rights reserved.
 *
 *    Licensed under the Apache License, Version 2.0 (the "License");
 *    you may not use this file except in compliance with the License.
 *    You may obtain a copy of the License at
 *
 *        http://www.apache.org/licenses/LICENSE-2.0
 *
 *    Unless required by applicable law or agreed to in writing, software
 *    distributed under the License is distributed on an "AS IS" BASIS,
 *    WITHOUT WARRANTIES OR CONDITIONS OF ANY KIND, either express or implied.
 *    See the License for the specific language governing permissions and
 *    limitations under the License.
 */

#pragma once

// ---- All Clusters Application example config ----

#define APP_SET_NETWORK_COMM_ENDPOINT_SEC 0
```

## include/AppEvent.h
```c
/*
 *
 *    Copyright (c) 2022 Project CHIP Authors
 *    All rights reserved.
 *
 *    Licensed under the Apache License, Version 2.0 (the "License");
 *    you may not use this file except in compliance with the License.
 *    You may obtain a copy of the License at
 *
 *        http://www.apache.org/licenses/LICENSE-2.0
 *
 *    Unless required by applicable law or agreed to in writing, software
 *    distributed under the License is distributed on an "AS IS" BASIS,
 *    WITHOUT WARRANTIES OR CONDITIONS OF ANY KIND, either express or implied.
 *    See the License for the specific language governing permissions and
 *    limitations under the License.
 */

#pragma once

#include <cstdint>

struct AppEvent;
typedef void (*EventHandler)(AppEvent *);

class LEDWidget;

struct AppEvent
{
    enum AppEventTypes
    {
        kEventType_Button = 0,
        kEventType_Timer,
        kEventType_UpdateLedState,
        kEventType_IdentifyStart,
        kEventType_IdentifyStop,
        kEventType_Contact,
    };

    uint16_t Type;

    union
    {
        struct
        {
            uint8_t Action;
        } ButtonEvent;
        struct
        {
            uint8_t Action;
        } ContactEvent;
        struct
        {
            LEDWidget * LedWidget;
        } UpdateLedStateEvent;
    };

    EventHandler Handler;
};
```

## include/AppTask.h
```c
/*
 *
 *    Copyright (c) 2022-2023 Project CHIP Authors
 *    All rights reserved.
 *
 *    Licensed under the Apache License, Version 2.0 (the "License");
 *    you may not use this file except in compliance with the License.
 *    You may obtain a copy of the License at
 *
 *        http://www.apache.org/licenses/LICENSE-2.0
 *
 *    Unless required by applicable law or agreed to in writing, software
 *    distributed under the License is distributed on an "AS IS" BASIS,
 *    WITHOUT WARRANTIES OR CONDITIONS OF ANY KIND, either express or implied.
 *    See the License for the specific language governing permissions and
 *    limitations under the License.
 */

#pragma once

#include "AppTaskCommon.h"
#include "ContactSensorManager.h"

// Application-defined error codes in the CHIP_ERROR space.
#define APP_ERROR_UNHANDLED_EVENT CHIP_APPLICATION_ERROR(0x03)

class AppTask : public AppTaskCommon
{
public:
    void PostContactActionRequest(ContactSensorManager::Action aAction);
    void UpdateClusterState(void);
    void UpdateDeviceState(void);

    bool IsSyncClusterToButtonAction(void);
    void SetSyncClusterToButtonAction(bool value);

private:
    friend AppTask & GetAppTask(void);
    friend class AppTaskCommon;

    CHIP_ERROR Init(void);
    void LinkLeds(LedManager & ledManager);

    static void OnStateChanged(ContactSensorManager::State aState);

    static void UpdateClusterStateInternal(intptr_t arg);
    static void UpdateDeviceStateInternal(intptr_t arg);

    static void ContactActionEventHandler(AppEvent * aEvent);

    bool mSyncClusterToButtonAction = false;

    static AppTask sAppTask;
};

inline AppTask & GetAppTask(void)
{
    return AppTask::sAppTask;
}

inline bool AppTask::IsSyncClusterToButtonAction()
{
    return mSyncClusterToButtonAction;
}

inline void AppTask::SetSyncClusterToButtonAction(bool value)
{
    mSyncClusterToButtonAction = value;
}
```

## include/CHIPProjectConfig.h
```c
/*
 *
 *    Copyright (c) 2022-2023 Project CHIP Authors
 *    All rights reserved.
 *
 *    Licensed under the Apache License, Version 2.0 (the "License");
 *    you may not use this file except in compliance with the License.
 *    You may obtain a copy of the License at
 *
 *        http://www.apache.org/licenses/LICENSE-2.0
 *
 *    Unless required by applicable law or agreed to in writing, software
 *    distributed under the License is distributed on an "AS IS" BASIS,
 *    WITHOUT WARRANTIES OR CONDITIONS OF ANY KIND, either express or implied.
 *    See the License for the specific language governing permissions and
 *    limitations under the License.
 */

/**
 *    @file
 *          Example project configuration file for CHIP.
 *
 *          This is a place to put application or project-specific overrides
 *          to the default configuration values for general CHIP features.
 *
 */

#pragma once

// Use a default pairing code if one hasn't been provisioned in flash.
#define CHIP_DEVICE_CONFIG_USE_TEST_SETUP_PIN_CODE 20202021
#define CHIP_DEVICE_CONFIG_USE_TEST_SETUP_DISCRIMINATOR 0xF00

/**
 * CHIP_SYSTEM_CONFIG_PACKETBUFFER_POOL_SIZE
 *
 * Reduce packet buffer pool size to 8 (default 15) to reduce ram consumption
 */
#define CHIP_SYSTEM_CONFIG_PACKETBUFFER_POOL_SIZE 8
```

## include/ContactSensorManager.h
```c
/*
 *
 * SPDX-FileCopyrightText: 2022 Project CHIP Authors
 *
 * SPDX-License-Identifier: Apache-2.0
 */

#pragma once

#include <stdbool.h>
#include <stdint.h>

#include "AppEventCommon.h"

class ContactSensorManager
{
public:
    enum class Action : uint8_t
    {
        kSignalDetected = 0,
        kSignalLost,
        kInvalid
    };

    enum class State : uint8_t
    {
        kContactClosed = 0,
        kContactOpened,
        kInvalid
    };

    int Init();
    bool IsContactClosed();
    void InitiateAction(Action aAction);

    typedef void (*CallbackStateChanged)(State aState);
    void SetCallback(CallbackStateChanged aCallbackStateChanged);

    static void HandleAction(AppEvent * aEvent);

private:
    friend ContactSensorManager & ContactSensorMgr(void);
    State mState;
    CallbackStateChanged mCallbackStateChanged;
    static ContactSensorManager sContactSensor;
};

inline ContactSensorManager & ContactSensorMgr(void)
{
    return ContactSensorManager::sContactSensor;
}
```

## src/AppTask.cpp
```c
/*
 *
 *    Copyright (c) 2022-2024 Project CHIP Authors
 *    All rights reserved.
 *
 *    Licensed under the Apache License, Version 2.0 (the "License");
 *    you may not use this file except in compliance with the License.
 *    You may obtain a copy of the License at
 *
 *        http://www.apache.org/licenses/LICENSE-2.0
 *
 *    Unless required by applicable law or agreed to in writing, software
 *    distributed under the License is distributed on an "AS IS" BASIS,
 *    WITHOUT WARRANTIES OR CONDITIONS OF ANY KIND, either express or implied.
 *    See the License for the specific language governing permissions and
 *    limitations under the License.
 */

#include "AppTask.h"
#include "LEDManager.h"

#include <app-common/zap-generated/attributes/Accessors.h>

// TODO: Ideally we should not depend on the codegen integration
// It would be best if we could use generic cluster API instead
#include <app/clusters/boolean-state-server/CodegenIntegration.h>

#include <zephyr/kernel.h>
#include <zephyr/logging/log.h>

LOG_MODULE_DECLARE(app, CONFIG_CHIP_APP_LOG_LEVEL);

AppTask AppTask::sAppTask;

CHIP_ERROR AppTask::Init(void)
{
    SetExampleButtonCallbacks(ContactActionEventHandler);
    ReturnErrorOnFailure(InitCommonParts());

    LedManager::getInstance().setLed(LedManager::EAppLed_App0, ContactSensorMgr().IsContactClosed());

    UpdateDeviceState();

    ContactSensorMgr().SetCallback(OnStateChanged);

    return CHIP_NO_ERROR;
}

void AppTask::OnStateChanged(ContactSensorManager::State aState)
{
    // If the contact state was changed, update LED state and cluster state (only if button was pressed).
    //  - turn on the contact LED if contact sensor is in closed state.
    //  - turn off the lock LED if contact sensor is in opened state.
    if (ContactSensorManager::State::kContactClosed == aState)
    {
        LOG_INF("Contact state changed to CLOSED");
        LedManager::getInstance().setLed(LedManager::EAppLed_App0, true);
    }
    else if (ContactSensorManager::State::kContactOpened == aState)
    {
        LOG_INF("Contact state changed to OPEN");
        LedManager::getInstance().setLed(LedManager::EAppLed_App0, false);
    }

    if (sAppTask.IsSyncClusterToButtonAction())
    {
        sAppTask.UpdateClusterState();
    }
}

void AppTask::PostContactActionRequest(ContactSensorManager::Action aAction)
{
    AppEvent event;
    event.Type               = AppEvent::kEventType_DeviceAction;
    event.DeviceEvent.Action = static_cast<uint8_t>(aAction);
    event.Handler            = ContactActionEventHandler;

    sAppTask.PostEvent(&event);
}

void AppTask::UpdateClusterStateInternal(intptr_t arg)
{
    uint8_t newValue = ContactSensorMgr().IsContactClosed();

    ChipLogProgress(NotSpecified, "StateValue::Set : %d", newValue);

    auto booleanState = chip::app::Clusters::BooleanState::FindClusterOnEndpoint(1);
    VerifyOrReturn(booleanState != nullptr);
    booleanState->SetStateValue(newValue);
}

void AppTask::ContactActionEventHandler(AppEvent * aEvent)
{
    ContactSensorManager::Action action = ContactSensorManager::Action::kInvalid;
    CHIP_ERROR err                      = CHIP_NO_ERROR;

    ChipLogProgress(NotSpecified, "ContactActionEventHandler");

    if (aEvent->Type == AppEvent::kEventType_DeviceAction)
    {
        action = static_cast<ContactSensorManager::Action>(aEvent->DeviceEvent.Action);
    }
    else if (aEvent->Type == AppEvent::kEventType_Button)
    {
        if (ContactSensorMgr().IsContactClosed())
        {
            action = ContactSensorManager::Action::kSignalLost;
        }
        else
        {
            action = ContactSensorManager::Action::kSignalDetected;
        }

        sAppTask.SetSyncClusterToButtonAction(true);
    }
    else
    {
        err    = APP_ERROR_UNHANDLED_EVENT;
        action = ContactSensorManager::Action::kInvalid;
    }

    if (err == CHIP_NO_ERROR)
    {
        ContactSensorMgr().InitiateAction(action);
    }
}

void AppTask::UpdateClusterState(void)
{
    LogErrorOnFailure(PlatformMgr().ScheduleWork(UpdateClusterStateInternal, 0));
}

void AppTask::UpdateDeviceState(void)
{
    LogErrorOnFailure(PlatformMgr().ScheduleWork(UpdateDeviceStateInternal, 0));
}

void AppTask::UpdateDeviceStateInternal(intptr_t arg)
{
    auto booleanState = chip::app::Clusters::BooleanState::FindClusterOnEndpoint(1);
    VerifyOrReturn(booleanState != nullptr);
    auto stateValueAttrValue = booleanState->GetStateValue();
    LedManager::getInstance().setLed(LedManager::EAppLed_App0, stateValueAttrValue);
}

void AppTask::LinkLeds(LedManager & ledManager)
{
#if CONFIG_CHIP_ENABLE_APPLICATION_STATUS_LED
    ledManager.linkLed(LedManager::EAppLed_Status, 0);
    ledManager.linkLed(LedManager::EAppLed_App0, 1);
#else
    ledManager.linkLed(LedManager::EAppLed_App0, 0);
#endif // CONFIG_CHIP_ENABLE_APPLICATION_STATUS_LED
}
```

## src/ContactSensorManager.cpp
```c
/*
 *
 *    Copyright (c) 2022 Project CHIP Authors
 *    All rights reserved.
 *
 *    Licensed under the Apache License, Version 2.0 (the "License");
 *    you may not use this file except in compliance with the License.
 *    You may obtain a copy of the License at
 *
 *        http://www.apache.org/licenses/LICENSE-2.0
 *
 *    Unless required by applicable law or agreed to in writing, software
 *    distributed under the License is distributed on an "AS IS" BASIS,
 *    WITHOUT WARRANTIES OR CONDITIONS OF ANY KIND, either express or implied.
 *    See the License for the specific language governing permissions and
 *    limitations under the License.
 */

#include "ContactSensorManager.h"

#include "AppConfig.h"
#include "AppTask.h"

#include <lib/support/CodeUtils.h>

#include <zephyr/drivers/pwm.h>
#include <zephyr/kernel.h>
#include <zephyr/logging/log.h>

LOG_MODULE_DECLARE(app, CONFIG_CHIP_APP_LOG_LEVEL);

ContactSensorManager ContactSensorManager::sContactSensor;

int ContactSensorManager::Init()
{
    int err = 0;

    mState                = State::kContactOpened;
    mCallbackStateChanged = nullptr;

    return err;
}

void ContactSensorManager::SetCallback(CallbackStateChanged aCallbackStateChanged)
{
    mCallbackStateChanged = aCallbackStateChanged;
}

bool ContactSensorManager::IsContactClosed()
{
    return mState == State::kContactClosed;
}

void ContactSensorManager::InitiateAction(Action aAction)
{
    AppEvent event;
    event.Type                = AppEvent::kEventType_Contact;
    event.ContactEvent.Action = static_cast<uint8_t>(aAction);
    event.Handler             = HandleAction;
    GetAppTask().PostEvent(&event);
}

void ContactSensorManager::HandleAction(AppEvent * aEvent)
{
    Action action = static_cast<Action>(aEvent->ContactEvent.Action);
    // Change current state based on action:
    // - if state is closed and action is signal lost, change state to opened
    // - if state is opened and action is signal detected, change state to closed
    // - else, the state/action combination does not change the state.
    if (sContactSensor.mState == State::kContactClosed && action == Action::kSignalLost)
    {
        sContactSensor.mState = State::kContactOpened;
    }
    else if (sContactSensor.mState == State::kContactOpened && action == Action::kSignalDetected)
    {
        sContactSensor.mState = State::kContactClosed;
    }

    if (sContactSensor.mCallbackStateChanged != nullptr)
    {
        sContactSensor.mCallbackStateChanged(sContactSensor.mState);
    }
    else
    {
        LOG_ERR("Callback for state change was not set. Please set an appropriate callback.");
    }
}
```

## src/ZclCallbacks.cpp
```c
/*
 *
 *    Copyright (c) 2022 Project CHIP Authors
 *    All rights reserved.
 *
 *    Licensed under the Apache License, Version 2.0 (the "License");
 *    you may not use this file except in compliance with the License.
 *    You may obtain a copy of the License at
 *
 *        http://www.apache.org/licenses/LICENSE-2.0
 *
 *    Unless required by applicable law or agreed to in writing, software
 *    distributed under the License is distributed on an "AS IS" BASIS,
 *    WITHOUT WARRANTIES OR CONDITIONS OF ANY KIND, either express or implied.
 *    See the License for the specific language governing permissions and
 *    limitations under the License.
 */

#include "AppTask.h"

#include <app-common/zap-generated/ids/Attributes.h>
#include <app-common/zap-generated/ids/Clusters.h>
#include <app/ConcreteAttributePath.h>
#include <app/clusters/boolean-state-server/CodegenIntegration.h>
#include <app/data-model-provider/AttributeChangeListener.h>
#include <lib/support/logging/CHIPLogging.h>

using namespace chip;
using namespace chip::app::Clusters;

LOG_MODULE_DECLARE(app, CONFIG_CHIP_APP_LOG_LEVEL);

void MatterPostAttributeChangeCallback(const chip::app::ConcreteAttributePath & attributePath, uint8_t type, uint16_t size,
                                       uint8_t * value)
{
    ClusterId clusterId = attributePath.mClusterId;
    ChipLogProgress(Zcl, "Cluster callback: " ChipLogFormatMEI, ChipLogValueMEI(clusterId));
}

void MatterCodegenPostAttributeChangeCallback(const chip::app::ConcreteAttributePath & path,
                                              chip::app::DataModel::AttributeChangeType type)
{
    if (path.mClusterId == BooleanState::Id && path.mAttributeId == BooleanState::Attributes::StateValue::Id)
    {
        auto * cluster = BooleanState::FindClusterOnEndpoint(path.mEndpointId);
        if (cluster != nullptr)
        {
            bool value = cluster->GetStateValue();
            ChipLogProgress(Zcl, "Cluster BooleanState: attribute StateValue set to %u", value);
            AppTask & task = GetAppTask();
            if (task.IsSyncClusterToButtonAction())
            {
                task.SetSyncClusterToButtonAction(false);
            }
            else
            {
                task.PostContactActionRequest(value ? ContactSensorManager::Action::kSignalDetected
                                                    : ContactSensorManager::Action::kSignalLost);
            }
        }
    }
}

void emberAfBooleanStateClusterInitCallback(EndpointId endpoint)
{
    ChipLogProgress(Zcl, "emberAfBooleanStateClusterInitCallback");
    GetAppTask().UpdateClusterState();
}
```
