/*
 * Copyright (c) 2026 Project CHIP Authors
 * SPDX-License-Identifier: Apache-2.0
 */

/ {
	aliases {
		led0 = &light_led;
	};

	leds {
		compatible = "gpio-leds";

		/*
		 * External LED on a non-strapping pin. GPIO2, GPIO8 and GPIO9 are
		 * strapping pins on the ESP32-C3; the on-board LED is a WS2812 on GPIO8.
		 */
		light_led: led_0 {
			gpios = <&gpio0 3 GPIO_ACTIVE_HIGH>;
			label = "Matter light";
		};
	};
};
