## CMakeLists.txt
```
#
#    Copyright (c) 2026 Project CHIP Authors
#
#    Licensed under the Apache License, Version 2.0 (the "License");
#    you may not use this file except in compliance with the License.
#    You may obtain a copy of the License at
#
#        http://www.apache.org/licenses/LICENSE-2.0
#
#    Unless required by applicable law or agreed to in writing, software
#    distributed under the License is distributed on an "AS IS" BASIS,
#    WITHOUT WARRANTIES OR CONDITIONS OF ANY KIND, either express or implied.
#    See the License for the specific language governing permissions and
#    limitations under the License.
#

cmake_minimum_required(VERSION 3.20)

get_filename_component(CHIP_ROOT ${CMAKE_CURRENT_SOURCE_DIR}/third_party/connectedhomeip REALPATH)
get_filename_component(TELINK_COMMON ${CHIP_ROOT}/examples/platform/telink REALPATH)
get_filename_component(GEN_DIR ${CHIP_ROOT}/zzz_generated/ REALPATH)
get_filename_component(ALL_DEVICES_COMMON_DIR ${CHIP_ROOT}/examples/all-devices-app/all-devices-common REALPATH)

include(${TELINK_COMMON}/common.cmake)
include(${CHIP_ROOT}/config/telink/app/enable-gnu-std.cmake)
include(${ALL_DEVICES_COMMON_DIR}/device-factory/enabled_devices.cmake)

add_compile_definitions(IDENTIFY_CLUSTER_DISABLED=1)

project(chip-telink-all-devices-app-example)

target_include_directories(app PRIVATE
                           include
                           ${GEN_DIR}/app-common
                           ${TELINK_COMMON}/common/include
                           ${TELINK_COMMON}/util/include
                           ${TELINK_COMMON}/app/include
                           ${TELINK_COMMON}/zephyr_ext
                           ${CHIP_ROOT}/examples/all-devices-app/all-devices-common
                           ${CHIP_ROOT}/src/data-model-providers/codedriven
                           ${CHIP_ROOT}/src/data-model-providers
                           ${CMAKE_CURRENT_BINARY_DIR} # for generated app_config/enabled_devices.h
                           ${ALL_DEVICES_EXTRA_INCLUDE_DIRS})

target_sources(app PRIVATE
               # Code-driven data model
               ${CHIP_ROOT}/src/data-model-providers/codedriven/CodeDrivenDataModelProvider.cpp
               ${CHIP_ROOT}/src/data-model-providers/codedriven/endpoint/EndpointInterfaceRegistry.cpp
               ${CHIP_ROOT}/src/app/server-cluster/ServerClusterInterfaceRegistry.cpp
               ${CHIP_ROOT}/src/app/StorageDelegateWrapper.cpp
               ${CHIP_ROOT}/src/app/persistence/DefaultAttributePersistenceProvider.cpp

               # all-devices common sources (interfaces, root node base, supported devices)
               ${ALL_DEVICES_DEVICE_SOURCES}
               ${ALL_DEVICES_CLUSTER_SOURCES})

target_sources(app PRIVATE
               src/AppTask.cpp
               src/DeviceTypeShell.cpp
               ${TELINK_COMMON}/common/src/AllDevicesServer.cpp
               ${TELINK_COMMON}/common/src/mainCommon.cpp
               ${TELINK_COMMON}/common/src/AppTaskCommon.cpp
               ${TELINK_COMMON}/util/src/LEDManager.cpp
               ${TELINK_COMMON}/util/src/ButtonManager.cpp
               ${TELINK_COMMON}/util/src/ThreadUtil.cpp
               ${TELINK_COMMON}/util/src/PWMManager.cpp
               ${TELINK_COMMON}/util/src/ColorFormat.cpp
               ${TELINK_COMMON}/zephyr_ext/zephyr_key_matrix.c
               ${TELINK_COMMON}/zephyr_ext/zephyr_key_pool.c
               ${TELINK_COMMON}/zephyr_ext/zephyr_led_pool.c
               ${TELINK_COMMON}/zephyr_ext/zephyr_ws2812.c
               ${TELINK_COMMON}/zephyr_ext/zephyr_pm_observer.c)

if(CONFIG_NET_L2_OPENTHREAD)
  target_sources(app PRIVATE
    ${CHIP_ROOT}/examples/all-devices-app/all-devices-common/device/types/root-node/features/ThreadFeature.cpp
    ${CHIP_ROOT}/examples/all-devices-app/all-devices-common/device/types/root-node/features/ThreadFeature.h
    ${CHIP_ROOT}/examples/all-devices-app/all-devices-common/device/types/root-node/ThreadRootNode.h
  )
elseif(CONFIG_CHIP_WIFI)
  target_sources(app PRIVATE
    ${CHIP_ROOT}/examples/all-devices-app/all-devices-common/device/types/root-node/features/WifiFeature.cpp
    ${CHIP_ROOT}/examples/all-devices-app/all-devices-common/device/types/root-node/features/WifiFeature.h
    ${CHIP_ROOT}/examples/all-devices-app/all-devices-common/device/types/root-node/WifiRootNode.h
  )
endif()

if(CONFIG_PWM)
	target_sources(app PRIVATE ${TELINK_COMMON}/zephyr_ext/zephyr_pwm_pool.c)
endif()

if(CONFIG_BOOTLOADER_MCUBOOT)
  target_sources(app PRIVATE ${TELINK_COMMON}/util/src/OTAUtil.cpp)
endif()

if (CONFIG_CHIP_PW_RPC)
  include(${TELINK_COMMON}/Rpc.cmake)
endif()

if(CONFIG_OPENTHREAD_SNTP_CLIENT)
  target_sources(app PRIVATE
                   ${TELINK_COMMON}/util/src/ThreadTimeSync.cpp)
endif()
```

## Kconfig
```
#
#    Copyright (c) 2026 Project CHIP Authors
#
#    Licensed under the Apache License, Version 2.0 (the "License");
#    you may not use this file except in compliance with the License.
#    You may obtain a copy of the License at
#
#        http://www.apache.org/licenses/LICENSE-2.0
#
#    Unless required by applicable law or agreed to in writing, software
#    distributed under the License is distributed on an "AS IS" BASIS,
#    WITHOUT WARRANTIES OR CONDITIONS OF ANY KIND, either express or implied.
#    See the License for the specific language governing permissions and
#    limitations under the License.
#
mainmenu "Matter Telink All Devices Example Application"

rsource "../../../config/telink/chip-module/Kconfig.defaults"
source "Kconfig.zephyr"

config CHIP_TELINK_ALL_DEVICES_APP
    bool
    default y
```

## prj.conf
```kconfig
#
#    Copyright (c) 2026 Project CHIP Authors
#
#    Licensed under the Apache License, Version 2.0 (the "License");
#    you may not use this file except in compliance with the License.
#    You may obtain a copy of the License at
#
#        http://www.apache.org/licenses/LICENSE-2.0
#
#    Unless required by applicable law or agreed to in writing, software
#    distributed under the License is distributed on an "AS IS" BASIS,
#    WITHOUT WARRANTIES OR CONDITIONS OF ANY KIND, either express or implied.
#    See the License for the specific language governing permissions and
#    limitations under the License.
#

# This sample uses Kconfig.defaults to set options common for all
# samples. This file should contain only options specific for this sample
# or overrides of default values.

# Enable CHIP
CONFIG_CHIP=y
CONFIG_STD_CPP20=y

# Bluetooth Low Energy configuration
CONFIG_BT_DEVICE_NAME="AllDevices"

# Disable Matter OTA DFU
CONFIG_CHIP_OTA_REQUESTOR=n
CONFIG_CHIP_DFU_OVER_BT_SMP=n
CONFIG_CHIP_DFU_OVER_BT_SMP_BUILD=n
CONFIG_CHIP_DEVICE_SOFTWARE_VERSION=1
CONFIG_TELINK_OTA_BUTTON_TEST=n

# Enable CHIP shell support
CONFIG_CHIP_LIB_SHELL=y

# Disable factory data support
CONFIG_CHIP_FACTORY_DATA=n
CONFIG_CHIP_FACTORY_DATA_BUILD=n
CONFIG_CHIP_FACTORY_DATA_MERGE_WITH_FIRMWARE=n
CONFIG_CHIP_CERTIFICATION_DECLARATION_STORAGE=n

# Enable PWM
CONFIG_PWM=y

# Enable Power Management
CONFIG_PM=n
```

## include/AppConfig.h
```c
/*
 *
 *    Copyright (c) 2026 Project CHIP Authors
 *    All rights reserved.
 *
 *    Licensed under the Apache License, Version 2.0 (the "License");
 *    you may not use this file except in compliance with the License.
 *    You may obtain a copy of the License at
 *
 *        http://www.apache.org/licenses/LICENSE-2.0
 *
 *    Unless required by applicable law or agreed to in writing, software
 *    distributed under the License is distributed on an "AS IS" BASIS,
 *    WITHOUT WARRANTIES OR CONDITIONS OF ANY KIND, either express or implied.
 *    See the License for the specific language governing permissions and
 *    limitations under the License.
 */

#pragma once

// ---- All Devices App Config ----

#define APP_SET_NETWORK_COMM_ENDPOINT_SEC 0
```

## include/AppTask.h
```c
/*
 *
 *    Copyright (c) 2026 Project CHIP Authors
 *    All rights reserved.
 *
 *    Licensed under the Apache License, Version 2.0 (the "License");
 *    you may not use this file except in compliance with the License.
 *    You may obtain a copy of the License at
 *
 *        http://www.apache.org/licenses/LICENSE-2.0
 *
 *    Unless required by applicable law or agreed to in writing, software
 *    distributed under the License is distributed on an "AS IS" BASIS,
 *    WITHOUT WARRANTIES OR CONDITIONS OF ANY KIND, either express or implied.
 *    See the License for the specific language governing permissions and
 *    limitations under the License.
 */

#pragma once

#include "AppTaskCommon.h"

class AppTask : public AppTaskCommon
{
private:
    friend AppTask & GetAppTask(void);
    friend class AppTaskCommon;

    CHIP_ERROR Init(void);
    void LinkLeds(LedManager & ledManager);

    static AppTask sAppTask;
};

inline AppTask & GetAppTask(void)
{
    return AppTask::sAppTask;
}
```

## include/CHIPProjectConfig.h
```c
/*
 *
 *    Copyright (c) 2026 Project CHIP Authors
 *    All rights reserved.
 *
 *    Licensed under the Apache License, Version 2.0 (the "License");
 *    you may not use this file except in compliance with the License.
 *    You may obtain a copy of the License at
 *
 *        http://www.apache.org/licenses/LICENSE-2.0
 *
 *    Unless required by applicable law or agreed to in writing, software
 *    distributed under the License is distributed on an "AS IS" BASIS,
 *    WITHOUT WARRANTIES OR CONDITIONS OF ANY KIND, either express or implied.
 *    See the License for the specific language governing permissions and
 *    limitations under the License.
 */

/**
 *    @file
 *          Example project configuration file for CHIP.
 *
 *          This is a place to put application or project-specific overrides
 *          to the default configuration values for general CHIP features.
 *
 */

#pragma once

// Use a default pairing code if one hasn't been provisioned in flash.
#define CHIP_DEVICE_CONFIG_USE_TEST_SETUP_PIN_CODE 20202021
#define CHIP_DEVICE_CONFIG_USE_TEST_SETUP_DISCRIMINATOR 0xF00

//  Switching from Thread child to router may cause a few second packet stall.
//  Until this is improved in OpenThread we need to increase the retransmission
//  interval to survive the stall.
#define CHIP_CONFIG_MRP_LOCAL_ACTIVE_RETRY_INTERVAL (1000_ms32)

// ========== Multicast groups Configuration Overrides =========
#undef CHIP_CONFIG_MAX_GROUP_ENDPOINTS_PER_FABRIC
#define CHIP_CONFIG_MAX_GROUP_ENDPOINTS_PER_FABRIC 2

#define CHIP_CONFIG_EXAMPLE_ACCESS_CONTROL_MAX_SUBJECTS_PER_ENTRY (4 * CHIP_CONFIG_MAX_GROUP_ENDPOINTS_PER_FABRIC)
```

## src/AppTask.cpp
```c
/*
 *
 *    Copyright (c) 2026 Project CHIP Authors
 *    All rights reserved.
 *
 *    Licensed under the Apache License, Version 2.0 (the "License");
 *    you may not use this file except in compliance with the License.
 *    You may obtain a copy of the License at
 *
 *        http://www.apache.org/licenses/LICENSE-2.0
 *
 *    Unless required by applicable law or agreed to in writing, software
 *    distributed under the License is distributed on an "AS IS" BASIS,
 *    WITHOUT WARRANTIES OR CONDITIONS OF ANY KIND, either express or implied.
 *    See the License for the specific language governing permissions and
 *    limitations under the License.
 */

#include "AppTask.h"
#include "LEDManager.h"

LOG_MODULE_DECLARE(app, CONFIG_CHIP_APP_LOG_LEVEL);

AppTask AppTask::sAppTask;

CHIP_ERROR AppTask::Init(void)
{
    ReturnErrorOnFailure(InitCommonParts());

    return CHIP_NO_ERROR;
}

void AppTask::LinkLeds(LedManager & ledManager)
{
#if CONFIG_CHIP_ENABLE_APPLICATION_STATUS_LED
    ledManager.linkLed(LedManager::EAppLed_Status, 0);
#endif

#if !CONFIG_PWM
    ledManager.linkLed(LedManager::EAppLed_App0, 1);
#endif /* !CONFIG_PWM */
}
```

## src/DeviceTypeShell.cpp
```c
/*
 *
 *    Copyright (c) 2026 Project CHIP Authors
 *    All rights reserved.
 *
 *    Licensed under the Apache License, Version 2.0 (the "License");
 *    you may not use this file except in compliance with the License.
 *    You may obtain a copy of the License at
 *
 *        http://www.apache.org/licenses/LICENSE-2.0
 *
 *    Unless required by applicable law or agreed to in writing, software
 *    distributed under the License is distributed on an "AS IS" BASIS,
 *    WITHOUT WARRANTIES OR CONDITIONS OF ANY KIND, either express or implied.
 *    See the License for the specific language governing permissions and
 *    limitations under the License.
 */

#include "AllDevicesServer.h"

#if CONFIG_CHIP_LIB_SHELL

#include <device-factory/DeviceFactory.h>
#include <platform/CHIPDeviceLayer.h>

#include <zephyr/shell/shell.h>

#include <string>

namespace {

std::string gRequestedDeviceType;
bool gStartRequested = false;

void StartAllDevicesServerWork(intptr_t)
{
    CHIP_ERROR err = chip::app::all_devices::StartAllDevicesServer(gRequestedDeviceType);
    if (err != CHIP_NO_ERROR)
    {
        ChipLogError(AppServer, "Failed to start all-devices server: %" CHIP_ERROR_FORMAT, err.Format());
        gStartRequested = false;
    }
}

int cmd_devtype_set(const struct shell * shell, size_t argc, char ** argv)
{
    if (argc != 2)
    {
        shell_print(shell, "Usage: devtype set <device-type>");
        return -EINVAL;
    }

    if (chip::app::all_devices::IsServerStarted())
    {
        shell_print(shell, "Server already started. Factory reset is required to change device type.");
        return -EALREADY;
    }

    if (gStartRequested)
    {
        shell_print(shell, "Server start is already scheduled.");
        return -EALREADY;
    }

    const std::string deviceType(argv[1]);
    auto & factory = chip::app::NoHooksDeviceFactory::GetInstance();

    if (!factory.IsValidDevice(deviceType))
    {
        shell_print(shell, "Invalid device type: %s", deviceType.c_str());
        shell_print(shell, "Supported device types:");

        for (const auto & item : factory.SupportedDeviceTypes())
        {
            shell_print(shell, "  %s", item.c_str());
        }

        return -EINVAL;
    }

    gRequestedDeviceType = deviceType;
    gStartRequested      = true;

    CHIP_ERROR err = chip::DeviceLayer::PlatformMgr().ScheduleWork(StartAllDevicesServerWork, 0);
    if (err != CHIP_NO_ERROR)
    {
        gStartRequested = false;
        shell_print(shell, "Failed to schedule server start: %" CHIP_ERROR_FORMAT, err.Format());
        return -EIO;
    }

    shell_print(shell, "Starting device type: %s", deviceType.c_str());

    return 0;
}

SHELL_STATIC_SUBCMD_SET_CREATE(sub_devtype,
                               SHELL_CMD_ARG(set, NULL, "Set device type: devtype set <device-type>", cmd_devtype_set, 2, 0),
                               SHELL_SUBCMD_SET_END);

} // namespace

SHELL_CMD_REGISTER(devtype, &sub_devtype, "All-devices device type commands", NULL);

#endif // CONFIG_CHIP_LIB_SHELL
```
