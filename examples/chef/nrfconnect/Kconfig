## examples/laundry-dryer-app/nxp/zephyr/sample.yaml
```yaml
sample:
  name: Matter
tests:
  sample.matter.laundry_dryer_app_no_factorydata:
    platform_allow:
      - rd_rw612_bga
      - frdm_rw612
    build_only: true
    tags: matter
  sample.matter.laundry_dryer_app_factorydata:
    platform_allow:
      - rd_rw612_bga
      - frdm_rw612
    build_only: true
    tags: matter
    extra_args: FILE_SUFFIX="fdata"
  sample.matter.laundry_dryer_app_no_factorydata_ota_v0:
    platform_allow:
      - rd_rw612_bga
      - frdm_rw612
    build_only: true
    tags: matter
    extra_args:
      - EXTRA_CONF_FILE="prj_ota.conf"
  sample.matter.laundry_dryer_app_no_factorydata_ota_v1:
    platform_allow:
      - rd_rw612_bga
      - frdm_rw612
    build_only: true
    tags: matter
    extra_args:
      - EXTRA_CONF_FILE="prj_ota.conf"
    extra_configs:
      - CONFIG_CHIP_DEVICE_SOFTWARE_VERSION=2
  sample.matter.laundry_dryer_app_factorydata_ota_v0:
    platform_allow:
      - rd_rw612_bga
      - frdm_rw612
    build_only: true
    tags: matter
    extra_args:
      - FILE_SUFFIX="fdata"
      - EXTRA_CONF_FILE="prj_ota.conf"
  sample.matter.laundry_dryer_app_factorydata_ota_v1:
    platform_allow:
      - rd_rw612_bga
      - frdm_rw612
    build_only: true
    tags: matter
    extra_args:
      - FILE_SUFFIX="fdata"
      - EXTRA_CONF_FILE="prj_ota.conf"
    extra_configs:
      - CONFIG_CHIP_DEVICE_SOFTWARE_VERSION=2
  sample.matter.laundry_dryer_app_ethernet_no_factorydata:
    platform_allow:
      - rd_rw612_bga/rw612/ethernet
    build_only: true
    tags: matter
    extra_args: EXTRA_CONF_FILE="prj_ethernet.conf"
  sample.matter.laundry_dryer_app_ethernet_factorydata:
    platform_allow:
      - rd_rw612_bga/rw612/ethernet
    build_only: true
    tags: matter
    extra_args:
    - FILE_SUFFIX="fdata"
    - EXTRA_CONF_FILE="prj_ethernet.conf"
  sample.matter.laundry_dryer_app_ethernet_factorydata_ota_v0:
    platform_allow:
      - rd_rw612_bga/rw612/ethernet
    build_only: true
    tags: matter
    extra_args:
      - FILE_SUFFIX="fdata"
      - EXTRA_CONF_FILE='prj_ota.conf;prj_ethernet.conf'
  sample.matter.laundry_dryer_app_ethernet_factorydata_ota_v1:
    platform_allow:
      - rd_rw612_bga/rw612/ethernet
    build_only: true
    tags: matter
    extra_args:
      - FILE_SUFFIX="fdata"
      - EXTRA_CONF_FILE='prj_ota.conf;prj_ethernet.conf'
    extra_configs:
      - CONFIG_CHIP_DEVICE_SOFTWARE_VERSION=2
```

## examples/light-switch-app/esp32/main/Kconfig.projbuild
```kconfig
#
#    Copyright (c) 2022 Project CHIP Authors
#    All rights reserved.
#
#    Licensed under the Apache License, Version 2.0 (the "License");
#    you may not use this file except in compliance with the License.
#    You may obtain a copy of the License at
#
#        http://www.apache.org/licenses/LICENSE-2.0
#
#    Unless required by applicable law or agreed to in writing, software
#    distributed under the License is distributed on an "AS IS" BASIS,
#    WITHOUT WARRANTIES OR CONDITIONS OF ANY KIND, either express or implied.
#    See the License for the specific language governing permissions and
#    limitations under the License.
#
#    Description:
#      Configuration options CHIP ESP32 demo application.
#

menu "Demo"

    choice
        prompt "Device Type"
        default DEVICE_TYPE_ESP32_DEVKITC if IDF_TARGET_ESP32
        default DEVICE_TYPE_ESP32_C3_DEVKITM if IDF_TARGET_ESP32C3
        default DEVICE_TYPE_ESP32_S3_DEVKITM if IDF_TARGET_ESP32S3
        help
            Specifies the type of ESP32 device.

            Note that the "ESP32-DevKitC" choice is compatible with a number of clone devices
            available from third-party manufacturers.

        config DEVICE_TYPE_ESP32_DEVKITC
            bool "ESP32-DevKitC"
            depends on IDF_TARGET_ESP32
        config DEVICE_TYPE_ESP32_WROVER_KIT
            bool "ESP32-WROVER-KIT_V4.1"
            depends on IDF_TARGET_ESP32
        config DEVICE_TYPE_ESP32_C3_DEVKITM
            bool "ESP32C3-DevKitM"
            depends on IDF_TARGET_ESP32C3
        config DEVICE_TYPE_ESP32_S3_DEVKITM
            bool "ESP32S3-DevKitM"
            depends on IDF_TARGET_ESP32S3
        config DEVICE_TYPE_ESP32H2_DEVKITC
            bool "ESP32H2-DevKitC"
            depends on IDF_TARGET_ESP32H2
    endchoice

    choice
      prompt "Rendezvous Mode"
      default RENDEZVOUS_MODE_BLE
      help
          Specifies the Rendezvous mode of the peripheral.

      config RENDEZVOUS_MODE_WIFI
          bool "Wi-Fi"
      config RENDEZVOUS_MODE_BLE
          bool "BLE"
      config RENDEZVOUS_MODE_THREAD
          bool "Thread"
      config RENDEZVOUS_MODE_ETHERNET
          bool "Ethernet"
    endchoice

    config RENDEZVOUS_MODE
       int
       range 0 8
       default 1 if RENDEZVOUS_MODE_WIFI
       default 2 if RENDEZVOUS_MODE_BLE
       default 4 if RENDEZVOUS_MODE_THREAD
       default 8 if RENDEZVOUS_MODE_ETHERNET
    
    config EXAMPLE_BOARD_BUTTON_GPIO
        int "Boot Button GPIO"
        default 0 if !IDF_TARGET_ESP32C3
        default 9 if IDF_TARGET_ESP32C3
        help
            GPIO number on which the "Boot" button is connected. This is generally used
            by the application for custom operations like toggling states.
endmenu
```

## examples/light-switch-app/esp32/sdkconfig.defaults.esp32c3
```kconfig
CONFIG_IDF_TARGET="esp32c3"
CONFIG_IDF_TARGET_ESP32C3=y
CONFIG_DEVICE_TYPE_ESP32_C3_DEVKITM=y

# Default to 921600 baud when flashing and monitoring device
CONFIG_ESPTOOLPY_BAUD_921600B=y
CONFIG_ESPTOOLPY_BAUD=921600
CONFIG_ESPTOOLPY_COMPRESSED=y
CONFIG_ESPTOOLPY_MONITOR_BAUD_115200B=y
CONFIG_ESPTOOLPY_MONITOR_BAUD=115200

#enable BT
CONFIG_BT_ENABLED=y
CONFIG_BT_NIMBLE_ENABLED=y

#enable lwip ipv6 autoconfig
CONFIG_LWIP_IPV6_AUTOCONFIG=y

# Use a custom partition table
CONFIG_PARTITION_TABLE_CUSTOM=y
CONFIG_PARTITION_TABLE_CUSTOM_FILENAME="partitions.csv"

#enable lwIP route hooks
CONFIG_LWIP_HOOK_IP6_ROUTE_DEFAULT=y
CONFIG_LWIP_HOOK_ND6_GET_GW_DEFAULT=y

# Serial Flasher config
CONFIG_ESPTOOLPY_FLASHSIZE_4MB=y
CONFIG_ESPTOOLPY_FLASHSIZE="4MB"

# Enable HKDF in mbedtls
CONFIG_MBEDTLS_HKDF_C=y

# Move functions from IRAM to flash
CONFIG_FREERTOS_PLACE_FUNCTIONS_INTO_FLASH=y
```

## examples/light-switch-app/esp32/sdkconfig.defaults.esp32c5
```kconfig
CONFIG_IDF_TARGET="esp32c5"

# Reduce flash size
CONFIG_ENABLE_CHIP_SHELL=n
CONFIG_OPENTHREAD_CLI=n
CONFIG_NEWLIB_NANO_FORMAT=y

CONFIG_NIMBLE_MAX_CONNECTIONS=1
CONFIG_BTDM_CTRL_BLE_MAX_CONN=1
CONFIG_BT_NIMBLE_ROLE_CENTRAL=n
CONFIG_BT_NIMBLE_ROLE_OBSERVER=n

CONFIG_EVENT_LOGGING_CRIT_BUFFER_SIZE=1024

CONFIG_LOG_DEFAULT_LEVEL_ERROR=y

CONFIG_COMPILER_OPTIMIZATION_SIZE=y
CONFIG_COMPILER_OPTIMIZATION_ASSERTIONS_SILENT=y
CONFIG_COMPILER_OPTIMIZATION_CHECKS_SILENT=y
CONFIG_ESP_ERR_TO_NAME_LOOKUP=n
```

## examples/light-switch-app/nrfconnect/Kconfig
```kconfig
#
# SPDX-FileCopyrightText: 2022 Project CHIP Authors
#
# SPDX-License-Identifier: Apache-2.0
#
mainmenu "Matter nRF Connect Light Switch Example Application"

config STATE_LEDS
	bool "Use LEDs to indicate the device state"
	default y
	help
	  Use LEDs to render the current state of the device such as the progress of commissioning of
	  the device into a network or the factory reset initiation. Note that setting this option to
	  'n' does not disable the LED indicating the state of the simulated bolt.

# Sample configuration used for Thread networking
if NET_L2_OPENTHREAD

choice OPENTHREAD_NORDIC_LIBRARY_CONFIGURATION
	default OPENTHREAD_NORDIC_LIBRARY_MTD
endchoice

choice OPENTHREAD_DEVICE_TYPE
	default OPENTHREAD_MTD
endchoice

config CHIP_ENABLE_SLEEPY_END_DEVICE_SUPPORT
	bool
	default y

endif # NET_L2_OPENTHREAD

if CHIP_WIFI

config NRF_WIFI_LOW_POWER
	default y

endif # CHIP_WIFI

config CHIP_ICD_SUBSCRIPTION_HANDLING
	default y

rsource "../../../config/nrfconnect/chip-module/Kconfig.features"
rsource "../../../config/nrfconnect/chip-module/Kconfig.defaults"
source "Kconfig.zephyr"
```

## examples/lighting-app/esp32/main/Kconfig.projbuild
```kconfig
#
#    Copyright (c) 2021 Project CHIP Authors
#    All rights reserved.
#
#    Licensed under the Apache License, Version 2.0 (the "License");
#    you may not use this file except in compliance with the License.
#    You may obtain a copy of the License at
#
#        http://www.apache.org/licenses/LICENSE-2.0
#
#    Unless required by applicable law or agreed to in writing, software
#    distributed under the License is distributed on an "AS IS" BASIS,
#    WITHOUT WARRANTIES OR CONDITIONS OF ANY KIND, either express or implied.
#    See the License for the specific language governing permissions and
#    limitations under the License.
#
#    Description:
#      Configuration options CHIP ESP32 demo application.
#

menu "Demo"

    choice
        prompt "Device Type"
        default DEVICE_TYPE_ESP32_DEVKITC if IDF_TARGET_ESP32
        default DEVICE_TYPE_ESP32_C3_DEVKITM if IDF_TARGET_ESP32C3
        default DEVICE_TYPE_ESP32_S3_DEVKITM if IDF_TARGET_ESP32S3
        help
            Specifies the type of ESP32 device.

            Note that the "ESP32-DevKitC" choice is compatible with a number of clone devices
            available from third-party manufacturers.

        config DEVICE_TYPE_ESP32_DEVKITC
            bool "ESP32-DevKitC"
            depends on IDF_TARGET_ESP32
        config DEVICE_TYPE_ESP32_WROVER_KIT
            bool "ESP32-WROVER-KIT_V4.1"
            depends on IDF_TARGET_ESP32
        config DEVICE_TYPE_ESP32_C3_DEVKITM
            bool "ESP32C3-DevKitM"
            depends on IDF_TARGET_ESP32C3
        config DEVICE_TYPE_ESP32_S3_DEVKITM
            bool "ESP32S3-DevKitM"
            depends on IDF_TARGET_ESP32S3
        config DEVICE_TYPE_ESP32H2_DEVKITC
            bool "ESP32H2-DevKitC"
            depends on IDF_TARGET_ESP32H2
    endchoice

    choice LED_TYPE
        prompt "LED type"
        default LED_TYPE_RMT if DEVICE_TYPE_ESP32_C3_DEVKITM || DEVICE_TYPE_ESP32_S3_DEVKITM || DEVICE_TYPE_ESP32H2_DEVKITC
        default LED_TYPE_GPIO
        help
            Defines the default LED type used in the example

        config LED_TYPE_GPIO
            bool "GPIO"
        config LED_TYPE_RMT
            bool "RMT - Addressable LED"
    endchoice

    config LED_RMT_CHANNEL
        depends on LED_TYPE_RMT
        int "RMT Channel"
        range 0 7
        default 0
        help
            Set the RMT peripheral channel.
            ESP32 RMT channel from 0 to 7
            ESP32-S3 RMT channel from 0 to 3
            ESP32-C3 RMT channel from 0 to 1

    config LED_GPIO
        int "LED GPIO number"
        range 0 48
        default 26 if DEVICE_TYPE_ESP32_WROVER_KIT
        default 8 if DEVICE_TYPE_ESP32_C3_DEVKITM || DEVICE_TYPE_ESP32H2_DEVKITC
        default 48 if DEVICE_TYPE_ESP32_S3_DEVKITM
        default 5
        help
            GPIO number (IOxx) to blink on and off or the RMT signal for the addressable LED.

    choice
      prompt "Rendezvous Mode"
      default RENDEZVOUS_MODE_BLE
      help
          Specifies the Rendezvous mode of the peripheral.

      config RENDEZVOUS_MODE_WIFI
          bool "Wi-Fi"
      config RENDEZVOUS_MODE_BLE
          bool "BLE"
      config RENDEZVOUS_MODE_THREAD
          bool "Thread"
      config RENDEZVOUS_MODE_ETHERNET
          bool "Ethernet"
    endchoice

    config RENDEZVOUS_MODE
       int
       range 0 8
       default 1 if RENDEZVOUS_MODE_WIFI
       default 2 if RENDEZVOUS_MODE_BLE
       default 4 if RENDEZVOUS_MODE_THREAD
       default 8 if RENDEZVOUS_MODE_ETHERNET

endmenu
```

## examples/lighting-app/esp32/sdkconfig.defaults.esp32c2
```kconfig
# Disable chip shell
CONFIG_ENABLE_CHIP_SHELL=n

# CONFIG_ESP32_WIFI_IRAM_OPT is not set
# CONFIG_ESP32_WIFI_RX_IRAM_OPT is not set
CONFIG_FREERTOS_PLACE_FUNCTIONS_INTO_FLASH=y
CONFIG_FREERTOS_PLACE_SNAPSHOT_FUNS_INTO_FLASH=y

CONFIG_COMPILER_OPTIMIZATION_ASSERTIONS_DISABLE=y

CONFIG_LWIP_TCPIP_RECVMBOX_SIZE=16
CONFIG_LWIP_TCP_RECVMBOX_SIZE=8

CONFIG_BT_NIMBLE_ROLE_CENTRAL=n
CONFIG_BT_NIMBLE_ROLE_OBSERVER=n

CONFIG_ESP32_WIFI_STATIC_RX_BUFFER_NUM=4
CONFIG_ESP32_WIFI_DYNAMIC_RX_BUFFER_NUM=8
CONFIG_ESP32_WIFI_DYNAMIC_TX_BUFFER_NUM=16
```

## examples/lighting-app/esp32/sdkconfig.defaults.esp32c6_tee
```kconfig
CONFIG_IDF_TARGET="esp32c6"
CONFIG_ESPTOOLPY_FLASHSIZE_8MB=y
CONFIG_PARTITION_TABLE_CUSTOM=y
CONFIG_PARTITION_TABLE_CUSTOM_FILENAME="partitions_tee.csv"

# ESP-TEE
CONFIG_SECURE_ENABLE_TEE=y
CONFIG_MBEDTLS_TEE_SEC_STG_ECDSA_SIGN=y
CONFIG_SECURE_TEE_SEC_STG_MODE_DEVELOPMENT=y

# DAC via TEE secure storage
CONFIG_SEC_CERT_DAC_PROVIDER=y
CONFIG_USE_ESP32_TEE=y
CONFIG_USE_ESP32_TEE_DAC_KEY_FLASH=y
CONFIG_ESP_SECURE_CERT_DS_PERIPHERAL=n

CONFIG_ENABLE_ESP32_FACTORY_DATA_PROVIDER=y
CONFIG_ENABLE_ESP32_DEVICE_INSTANCE_INFO_PROVIDER=y
CONFIG_DEVICE_VENDOR_ID=0xFFF2
CONFIG_DEVICE_PRODUCT_ID=0x8001
CONFIG_CHIP_FACTORY_NAMESPACE_PARTITION_LABEL="fctry"
```

## examples/lighting-app/esp32/sdkconfig.defaults.esp32h2
```kconfig
CONFIG_IDF_TARGET="esp32h2"
CONFIG_IDF_TARGET_ESP32H2_BETA_VERSION_2=y

# Default to 921600 baud when flashing and monitoring device
CONFIG_ESPTOOLPY_BAUD_921600B=y
CONFIG_ESPTOOLPY_BAUD=921600
CONFIG_ESPTOOLPY_COMPRESSED=y
CONFIG_ESPTOOLPY_FLASHMODE_QIO=y
CONFIG_ESPTOOLPY_FLASHFREQ_40M=y
CONFIG_ESPTOOLPY_FLASHFREQ="40m"
CONFIG_ESPTOOLPY_MONITOR_BAUD_115200B=y
CONFIG_ESPTOOLPY_MONITOR_BAUD=115200

# libsodium
CONFIG_LIBSODIUM_USE_MBEDTLS_SHA=y

# Serial Flasher config
CONFIG_ESPTOOLPY_FLASHSIZE_4MB=y
CONFIG_ESPTOOLPY_FLASHSIZE="4MB"

# NIMBLE
CONFIG_BT_ENABLED=y
CONFIG_BT_NIMBLE_ENABLED=y
CONFIG_BT_NIMBLE_EXT_ADV=n
CONFIG_BT_NIMBLE_HCI_EVT_BUF_SIZE=70
CONFIG_USE_BLE_ONLY_FOR_COMMISSIONING=n

# Enable OpenThread
CONFIG_OPENTHREAD_ENABLED=y
CONFIG_OPENTHREAD_SRP_CLIENT=y
CONFIG_OPENTHREAD_LOG_LEVEL_DYNAMIC=n
CONFIG_OPENTHREAD_LOG_LEVEL_NOTE=y
CONFIG_OPENTHREAD_CLI=n
CONFIG_OPENTHREAD_DNS_CLIENT=y

# Disable lwip ipv6 autoconfig
CONFIG_LWIP_IPV6_AUTOCONFIG=n

# Use a custom partition table
CONFIG_PARTITION_TABLE_CUSTOM=y
CONFIG_PARTITION_TABLE_CUSTOM_FILENAME="partitions.csv"

# LwIP config for OpenThread
CONFIG_LWIP_IPV6_NUM_ADDRESSES=8
CONFIG_LWIP_MULTICAST_PING=y

# mbedTLS
CONFIG_MBEDTLS_HARDWARE_AES=n
CONFIG_MBEDTLS_HARDWARE_MPI=n
CONFIG_MBEDTLS_HARDWARE_SHA=n
CONFIG_MBEDTLS_HARDWARE_ECC=y
CONFIG_MBEDTLS_ATCA_HW_ECDSA_SIGN=n
CONFIG_MBEDTLS_ATCA_HW_ECDSA_VERIFY=n
CONFIG_MBEDTLS_CMAC_C=y
CONFIG_MBEDTLS_SSL_PROTO_DTLS=y
CONFIG_MBEDTLS_KEY_EXCHANGE_ECJPAKE=y

# rtc clk for ble
# CONFIG_ESP32H2_RTC_CLK_SRC_EXT_CRYS=y

# MDNS platform
CONFIG_USE_MINIMAL_MDNS=n
CONFIG_ENABLE_EXTENDED_DISCOVERY=y

# FreeRTOS should use legacy API
CONFIG_FREERTOS_ENABLE_BACKWARD_COMPATIBILITY=y

# Disable STA and AP for ESP32H2
CONFIG_ENABLE_WIFI_STATION=n
CONFIG_ENABLE_WIFI_AP=n
# Enable this to avoid implicit declaration of function 'esp_send_assoc_resp'
CONFIG_ESP_WIFI_SOFTAP_SUPPORT=y

# Enable OTA Requestor
CONFIG_ENABLE_OTA_REQUESTOR=y

# Enable chip shell
CONFIG_ENABLE_CHIP_SHELL=y

# Enable HKDF in mbedtls
CONFIG_MBEDTLS_HKDF_C=y
```

## examples/lighting-app/esp32/sdkconfig.defaults.esp32p4
```kconfig
CONFIG_IDF_TARGET="esp32p4"

# Enable BLE Host but use remote controller
CONFIG_BT_NIMBLE_TRANSPORT_UART=n
CONFIG_ESP_ENABLE_BT=y

# Increase main task stack size
CONFIG_ESP_MAIN_TASK_STACK_SIZE=4096

# Do not deinit BLE after commissioning
CONFIG_USE_BLE_ONLY_FOR_COMMISSIONING=n

# ESP32-P4 Function EV Board use ESP32C6 as slave device
CONFIG_SLAVE_IDF_TARGET_ESP32C6=y
```
