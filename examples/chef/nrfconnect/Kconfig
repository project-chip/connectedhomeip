## examples/chef/nrfconnect/Kconfig
```kconfig
#
#    Copyright (c) 2022 Project CHIP Authors
#
#    Licensed under the Apache License, Version 2.0 (the "License");
#    you may not use this file except in compliance with the License.
#    You may obtain a copy of the License at
#
#        http://www.apache.org/licenses/LICENSE-2.0
#
#    Unless required by applicable law or agreed to in writing, software
#    distributed under the License is distributed on an "AS IS" BASIS,
#    WITHOUT WARRANTIES OR CONDITIONS OF ANY KIND, either express or implied.
#    See the License for the specific language governing permissions and
#    limitations under the License.
#
mainmenu "Matter nRF Connect Chef Example Application"

config CHEF_DEVICE_TYPE
	string "Chef app device type"
	default ""
	help
	  Specifies the device type used to generate data model for the chef app. It should be the string literal matching one of the file names located in the chef's devices directory.

rsource "../../../config/nrfconnect/chip-module/Kconfig.defaults"
rsource "../../../config/nrfconnect/chip-module/Kconfig.features"
source "Kconfig.zephyr"
```

## examples/closure-app/nxp/zephyr/boards/rd_rw612_bga_ethernet_fdata.conf
```kconfig
#
#    Copyright (c) 2024 Project CHIP Authors
#
#    Licensed under the Apache License, Version 2.0 (the "License");
#    you may not use this file except in compliance with the License.
#    You may obtain a copy of the License at
#
#        http://www.apache.org/licenses/LICENSE-2.0
#
#    Unless required by applicable law or agreed to in writing, software
#    distributed under the License is distributed on an "AS IS" BASIS,
#    WITHOUT WARRANTIES OR CONDITIONS OF ANY KIND, either express or implied.
#    See the License for the specific language governing permissions and
#    limitations under the License.
#

CONFIG_SETTINGS_NVS_SECTOR_COUNT=16

# 0xA226
CONFIG_CHIP_DEVICE_PRODUCT_ID=41510
CONFIG_CHIP_DEVICE_PRODUCT_URL="https://www.nxp.com/products/wireless-connectivity/wi-fi-plus-bluetooth-plus-802-15-4/wireless-mcu-with-integrated-tri-radio-1x1-wi-fi-6-plus-bluetooth-low-energy-5-3-802-15-4:RW612"
CONFIG_CHIP_DEVICE_PRODUCT_LABEL="RW612"
CONFIG_CHIP_DEVICE_PART_NUMBER="RW612"
```

## examples/contact-sensor-app/bouffalolab/defconfig
```kconfig
CONFIG_BFLB_LOG                              = n
CONFIG_COREDUMP                             ?= n
CONFIG_SHELL                                 = n
CONFIG_VSNPRINTF_NANO                       = n
CONFIG_VSNPRINTF_FLOAT                     = y
CONFIG_VSNPRINTF_FLOAT_EX                  = y
CONFIG_VSNPRINTF_LONG_LONG                 = y

CONFIG_BFLB_MTD                             = y
CONFIG_PARTITION                            = y
CONFIG_LITTLEFS                             = y
CONFIG_FOTA                                 = y

CONFIG_FREERTOS                             = y
CONFIG_NEWLIB                               = n
CONFIG_NEWLIB_STANDARD                      = n
CONFIG_POSIX                                = n
CONFIG_TLSF                                 = y

CONFIG_CONSOLE_UART_BAUDRATE                = 2000000
CONFIG_NO_SHORT_ENUMS                       = y
CONFIG_STDATOMIC                            = y
CONFIG_MM_ENABLE_MIN_FREE_TRACKING          = y
CONFIG_MATTER                               = y

CONFIG_MBEDTLS                             = y
# MBEDTLS_V2: y=v2.28, n/undefined=v3.6.3 (default)
CONFIG_MBEDTLS_V2                          = n
CONFIG_MBEDTLS_AES_USE_HW                  = y
CONFIG_MBEDTLS_BIGNUM_USE_HW               = y
CONFIG_MBEDTLS_ECC_USE_HW                  = y
CONFIG_MBEDTLS_SHA1_USE_HW                 = y
CONFIG_MBEDTLS_SHA256_USE_HW               = y
CONFIG_MBEDTLS_SHA512_USE_HW               = y

# Matter-required mbedTLS v3 features (consumed by SDK config-tls-generic.h).
# v2 path uses bflb/mbedtls_sample_config.h instead, so these are scoped to v3.
ifneq ($(CONFIG_MBEDTLS_V2),y)
  CONFIG_MBEDTLS_CIPHER_CCM_ENABLED        = y
  CONFIG_MBEDTLS_HKDF_C                    = y
  CONFIG_MBEDTLS_X509_CSR_WRITE_C          = y
  CONFIG_MBEDTLS_HMAC_DRBG_ENABLED         = y
  CONFIG_MBEDTLS_CMAC                      = y
  CONFIG_MBEDTLS_ECDSA_DETERMINISTIC       = y

  # Thread-only: openthread commissioning / CoAP-secure
  ifeq ($(CONFIG_THREAD),y)
    CONFIG_MBEDTLS_KEY_EXCHANGE_ECJPAKE_ENABLED = y
    CONFIG_MBEDTLS_ECJPAKE_C               = y
    CONFIG_MBEDTLS_DTLS                    = y
    CONFIG_MBEDTLS_SSL_DTLS_CONNECTION_ID  = y
  endif
endif

ifneq ($(filter y,$(CONFIG_WIFI) $(CONFIG_THREAD)),)
  ifneq ($(CONFIG_ETHERNET),y)
  CONFIG_RF                                = y
  endif
  CONFIG_BLUETOOTH                         = y
  ifeq ($(CHIP),bl616)
    CONFIG_BTBLECONTROLLER_LIB             = ble1m0s1bredr0
  else
    CONFIG_BTBLECONTROLLER_LIB             = m2s1
  endif
  CONFIG_BL_SDK                            = y
  CONFIG_BLE_USE_MAC2                      = n
  CONFIG_BLE_USING_DYNAMIC_RAM             = y
  CONFIG_BT_OAD_SERVER                     = n
  CONFIG_BT_STACK_CLI                      = n
endif

ifeq ($(CONFIG_WIFI),y)
  CONFIG_WIFI6                             = y
  CONFIG_MACSW_SELECT                       = default
  ifeq ($(CONFIG_WL80211),y)
    CONFIG_BL_WPA_SUPPLICANT               = y
    CONFIG_WL80211_WRAM_MEM_SIZE_LIMIT    ?= 0x10000
  else
    CONFIG_FHOST                            = y
    CONFIG_DHCPD                            = y
  endif

  CONFIG_LPAPP =y
  CONFIG_POST_BUILDS_CONCAT_WITH_LP_FW=y
  CONFIG_PM =y
  CONFIG_LWIP_LP =y
  CONFIG_TICKLESS_ACCURATE =y
  CONFIG_PWRMGMT               =y
  CONFIG_TICKLESS_CUSTOMIZE    =y
endif

ifeq ($(CHIP),bl616)
  CONFIG_DCDC_ENABLE                        = n
  CONFIG_CLOCK_SOURCE_EF_PARAM =y
endif

ifeq ($(CHIP),bl616cl)
  CONFIG_CLOCK_SOURCE_EF_PARAM =n
  CONFIG_BL616CL_POWER_SUPPLY_EXT_DCDC_SOC =n
  CONFIG_BL616CL_POWER_SUPPLY_EXT_DCDC_SYS =n
  CONFIG_BL616CL_DCDC_CTRL_USE_STD =y
  CONFIG_BL616CL_DCDC_SOC_CTRL_PIN =0xFF
  CONFIG_BL616CL_DCDC_SOC_ENABLE_PIN =0xFF
  CONFIG_BL616CL_DCDC_SYS_ENABLE_PIN =0xFF
  CONFIG_BL616CL_DCDC_SYS_PDS_ENABLE =0
  CONFIG_BL616CL_LDO_SOC_ACTIVE_LEVEL =HBN_LDO_SOC_LEVEL_0P900V
  CONFIG_BL616CL_LDO_SOC_ENTER_LEVEL =HBN_LDO_SOC_LEVEL_0P900V
  CONFIG_BL616CL_DCDC_SOC_PDS_LEVEL =PM_DCDC_SOC_LEVEL_0P7
  CONFIG_BL616CL_DCDC_SOC_PDS_ENABLE =0
endif

ifneq ($(filter y,$(CONFIG_WIFI) $(CONFIG_ETHERNET)),)
  CONFIG_LWIP                              = y
  CONFIG_PING                              = n
endif

ifeq ($(CONFIG_THREAD),y)
  CONFIG_LMAC154                           = y
  CONFIG_THREAD                            = y
endif
```

## examples/energy-gateway-app/esp32/sdkconfig.defaults.esp32h2
```kconfig
CONFIG_IDF_TARGET="esp32h2"

# Enable OpenThread
CONFIG_OPENTHREAD_ENABLED=y
CONFIG_OPENTHREAD_SRP_CLIENT=y
CONFIG_OPENTHREAD_LOG_LEVEL_DYNAMIC=n
CONFIG_OPENTHREAD_LOG_LEVEL_NOTE=y
CONFIG_OPENTHREAD_CLI=n
CONFIG_OPENTHREAD_DNS_CLIENT=y

# Disable lwip ipv6 autoconfig
CONFIG_LWIP_IPV6_AUTOCONFIG=n

# LwIP config for OpenThread
CONFIG_LWIP_IPV6_NUM_ADDRESSES=8
CONFIG_LWIP_MULTICAST_PING=y

# MDNS platform
CONFIG_USE_MINIMAL_MDNS=n
CONFIG_ENABLE_EXTENDED_DISCOVERY=y

# Disable STA for ESP32H2
CONFIG_ENABLE_WIFI_STATION=n
```

## examples/energy-management-app/esp32/sdkconfig.defaults
```kconfig
#
#    Copyright (c) 2021 Project CHIP Authors
#    All rights reserved.
#
#    Licensed under the Apache License, Version 2.0 (the "License");
#    you may not use this file except in compliance with the License.
#    You may obtain a copy of the License at
#
#        http://www.apache.org/licenses/LICENSE-2.0
#
#    Unless required by applicable law or agreed to in writing, software
#    distributed under the License is distributed on an "AS IS" BASIS,
#    WITHOUT WARRANTIES OR CONDITIONS OF ANY KIND, either express or implied.
#    See the License for the specific language governing permissions and
#    limitations under the License.
#
#    Description:
#      Some useful defaults for the demo app configuration.
#

#enable BT
CONFIG_BT_ENABLED=y
CONFIG_BT_NIMBLE_ENABLED=y

#disable BT connection reattempt
CONFIG_BT_NIMBLE_ENABLE_CONN_REATTEMPT=n

#enable lwip ipv6 autoconfig
CONFIG_LWIP_IPV6_AUTOCONFIG=y

#enable debug shell
CONFIG_ENABLE_CHIP_SHELL=y

# Use a custom partition table
CONFIG_PARTITION_TABLE_CUSTOM=y
CONFIG_PARTITION_TABLE_FILENAME="partitions.csv"

#enable lwIP route hooks
CONFIG_LWIP_HOOK_IP6_ROUTE_DEFAULT=y
CONFIG_LWIP_HOOK_ND6_GET_GW_DEFAULT=y

# Serial Flasher config
CONFIG_ESPTOOLPY_FLASHSIZE_4MB=y
CONFIG_ESPTOOLPY_FLASHSIZE="4MB"

# Disable softap support by default
CONFIG_ESP_WIFI_SOFTAP_SUPPORT=n
# This example uses the older version of RMT driver to work with both
# idf-v4.4.3 and idf-v5.0, so suppressing the warnings by setting below option
CONFIG_RMT_SUPPRESS_DEPRECATE_WARN=y

# Enable HKDF in mbedtls
CONFIG_MBEDTLS_HKDF_C=y

# Disable Read Client
CONFIG_DISABLE_READ_CLIENT=y

# Increase LwIP IPv6 address number
CONFIG_LWIP_IPV6_NUM_ADDRESSES=6

# Enable sntp time sync
CONFIG_ENABLE_SNTP_TIME_SYNC=y

# Enable EVSE device on EP1
CONFIG_CHIP_DEVICE_CONFIG_ENABLE_EVSE=y

# Enable test triggers used by the Device Energy Management tests
CONFIG_CHIP_DEVICE_CONFIG_ENABLE_DEVICE_ENERGY_MANAGEMENT_TRIGGER=y

# Enable test triggers used by the Evse tests
CONFIG_CHIP_DEVICE_CONFIG_ENABLE_ENERGY_EVSE_TRIGGER=y

# Enable test triggers used by the Water Heater Management tests
CONFIG_CHIP_DEVICE_CONFIG_ENABLE_WATER_HEATER_MANAGEMENT_TRIGGER=y

# Enable test triggers used by the Electrical Reporting tests
CONFIG_CHIP_DEVICE_CONFIG_ENABLE_ENERGY_REPORTING_TRIGGER=y

# Ensure kPowerForecastReporting (PFR) is set in the DeviceEnergyManagement::Feature attribute. Note cannot set PFR and SFR.
CONFIG_DEM_SUPPORT_POWER_FORECAST_REPORTING=y

# Enable OTA Requestor
CONFIG_ENABLE_OTA_REQUESTOR=y
```

## examples/evse-app/esp32/main/Kconfig.projbuild
```kconfig
#
#    Copyright (c) 2021-2024 Project CHIP Authors
#    All rights reserved.
#
#    Licensed under the Apache License, Version 2.0 (the "License");
#    you may not use this file except in compliance with the License.
#    You may obtain a copy of the License at
#
#        http://www.apache.org/licenses/LICENSE-2.0
#
#    Unless required by applicable law or agreed to in writing, software
#    distributed under the License is distributed on an "AS IS" BASIS,
#    WITHOUT WARRANTIES OR CONDITIONS OF ANY KIND, either express or implied.
#    See the License for the specific language governing permissions and
#    limitations under the License.
#
#    Description:
#      Configuration options CHIP ESP32 EVSE application.
#

menu "Demo"

    choice
        prompt "Device Type"
        default DEVICE_TYPE_ESP32_DEVKITC if IDF_TARGET_ESP32
        default DEVICE_TYPE_ESP32_C3_DEVKITM if IDF_TARGET_ESP32C3
        default DEVICE_TYPE_ESP32_S3_DEVKITM if IDF_TARGET_ESP32S3
        default DEVICE_TYPE_ESP32_C2_DEVKITM if IDF_TARGET_ESP32C2
        default DEVICE_TYPE_ESP32_C6_DEVKITC if IDF_TARGET_ESP32C6
        default DEVICE_TYPE_ESP32_H2_DEVKITC if IDF_TARGET_ESP32H2
        help
            Specifies the type of ESP32 device.

            Note that the "ESP32-DevKitC" choice is compatible with a number of clone devices
            available from third-party manufacturers.

        config DEVICE_TYPE_ESP32_DEVKITC
            bool "ESP32-DevKitC"
            depends on IDF_TARGET_ESP32
        config DEVICE_TYPE_ESP32_WROVER_KIT
            bool "ESP32-WROVER-KIT_V4.1"
            depends on IDF_TARGET_ESP32
        config DEVICE_TYPE_M5STACK
            bool "M5Stack"
            depends on IDF_TARGET_ESP32
        config DEVICE_TYPE_ESP32_C3_DEVKITM
            bool "ESP32C3-DevKitM"
            depends on IDF_TARGET_ESP32C3
        config DEVICE_TYPE_ESP32_S3_DEVKITM
            bool "ESP32S3-DevKitM"
            depends on IDF_TARGET_ESP32S3
        config DEVICE_TYPE_ESP32H2_DEVKITC
            bool "ESP32H2-DevKitC"
            depends on IDF_TARGET_ESP32H2
        config DEVICE_TYPE_ESP32_C2_DEVKITM
            bool "ESP32C2-DevKitM"
            depends on IDF_TARGET_ESP32C2
        config DEVICE_TYPE_ESP32_C6_DEVKITC
            bool "ESP32C6-DevKitC"
            depends on IDF_TARGET_ESP32C6
    endchoice

    config CHIP_PROJECT_CONFIG
        string "CHIP Project Configuration file"
        default "main/include/CHIPProjectConfig.h"

    choice
      prompt "Rendezvous Mode"
      default RENDEZVOUS_MODE_BLE
      help
          Specifies the Rendezvous mode of the peripheral.

      config RENDEZVOUS_MODE_WIFI
          bool "Wi-Fi"
      config RENDEZVOUS_MODE_BLE
          bool "BLE"
      config RENDEZVOUS_MODE_THREAD
          bool "Thread"
      config RENDEZVOUS_MODE_ETHERNET
          bool "Ethernet"
    endchoice

    config RENDEZVOUS_MODE
       int
       range 0 8
       default 1 if RENDEZVOUS_MODE_WIFI
       default 2 if RENDEZVOUS_MODE_BLE
       default 4 if RENDEZVOUS_MODE_THREAD
       default 8 if RENDEZVOUS_MODE_ETHERNET

endmenu

menu "EVSE App Configuration"

    config CHIP_DEVICE_CONFIG_ENABLE_DEVICE_ENERGY_MANAGEMENT_TRIGGER
        bool "Enable DEM triggers"
        default "n"
        help
            Enable test triggers used by the Device Energy Management tests

    config CHIP_DEVICE_CONFIG_ENABLE_ENERGY_EVSE_TRIGGER
        bool "Enable EVSE triggers"
        default "n"
        help
            Enable test triggers used by the EVSE tests

    config CHIP_DEVICE_CONFIG_ENABLE_ENERGY_REPORTING_TRIGGER
        bool "Enable Electrical Power & Energy Measurement triggers"
        default "n"
        help
            Enable test triggers used by the Energy Reporting (EEM / EPM) tests

    config DEM_SUPPORT_STATE_FORECAST_REPORTING
        bool "State forecast reporting is supported"
        default "n"
        help
            Ensure kStateForecastReporting (SFR) is set in the DeviceEnergyManagement::Feature attribute. Note cannot set SFR and PFR.

    config DEM_SUPPORT_POWER_FORECAST_REPORTING
        bool "Power forecast reporting is supported"
        default "y"
        help
            Ensure kPowerForecastReporting (PFR) is set in the DeviceEnergyManagement::Feature attribute. Note cannot set PFR and SFR.

endmenu
```

## examples/ipv6only-app/esp32/main/Kconfig.projbuild
```kconfig
menu "PW RPC Example Configuration"

    config EXAMPLE_UART_PORT_NUM
        int "UART port number"
        range 0 2 if IDF_TARGET_ESP32
        default 0 if IDF_TARGET_ESP32
        help
            UART communication port number for the example.
            See UART documentation for available port numbers.

    config EXAMPLE_UART_BAUD_RATE
        int "UART communication speed"
        range 1200 115200
        default 115200
        help
            UART communication speed for Modbus example.

    config EXAMPLE_UART_RXD
        int "UART RXD pin number"
        range 0 34 if IDF_TARGET_ESP32
        default 3
        help
            GPIO number for UART RX pin. See UART documentation for more information
            about available pin numbers for UART.

    config EXAMPLE_UART_TXD
        int "UART TXD pin number"
        range 0 34 if IDF_TARGET_ESP32
        default 1
        help
            GPIO number for UART TX pin. See UART documentation for more information
            about available pin numbers for UART.


endmenu
```
