## third_party/nxp/github_sdk/rt/manifest/west.yml
```yaml
# The west manifest file (west.yml) for MCUXpresso SDK delivery.
#
# See the west documentation for more information:
#
# https://docs.zephyrproject.org/latest/guides/west/index.html
manifest:
  projects:
    - name: mcux-sdk
      url: https://github.com/nxp-mcuxpresso/mcux-sdk.git
      revision: MCUX_2.15.000
      path: core
      import:
        name-allowlist:
          - FreeRTOS-Kernel
          - CMSIS_5
          - mcux-sdk-middleware-sdmmc
          - mcux-sdk-middleware-connectivity-framework
          - fatfs
          - mcux-sdk-middleware-edgefast-bluetooth
          - mcux-sdk-middleware-ethermind
          - mbedtls
          - lwip
          - littlefs
          - mcuboot
        path-prefix: repo/sdk-2.15
    - name: mcux-sdk-examples
      url: https://github.com/nxp-mcuxpresso/mcux-sdk-examples.git
      revision: MCUX_2.15.000_RT1170
      path: repo/sdk-2.15/examples
    - name: wifi_nxp
      url: https://github.com/dvagner/wifi_nxp.git
      revision: 867cac1e225306cc39159dc45ad99977ed7500c2
      path: repo/sdk-2.15/middleware/wifi_nxp
```

## third_party/nxp/k32w0_sdk/repo/manifest/west.yml
```yaml
# The west manifest file (west.yml) for MCUXpresso SDK delivery.
#
# See the west documentation for more information:
#
# https://docs.zephyrproject.org/latest/guides/west/index.html
manifest:
    remotes:
        - name: nxpmicro
          url-base: https://github.com/NXPmicro
    defaults:
        remote: nxpmicro
    projects:
        - name: mcux-sdk
          revision: 7219c54f5dbd5a8636242f9f1771ddb70be146c9
          path: core
        - name: amazon-freertos
          url: https://github.com/NXP/amazon-freertos.git
          path: core/rtos/amazon-freertos
          revision: fb74168634e716fb5f0a61714e5c0d1ac6246ba
        - name: mbedtls
          url: https://github.com/nxp-mcuxpresso/mbedtls.git
          path: core/middleware/mbedtls
          revision: 15458495823165de372f62c3dad621a8da6c86e3
        - name: framework
          url: https://github.com/NXP/mcux-sdk-middleware-connectivity-framework.git
          revision: 2ccc3df70ee5b73c451fceee13e6172518412518
          path: core/middleware/wireless/framework
        - name: ble_controller
          url: https://github.com/NXP/mcux-sdk-middleware-bluetooth-controller.git
          revision: 0e4effc707a0d5569160b9335bc2e57c17255f01
          path: core/middleware/wireless/ble_controller
        - name: bluetooth
          url: https://github.com/NXP/mcux-sdk-middleware-bluetooth-host.git
          revision: e5a1b7b9e3b44b49c6c0318edfc3acac74b342d8
          path: core/middleware/wireless/bluetooth
        - name: ieee-802.15.4
          url: https://github.com/NXP/mcux-sdk-middleware-ieee_802.15.4.git
          revision: e8c96197346a7e37ce3a872096a22bf4aee47e3d
          path: core/middleware/wireless/ieee-802.15.4
        - name: examples
          url: https://github.com/nxp-mcuxpresso/mcux-sdk-examples.git
          revision: 6735550f5a41dfb997d4dd3ce6eebfe1f1d41054
          path: core/boards
```
