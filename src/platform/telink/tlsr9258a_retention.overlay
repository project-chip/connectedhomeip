/ {
	/*
	 * There is no way to keep GPIOs
	 * during deep-sleep mode so output GPIOs
	 * and PWM's are useless.
	 */

	aliases {
		/delete-property/ led0;
		/delete-property/ led1;
		/delete-property/ led2;
		/delete-property/ led3;
		/delete-property/ mcuboot-led0;
		/delete-property/ pwm-led0;
		/delete-property/ pwm-0;
	};

	/delete-node/ leds;
	/delete-node/ pwm_leds;
};

&pwm0 {
	status = "disabled";
};
