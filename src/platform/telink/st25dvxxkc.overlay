/*
 * Copyright (c) 2025 - 2026 Telink Semiconductor
 *
 * SPDX-License-Identifier: Apache-2.0
 */

&i2c {
	status = "okay";
	st25dvxxkc: st25dvxxkc@53 {
		compatible = "st,st25dvxxkc";
		status = "okay";
		reg = <0x53>, <0x57>;
	};
};
