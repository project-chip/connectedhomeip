## config/silabs/Kconfig
```kconfig
#
#   Copyright (c) 2021 Project CHIP Authors
#
#   Licensed under the Apache License, Version 2.0 (the "License");
#   you may not use this file except in compliance with the License.
#   You may obtain a copy of the License at
#
#       http://www.apache.org/licenses/LICENSE-2.0
#
#   Unless required by applicable law or agreed to in writing, software
#   distributed under the License is distributed on an "AS IS" BASIS,
#   WITHOUT WARRANTIES OR CONDITIONS OF ANY KIND, either express or implied.
#   See the License for the specific language governing permissions and
#   limitations under the License.
#

rsource "../zephyr/Kconfig"

if CHIP

menu "Silabs Matter Config"

# See config/zephyr/Kconfig for full definition
config CHIP_DEVICE_VENDOR_NAME
	string "Vendor Name"
	default "Silicon Laboratories"

# See config/zephyr/Kconfig for full definition
config CHIP_OTA_REQUESTOR
	bool "Enable OTA Requestor"
	default n
	imply BOOTLOADER_MCUBOOT
	imply IMG_MANAGER
	imply STREAM_FLASH
	imply STREAM_FLASH_ERASE

config CHIP_OTA_IMAGE_BUILD
	bool
	default y if CHIP_OTA_REQUESTOR
	depends on SIGN_IMAGES

# Sign the application with the MCUboot ECDSA-P256 development key. Only relevant
# for MCUboot/OTA builds; replace with a private key for production.
config MCUBOOT_SIGNATURE_KEY_FILE
	default "bootloader/mcuboot/root-ec-p256.pem"
	depends on BOOTLOADER_MCUBOOT

config CHIP_TASK_STACK_SIZE
	int "The Matter thread stack size"
	default 10240
	help
	  Configures the stack size available for the CHIP (Matter) thread.

config CHIP_FACTORY_DATA
	bool "Use provisioned factory data from Zephyr settings"
	default n
	help
	  Enables Provision::Storage (ProvisionStorageZephyr) that reads
	  provisioned credentials and commissionable data from Zephyr settings
	  stored in the storage partition. Factory data is expected to be
	  provisioned into NVS separately using Silicon Labs generator
	  firmware.

config CHIP_FACTORY_DATA_ROTATING_DEVICE_UID_MAX_LEN
	int "Maximum length of rotating device ID unique ID in bytes"
	default 16
	depends on CHIP_FACTORY_DATA
	help
	  Maximum acceptable length of rotating device ID unique ID in bytes.

config CHIP_FACTORY_RESET_ERASE_SETTINGS
	default n
	depends on NVS || ZMS
	help
		Enables storage partition wipe on factory reset. Enabling also wipes 
		provisioned data. Disabling only resets relevant entries.

config CHIP_OPENTHREAD_JOINER_ENABLED
	bool "Specify whether the Thread Joiner functionality is used when it is enabled"
	default n
	depends on NET_L2_OPENTHREAD
	depends on OPENTHREAD_JOINER
	help
	  If disabled, it allows to optimize memory usage even if Thread Joiner
	  support is enabled.

config CHIP_PERSISTENT_SUBSCRIPTIONS
	default n
	# selecting experimental for this feature since there is an issue with multiple controllers.
	select EXPERIMENTAL

# See config/common/cmake/Kconfig for full definition
config CHIP_WIFI
	default y
	depends on WIFI
	imply NET_STATISTICS
	imply NET_PKT_TXTIME
	imply NET_PKT_TIMESTAMP
	imply BUILD_OUTPUT_META
	imply NET_IPV6_ND # enable Neighbor Discovery to handle Router Advertisements
	imply NET_IPV6_NBR_CACHE
	imply NET_STATISTICS_IPV6
	imply NET_STATISTICS_USER_API

config CHIP_ENABLE_WIFI_STATION
	depends on CHIP_WIFI
	default y

config CHIP_MEMORY_PROFILING
	bool "Enable features for tracking memory usage"
	# Matter stack
	select CHIP_STATISTICS
	# Heap
	select CHIP_MALLOC_SYS_HEAP_WATERMARKS_SUPPORT if CHIP_MALLOC_SYS_HEAP
	select SYS_HEAP_RUNTIME_STATS if CHIP_MALLOC_SYS_HEAP
	# Crypto
	select MBEDTLS_MEMORY_DEBUG if !CHIP_CRYPTO_IMPL_PSA
	# Network
	select NET_STATISTICS
	select NET_SHELL
	select NET_BUF_POOL_USAGE
	select OPENTHREAD_SHELL if !CHIP_WIFI
	# Settings
	select SETTINGS_SHELL
	# Zephyr
	select KERNEL_SHELL
	help
	  Enables features for tracking memory usage in Matter.

# ==============================================================================
# System configuration
# ==============================================================================

choice LIBC_IMPLEMENTATION
	default NEWLIB_LIBC
endchoice

config ASSERT
	default y

config ASSERT_NO_COND_INFO
	default y

config ASSERT_NO_MSG_INFO
	default y

config HW_STACK_PROTECTION
	default y

config MAIN_STACK_SIZE
	int
	default 6144

config INIT_STACKS
	default y

config SYSTEM_WORKQUEUE_STACK_SIZE
	default 2560 if CHIP_WIFI
	default 2048 if CHIP_ICD_LIT_SUPPORT

config NVS_LOOKUP_CACHE_SIZE
	default 512 if NVS

config ZMS_LOOKUP_CACHE_SIZE
	default 512 if ZMS

# ==============================================================================
# Zephyr networking configuration
# ==============================================================================

config NET_IPV6_MLD
	default y

config NET_IPV6_NBR_CACHE
	default y if CHIP_WIFI
	default n if NET_L2_OPENTHREAD

config NET_IF_UNICAST_IPV6_ADDR_COUNT
	default 6

config NET_IF_MCAST_IPV6_ADDR_COUNT
	default 14

config NET_IF_IPV6_PREFIX_COUNT
	default NET_IF_UNICAST_IPV6_ADDR_COUNT if CHIP_WIFI

config NET_PKT_RX_COUNT
	default 8

config NET_PKT_TX_COUNT
	default 8

config NET_BUF_RX_COUNT
	default 16

config NET_BUF_TX_COUNT
	default 16

config NET_SOCKETS_POLL_MAX
	default 6 if CHIP_WIFI

# ==============================================================================
# Bluetooth Low Energy configuration
# ==============================================================================

config BT
	default y

config BT_PERIPHERAL
	default y

config BT_PERIPHERAL_PREF_MIN_INT
	default 36

config BT_PERIPHERAL_PREF_MAX_INT
	default 36

# Increase BT timeout to 5 s to improve connection reliability and avoid fast drop outs.
config BT_PERIPHERAL_PREF_TIMEOUT
	default 500

config BT_GAP_AUTO_UPDATE_CONN_PARAMS
	default y

# Decrease connection parameters update time, as some Matter controllers request
# enabling IP networking faster than BT connection parameters are updated, what may result
# in commissioning instabilities.
config BT_CONN_PARAM_UPDATE_TIMEOUT
	default 1000

config BT_GATT_DYNAMIC_DB
	default y

config BT_DEVICE_NAME_DYNAMIC
	default y

config BT_DEVICE_NAME_MAX
	default 17

config BT_MAX_CONN
	default 1

config BT_L2CAP_TX_MTU
	default 247

config BT_BUF_ACL_RX_SIZE
	default 251

config BT_BUF_ACL_TX_SIZE
	default 251

config BT_RX_STACK_SIZE
	default 1200

config BT_DEVICE_NAME_GATT_WRITABLE
	default n

config BT_GATT_CACHING
	default n

# ==============================================================================
# DFU configuration
# ==============================================================================
config BOOT_IMAGE_ACCESS_HOOKS
	default n

config UPDATEABLE_IMAGE_NUMBER
	default 1

config DFU_MULTI_IMAGE_MAX_IMAGE_COUNT
	int "Maximum number of images for multi-image DFU"
	default 1

# ==============================================================================
# OpenThread configuration
# ==============================================================================

config NET_L2_OPENTHREAD
	default y if !CHIP_WIFI

if NET_L2_OPENTHREAD

config OPENTHREAD_THREAD_STACK_SIZE
	default 6144 if (PSA_CRYPTO_DRIVER_CC3XX && PSA_CRYPTO_DRIVER_OBERON) || PSA_CRYPTO_DRIVER_CRACEN
	default 4096

config OPENTHREAD_DEFAULT_TX_POWER
	default 20 if MPSL_FEM

endif # NET_L2_OPENTHREAD

# ==============================================================================
# Crypto configuration
# ==============================================================================

menu "Crypto configuration"

choice CHIP_CRYPTO_IMPL
	prompt "Crypto implementation"
	default CHIP_CRYPTO_IMPL_PSA

config CHIP_CRYPTO_IMPL_MBEDTLS
	bool "mbedtls"

config CHIP_CRYPTO_IMPL_PSA
	bool "psa"

endchoice

config CHIP_CRYPTO
	string
	default "mbedtls" if CHIP_CRYPTO_IMPL_MBEDTLS
	default "psa" if CHIP_CRYPTO_IMPL_PSA
	help
	  Configures the cryptographic implementation between PSA or mbedTLS.

config MBEDTLS_ENABLE_HEAP
	bool "Enable MbedTLS heap"
	default y

config MBEDTLS_HEAP_SIZE
	int "MbedTLS heap size"
	default 8192

config MBEDTLS_ECP_C
	bool
	default y

config MBEDTLS_ECP_DP_SECP256R1_ENABLED
	bool
	default y

config MBEDTLS_HMAC_DRBG_ENABLED
	bool
	default y
config MBEDTLS_PKCS1_V15
	bool
	default y


if CHIP_CRYPTO_IMPL_PSA

config PSA_WANT_ALG_SPAKE2P_MATTER
	bool
	default y
config PSA_WANT_KEY_TYPE_AES
	bool
	default y
config PSA_WANT_ALG_CCM
	bool
	default y
config PSA_WANT_ALG_CMAC
	bool
	default y
config PSA_WANT_ALG_SHA_224
	bool
	default y
config PSA_WANT_ALG_SHA_256
	bool
	default y
config PSA_WANT_ALG_ECB_NO_PADDING
	bool
	default y
config PSA_WANT_KEY_TYPE_ECC_KEY_PAIR
	bool
	default y
config PSA_WANT_KEY_TYPE_ECC_PUBLIC_KEY
	bool
	default y
config PSA_WANT_ECC_SECP_R1_256
	bool
	default y
config PSA_WANT_KEY_TYPE_ECC_KEY_PAIR_BASIC
	bool
	default y
config PSA_WANT_KEY_TYPE_ECC_KEY_PAIR_IMPORT
	bool
	default y
config PSA_WANT_KEY_TYPE_ECC_KEY_PAIR_EXPORT
	bool
	default y
config PSA_WANT_KEY_TYPE_ECC_KEY_PAIR_GENERATE
	bool
	default y
config PSA_WANT_ALG_PBKDF2_AES_CMAC_PRF_128
	bool
	default y
config PSA_WANT_ALG_ECDH
	bool
	default y
config PSA_WANT_ALG_ECDSA
	bool
	default y
config PSA_WANT_ALG_HKDF
	bool
	default y
config PSA_WANT_ALG_HMAC
	bool
	default y
config PSA_WANT_KEY_TYPE_HMAC
	bool
	default y
config PSA_WANT_ALG_JPAKE
	bool
	default y
config MBEDTLS_PSA_CRYPTO_C
	bool
	default y
config MBEDTLS_KEY_EXCHANGE_RSA_ENABLED
	bool
	default n
config MBEDTLS_KEY_EXCHANGE_RSA_PSK_ENABLED
	bool
	default n
config MBEDTLS_RSA_C
	bool
	default n
config MBEDTLS_CMAC
	bool
	default y
config MBEDTLS_USE_PSA_CRYPTO
	bool
	default y
# Extend the maximum number of PSA key slots to fit Matter requirements
config MBEDTLS_PSA_KEY_SLOT_COUNT
	default 64

endif # CHIP_CRYPTO_IMPL_PSA


if CHIP_CRYPTO_IMPL_MBEDTLS

config MBEDTLS_X509_REMOVE_INFO
	bool
	default y
config MBEDTLS_X509_CSR_WRITE_C
	bool
	default y
config MBEDTLS_X509_CRT_WRITE_C
	bool
	default y
config MBEDTLS_X509_CRL_PARSE_C
	bool
	default y
config MBEDTLS_X509_CSR_PARSE_C
	bool
	default y
config MBEDTLS_PKCS5_C
	bool
	default y
config MBEDTLS_PK_WRITE_C
	bool
	default y
config MBEDTLS_PK_HAVE_ECC_KEYS
	bool "Enable PK Have ECC Keys"
	default y

endif # CHIP_CRYPTO_IMPL_MBEDTLS

config MBEDTLS_ENTROPY_C
	bool
	default y

config MBEDTLS_ECDH_C
	bool "Enable ECDH"
	default y

config MBEDTLS_HKDF_C
	bool "Enable HKDF"
	default y

config MBEDTLS_ECDSA_C
	bool "Enable ECDSA support in MbedTLS"
	default y

config SECURE_STORAGE
	bool "Enable secure storage"
	default y

config MBEDTLS_ECP_NIST_OPTIM
	bool "Enable ECP NIST Optim"
	default y

config MBEDTLS_HAVE_ASM
	bool "Enable ASM"
	default y

config MBEDTLS_CIPHER_CCM_ENABLED
	bool
	default y

config MBEDTLS_CIPHER_AES_128_CCM
	bool "Enable AES-128-CCM cipher support in MbedTLS"
	default y

config MBEDTLS_SSL_OUT_CONTENT_LEN
	int "Maximum content length for MbedTLS SSL output"
	default 1560

config MBEDTLS_AES_ONLY_128_BIT_KEY_LENGTH
	bool "Restrict AES to 128-bit key length in MbedTLS"
	default y

if BOARD_SIWX917_RB4338A

config MBEDTLS_AES_ROM_TABLES
	bool
	default y

config MBEDTLS_AES_FEWER_TABLES
	bool
	default n

endif # BOARD_SIWX917_RB4338A

endmenu

menu "Silabs Demo Interface"

config SILABS_LOW_POWER
	bool "Optimize power usage"
	default n

config SILABS_LED_SUPPORT
	bool "Enable LED support"
	default n if SILABS_LOW_POWER
	default y
config BUTTONS_SUPPORT
	bool "Enable Buttons support"
	default y

config ENABLE_SILABS_LCD
	bool "Enable LCD Support"
	default n if SILABS_LOW_POWER
	default y

endmenu

endmenu

endif # CHIP
```
