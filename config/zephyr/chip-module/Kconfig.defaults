## examples/camera-app/esp32/sdkconfig.defaults
```kconfig
#
#    Copyright (c) 2021 Project CHIP Authors
#    All rights reserved.
#
#    Licensed under the Apache License, Version 2.0 (the "License");
#    you may not use this file except in compliance with the License.
#    You may obtain a copy of the License at
#
#        http://www.apache.org/licenses/LICENSE-2.0
#
#    Unless required by applicable law or agreed to in writing, software
#    distributed under the License is distributed on an "AS IS" BASIS,
#    WITHOUT WARRANTIES OR CONDITIONS OF ANY KIND, either express or implied.
#    See the License for the specific language governing permissions and
#    limitations under the License.
#
#    Description:
#      Some useful defaults for the demo app configuration.
#

CONFIG_ESPTOOLPY_FLASHSIZE_4MB=y

#enable BT
CONFIG_BT_ENABLED=y
CONFIG_BT_NIMBLE_ENABLED=y

#disable BT connection reattempt
CONFIG_BT_NIMBLE_ENABLE_CONN_REATTEMPT=n

#enable lwip ipv6 autoconfig
CONFIG_LWIP_IPV6_AUTOCONFIG=y

# Use a custom partition table
CONFIG_PARTITION_TABLE_CUSTOM=y
CONFIG_PARTITION_TABLE_FILENAME="partitions.csv"
CONFIG_PARTITION_TABLE_OFFSET=0xC000

# Enable chip shell
CONFIG_ENABLE_CHIP_SHELL=y

CONFIG_ENABLE_WIFI_AP=n

# Enable sntp time sync
CONFIG_ENABLE_SNTP_TIME_SYNC=y

#enable lwIP route hooks
CONFIG_LWIP_HOOK_IP6_ROUTE_DEFAULT=y
CONFIG_LWIP_HOOK_ND6_GET_GW_DEFAULT=y

# Button
CONFIG_BUTTON_PERIOD_TIME_MS=20
CONFIG_BUTTON_LONG_PRESS_TIME_MS=5000

# disable softap by default
CONFIG_ESP_WIFI_SOFTAP_SUPPORT=n

# Enable OTA Requestor
CONFIG_ENABLE_OTA_REQUESTOR=y

# Enable HKDF in mbedtls
CONFIG_MBEDTLS_HKDF_C=y

# Increase LwIP IPv6 address number to 6 (MAX_FABRIC + 1)
# unique local addresses for fabrics(MAX_FABRIC), a link local address(1)
CONFIG_LWIP_IPV6_NUM_ADDRESSES=6


#Singnling Specific config

# Signalling only defaults to C6
CONFIG_IDF_TARGET="esp32c6"
CONFIG_IDF_TARGET_ESP32C6=y

#
# Serial flasher config
#
CONFIG_ESPTOOLPY_FLASHMODE_QIO=y
CONFIG_ESPTOOLPY_FLASHFREQ_80M=y
CONFIG_ESPTOOLPY_FLASHSIZE_4MB=y


#
# Example Configuration
#
CONFIG_ESP_WIFI_SSID="myssid"
CONFIG_ESP_WIFI_PASSWORD="mypassword"
CONFIG_ESP_MAXIMUM_RETRY=5
CONFIG_EXAMPLE_SDMMC_BUS_WIDTH_1=y
CONFIG_EXAMPLE_PIN_CMD=35
CONFIG_EXAMPLE_PIN_CLK=36
CONFIG_EXAMPLE_PIN_D0=37

#
# ESP32-Specific
#
CONFIG_ESP32_DEFAULT_CPU_FREQ_240=y
CONFIG_ESP32_DEFAULT_CPU_FREQ_MHZ=240

#
# SPI RAM config
#
CONFIG_SPIRAM=y
CONFIG_SPIRAM_SUPPORT=y
CONFIG_ESP32_SPIRAM_SUPPORT=y
CONFIG_WIFI_LWIP_ALLOCATION_FROM_SPIRAM_FIRST=y

CONFIG_SPIRAM_USE_MALLOC=y
CONFIG_SPIRAM_MALLOC_ALWAYSINTERNAL=0
CONFIG_SPIRAM_TRY_ALLOCATE_WIFI_LWIP=y
CONFIG_SPIRAM_MALLOC_RESERVE_INTERNAL=32768
CONFIG_SPIRAM_ALLOW_BSS_SEG_EXTERNAL_MEMORY=y
CONFIG_SPIRAM_BANKSWITCH_ENABLE=y
CONFIG_SPIRAM_BANKSWITCH_RESERVE=8
CONFIG_SPIRAM_ALLOW_STACK_EXTERNAL_MEMORY=y
CONFIG_SPIRAM_SPEED_80M=y

# 1. The SPIRAM test is only needed for custom SPIRAM
# 2. Needed only in development phase
# Disabling this save us around 1 seconds at startup
CONFIG_SPIRAM_MEMTEST=n

CONFIG_ESP32_WIFI_STATIC_TX_BUFFER=y
CONFIG_ESP32_WIFI_TX_BUFFER_TYPE=0
CONFIG_ESP32_WIFI_STATIC_TX_BUFFER_NUM=16

CONFIG_FATFS_LFN_HEAP=y
CONFIG_FATFS_MAX_LFN=255
CONFIG_FATFS_API_ENCODING_ANSI_OEM=y
CONFIG_FATFS_FS_LOCK=10

CONFIG_FATFS_ALLOC_PREFER_EXTRAM=y

CONFIG_LOG_DEFAULT_LEVEL=3
CONFIG_LOG_COLORS=y
#
# SNTP
#
CONFIG_LWIP_SNTP_MAX_SERVERS=3

#CONFIG_LWIP_SO_LINGER=y
#CONFIG_LWIP_SO_RCVBUF=y
#CONFIG_LWIP_NETBUF_RECVINFO=y
#CONFIG_LWIP_IP_FRAG=y
#CONFIG_LWIP_STATS=y

#CONFIG_LWIP_MULTICAST_PING=y
#CONFIG_LWIP_BROADCAST_PING=y

CONFIG_LWIP_DHCP_MAX_NTP_SERVERS=1

CONFIG_MBEDTLS_EXTERNAL_MEM_ALLOC=y

CONFIG_MBEDTLS_DEBUG=y
CONFIG_MBEDTLS_DEBUG_LEVEL_WARN=y
CONFIG_MBEDTLS_DEBUG_LEVEL=1

#CONFIG_SEMIHOSTFS_MAX_MOUNT_POINTS=1
#CONFIG_SEMIHOSTFS_HOST_PATH_MAX_LEN=128

CONFIG_MBEDTLS_SSL_PROTO_DTLS=y
CONFIG_MBEDTLS_SSL_ALPN=y

#
# ESP Ringbuf
#
#CONFIG_RINGBUF_PLACE_FUNCTIONS_INTO_FLASH=y
#CONFIG_RINGBUF_PLACE_ISR_FUNCTIONS_INTO_FLASH=y

#
# FreeRTOS
#
CONFIG_FREERTOS_PLACE_SNAPSHOT_FUNS_INTO_FLASH=y

#
# ESP System Settings
#
CONFIG_ESP_SYSTEM_ALLOW_RTC_FAST_MEM_AS_HEAP=y

#
# PThreads
#
CONFIG_PTHREAD_TASK_STACK_SIZE_DEFAULT=4096
CONFIG_PTHREAD_STACK_MIN=4096


CONFIG_MAIN_TASK_STACK_SIZE=12000
CONFIG_IPC_TASK_STACK_SIZE=1024
CONFIG_TIMER_TASK_STACK_SIZE=3584

CONFIG_MB_SERIAL_TASK_STACK_SIZE=2048
CONFIG_SUPPORT_STATIC_ALLOCATION=y

#
# Wi-Fi
#
# CONFIG_ESP32_WIFI_STATIC_RX_BUFFER_NUM=16
CONFIG_ESP32_WIFI_IRAM_OPT=n
CONFIG_ESP32_WIFI_RX_IRAM_OPT=n

CONFIG_ESP_SYSTEM_EVENT_TASK_STACK_SIZE=4000
CONFIG_DIAG_USE_EXTERNAL_LOG_WRAP=y

#
# TCP
#
CONFIG_ENABLE_TCP_TRANSPORT=y
CONFIG_MAX_LARGE_BUFFER_SIZE_BYTES=8192
```

## examples/camera-app/esp32/sdkconfig.defaults.esp32c5
```kconfig
CONFIG_IDF_TARGET="esp32c6"

#Singnling Specific config

# Slave
CONFIG_SLAVE_LWIP_ENABLED=y
CONFIG_LWIP_TCP_LOCAL_PORT_RANGE_START=61440
CONFIG_LWIP_TCP_LOCAL_PORT_RANGE_END=65535
CONFIG_LWIP_UDP_LOCAL_PORT_RANGE_START=61440
CONFIG_LWIP_UDP_LOCAL_PORT_RANGE_END=65535
CONFIG_ESP_DEFAULT_LWIP_SLAVE=y

CONFIG_FREERTOS_USE_TRACE_FACILITY=y
CONFIG_FREERTOS_USE_STATS_FORMATTING_FUNCTIONS=y
# CONFIG_FREERTOS_USE_LIST_DATA_INTEGRITY_CHECK_BYTES is not set
CONFIG_FREERTOS_VTASKLIST_INCLUDE_COREID=y
CONFIG_FREERTOS_GENERATE_RUN_TIME_STATS=y

# 4K is sufficient for signalling_only
CONFIG_MAIN_TASK_STACK_SIZE=4000

# Maximum allowed by LwIP (UINT16_MAX = 65535)
CONFIG_MAX_LARGE_BUFFER_SIZE_BYTES=65535
CONFIG_LWIP_TCP_SND_BUF_DEFAULT=65535

# OS
CONFIG_FREERTOS_HZ=1000

CONFIG_FREERTOS_PLACE_FUNCTIONS_INTO_FLASH=y
CONFIG_ESP_WIFI_EXTRA_IRAM_OPT=n
CONFIG_LWIP_TCPIP_RECVMBOX_SIZE=24
CONFIG_LWIP_TCP_OVERSIZE_QUARTER_MSS=y
CONFIG_LWIP_TCP_ACCEPTMBOX_SIZE=4

CONFIG_ESP_WEBRTC_BRIDGE_HOSTED=y

# DANGER: Do not touch me!!!
# CONFIG_HOSTED_ON_LOW_MEM=y
CONFIG_ESP_CACHE_MALLOC=y
CONFIG_ESP_PKT_STATS=y

# Wifi config
#----------------
CONFIG_WIFI_CMD_BASIC_ONLY=y

CONFIG_ESP_WIFI_STATIC_RX_BUFFER_NUM=10
CONFIG_ESP_WIFI_DYNAMIC_RX_BUFFER_NUM=32
CONFIG_ESP_WIFI_DYNAMIC_TX_BUFFER_NUM=32
CONFIG_ESP_WIFI_AMPDU_TX_ENABLED=y
CONFIG_ESP_WIFI_TX_BA_WIN=6
CONFIG_ESP_WIFI_AMPDU_RX_ENABLED=y
CONFIG_ESP_WIFI_RX_BA_WIN=6

CONFIG_ESP_WIFI_RX_IRAM_OPT=n
CONFIG_ESP_WIFI_IRAM_OPT=n
CONFIG_ESP_WIFI_EXTRA_IRAM_OPT=n
CONFIG_ESP_WIFI_SLP_IRAM_OPT=n


# Mem optimizations
#---------------------
CONFIG_FREERTOS_PLACE_FUNCTIONS_INTO_FLASH=y

# 14. SPIRAM config
CONFIG_SPIRAM=y
CONFIG_SPIRAM_MODE_QUAD=y
CONFIG_SPIRAM_SPEED_80M=y
CONFIG_SPIRAM_MALLOC_ALWAYSINTERNAL=2000
CONFIG_SPIRAM_TRY_ALLOCATE_WIFI_LWIP=y
CONFIG_SPIRAM_MALLOC_RESERVE_INTERNAL=32768
CONFIG_SPIRAM_ALLOW_BSS_SEG_EXTERNAL_MEMORY=y
CONFIG_SPIRAM_ALLOW_NOINIT_SEG_EXTERNAL_MEMORY=y

#
# ESP-Hosted - Network coprocessor
#
#CONFIG_SLAVE_LWIP_ENABLED=y
CONFIG_ESP_HOSTED_NETWORK_SPLIT_ENABLED=y
CONFIG_ESP_SDIO_RX_Q_SIZE=10
CONFIG_ESP_SDIO_TX_Q_SIZE=10

# Disable ESP-Hosted coprocessor app_main (we provide our own)
CONFIG_ESP_HOSTED_COPROCESSOR_APP_MAIN=n

# Create wifi sta in example, instead of internal slave code base
CONFIG_ESP_HOSTED_REUSE_WIFI_STA_DEF_NETIF_INSTANCE=y
CONFIG_ESP_HOSTED_COPROCESSOR_BT_ENABLED=n

# Hosted - Re-use CLI instance
CONFIG_ESP_HOSTED_CLI_NEW_INSTANCE=n

# Hosted : Host deep sleep & wake up
CONFIG_ESP_SDIO_STREAMING_MODE=n
CONFIG_ESP_HOSTED_HOST_POWER_SAVE_ENABLED=y
CONFIG_ESP_HOSTED_HOST_DEEP_SLEEP_ALLOWED=y
CONFIG_ESP_HOSTED_UNLOAD_BUS_DRIVER_DURING_HOST_SLEEP=y
CONFIG_ESP_HOSTED_HOST_WAKEUP_GPIO=3

## Hosted - Light sleep on Deep sleep
#CONFIG_PM_ENABLE=y
## Enable peripheral powerdown for maximum power saving during light sleep
## This requires proper IRAM placement for ISR handlers - matches rmaker_split_camera
#CONFIG_PM_POWER_DOWN_PERIPHERAL_IN_LIGHT_SLEEP=y
#CONFIG_FREERTOS_USE_TICKLESS_IDLE=y
#CONFIG_BT_LE_SLEEP_ENABLE=y
#CONFIG_ESP_HOSTED_LIGHT_SLEEP_ENABLE=y
#CONFIG_ESP_HOSTED_LIGHT_SLEEP_MIN_FREQ_MHZ=10
#CONFIG_ESP_HOSTED_LIGHT_SLEEP_PERIPHERAL_POWERDOWN=y
#CONFIG_ESP_PHY_MAC_BB_PD=y
#CONFIG_FREERTOS_USE_TRACE_FACILITY=y

CONFIG_ESP_HOST_DEV_BOARD_P4_C5_CORE=y
```

## examples/camera-app/esp32/sdkconfig.defaults.esp32c6
```kconfig
CONFIG_IDF_TARGET="esp32c6"

#Singnling Specific config

# Slave
CONFIG_SLAVE_LWIP_ENABLED=y
CONFIG_LWIP_TCP_LOCAL_PORT_RANGE_START=61440
CONFIG_LWIP_TCP_LOCAL_PORT_RANGE_END=65535
CONFIG_LWIP_UDP_LOCAL_PORT_RANGE_START=61440
CONFIG_LWIP_UDP_LOCAL_PORT_RANGE_END=65535
CONFIG_ESP_DEFAULT_LWIP_SLAVE=y

CONFIG_FREERTOS_USE_TRACE_FACILITY=y
CONFIG_FREERTOS_USE_STATS_FORMATTING_FUNCTIONS=y
# CONFIG_FREERTOS_USE_LIST_DATA_INTEGRITY_CHECK_BYTES is not set
CONFIG_FREERTOS_VTASKLIST_INCLUDE_COREID=y
CONFIG_FREERTOS_GENERATE_RUN_TIME_STATS=y

# 4K is sufficient for signalling_only
CONFIG_MAIN_TASK_STACK_SIZE=4000

# OS
CONFIG_FREERTOS_HZ=1000

CONFIG_FREERTOS_PLACE_FUNCTIONS_INTO_FLASH=y
CONFIG_ESP_WIFI_EXTRA_IRAM_OPT=n
CONFIG_LWIP_TCPIP_RECVMBOX_SIZE=24
CONFIG_LWIP_TCP_OVERSIZE_QUARTER_MSS=y
CONFIG_LWIP_TCP_ACCEPTMBOX_SIZE=4

CONFIG_ESP_WEBRTC_BRIDGE_HOSTED=y

# DANGER: Do not touch me!!!
# CONFIG_HOSTED_ON_LOW_MEM=y
CONFIG_ESP_CACHE_MALLOC=y
CONFIG_ESP_PKT_STATS=y

#
# ESP-Hosted - Network coprocessor
#
CONFIG_SLAVE_LWIP_ENABLED=y
CONFIG_ESP_HOSTED_NETWORK_SPLIT_ENABLED=y
CONFIG_ESP_SDIO_RX_Q_SIZE=10
CONFIG_ESP_SDIO_TX_Q_SIZE=10

# Disable ESP-Hosted coprocessor app_main (we provide our own)
CONFIG_ESP_HOSTED_COPROCESSOR_APP_MAIN=n

# Create wifi sta in example, instead of internal slave code base
CONFIG_ESP_HOSTED_REUSE_WIFI_STA_DEF_NETIF_INSTANCE=y
CONFIG_ESP_HOSTED_COPROCESSOR_BT_ENABLED=n

# Hosted - Re-use CLI instance
CONFIG_ESP_HOSTED_CLI_NEW_INSTANCE=n

# Hosted : Host deep sleep & wake up
CONFIG_ESP_SDIO_STREAMING_MODE=n
CONFIG_ESP_HOSTED_HOST_POWER_SAVE_ENABLED=y
CONFIG_ESP_HOSTED_HOST_DEEP_SLEEP_ALLOWED=y
CONFIG_ESP_HOSTED_UNLOAD_BUS_DRIVER_DURING_HOST_SLEEP=y
CONFIG_ESP_HOSTED_HOST_WAKEUP_GPIO=2

# Hosted - Light sleep on Deep sleep
CONFIG_PM_ENABLE=y
# Enable peripheral powerdown for maximum power saving during light sleep
# This requires proper IRAM placement for ISR handlers - matches rmaker_split_camera
CONFIG_PM_POWER_DOWN_PERIPHERAL_IN_LIGHT_SLEEP=y
CONFIG_FREERTOS_USE_TICKLESS_IDLE=y
CONFIG_BT_LE_SLEEP_ENABLE=y
CONFIG_ESP_HOSTED_LIGHT_SLEEP_ENABLE=y
CONFIG_ESP_HOSTED_LIGHT_SLEEP_MIN_FREQ_MHZ=10
CONFIG_ESP_HOSTED_LIGHT_SLEEP_PERIPHERAL_POWERDOWN=y
CONFIG_ESP_PHY_MAC_BB_PD=y
CONFIG_FREERTOS_USE_TRACE_FACILITY=y
```

## examples/chef/esp32/sdkconfig.defaults
```kconfig
#
# SPDX-FileCopyrightText: 2021 Project CHIP Authors
#
# SPDX-License-Identifier: Apache-2.0
#

CONFIG_IDF_TARGET="esp32"
CONFIG_IDF_TARGET_ESP32=y
CONFIG_DEVICE_TYPE_M5STACK=y

# Default to 921600 baud when flashing and monitoring device
CONFIG_ESPTOOLPY_BAUD_921600B=y
CONFIG_ESPTOOLPY_BAUD=921600
CONFIG_ESPTOOLPY_COMPRESSED=y
CONFIG_ESPTOOLPY_MONITOR_BAUD_115200B=y
CONFIG_ESPTOOLPY_MONITOR_BAUD=115200

#enable BT
CONFIG_BT_ENABLED=y
CONFIG_BT_NIMBLE_ENABLED=y

#disable BT connection reattempt
CONFIG_BT_NIMBLE_ENABLE_CONN_REATTEMPT=n

#enable lwip ipv6 autoconfig
CONFIG_LWIP_IPV6_AUTOCONFIG=y

# disable IPV4
# CONFIG_DISABLE_IPV4 is not set

# Use a custom partition table
CONFIG_PARTITION_TABLE_CUSTOM=y
CONFIG_PARTITION_TABLE_FILENAME="partitions.csv"

CONFIG_ENABLE_CHIP_SHELL=y

CONFIG_ESP_MAIN_TASK_STACK_SIZE=8192

CONFIG_STACK_CHECK_NORM=y
CONFIG_STACK_CHECK=y

# Serial Flasher config
CONFIG_ESPTOOLPY_FLASHSIZE_4MB=y
CONFIG_ESPTOOLPY_FLASHSIZE="4MB"

# Disable softap support by default
CONFIG_ESP_WIFI_SOFTAP_SUPPORT=n

# Enable HKDF in mbedtls
CONFIG_MBEDTLS_HKDF_C=y

# IRAM optimizations
CONFIG_FREERTOS_PLACE_FUNCTIONS_INTO_FLASH=y

# Increase LwIP IPv6 address number
CONFIG_LWIP_IPV6_NUM_ADDRESSES=6
```
