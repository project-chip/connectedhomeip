## config/zephyr/chip-module/Kconfig.defaults
```kconfig
#
#   Copyright (c) 2022 Project CHIP Authors
#
#   Licensed under the Apache License, Version 2.0 (the "License");
#   you may not use this file except in compliance with the License.
#   You may obtain a copy of the License at
#
#       http://www.apache.org/licenses/LICENSE-2.0
#
#   Unless required by applicable law or agreed to in writing, software
#   distributed under the License is distributed on an "AS IS" BASIS,
#   WITHOUT WARRANTIES OR CONDITIONS OF ANY KIND, either express or implied.
#   See the License for the specific language governing permissions and
#   limitations under the License.
#

# The purpose of this file is to define new default values of settings used when building Matter samples.
# This file only changes defaults and thus all symbols here must be promptless
# and safeguarded so that they only are applied when building Matter.

if CHIP

# disable synchronous printk to avoid blocking IRQs which
# may affect time sensitive components
config PRINTK_SYNC
	bool
	default n

config ASSERT
	bool
	default y

config HW_STACK_PROTECTION
	bool
	default y

config FPU
	bool
	default y

config SHELL
	bool
	default y

# Enable getting reboot reasons information
config HWINFO
	bool
	default y

# Generic networking options
config NET_SOCKETS_POSIX_NAMES
	bool
	default n

# Application stack size
config MAIN_STACK_SIZE
	int
	default 8192

config INIT_STACKS
	bool
	default y

config CHIP_DEVICE_VENDOR_ID
	int
	default 65521

config CHIP_DEVICE_PRODUCT_ID
	int
	default 32768

# Disable certain parts of Zephyr IPv6 stack
config NET_IPV6_NBR_CACHE
	bool
	default n

config NET_IPV6_MLD
	bool
	default y

config NET_IF_MCAST_IPV6_ADDR_COUNT
	int
	default 14

# Network buffers
config NET_PKT_RX_COUNT
	int
	default 16

config NET_PKT_TX_COUNT
	int
	default 16

config NET_BUF_RX_COUNT
	int
	default 80

config NET_BUF_TX_COUNT
	int
	default 80



config CHIP_OTA_REQUESTOR
	bool
	default y

# Enable extended discovery
config CHIP_EXTENDED_DISCOVERY
	bool
	default y

config NVS_LOOKUP_CACHE
	bool
	default y

# Enable OpenThread
config NET_L2_OPENTHREAD
	bool
	default y

# Enable mbedTLS
config MBEDTLS_ENABLE_HEAP
	bool
	default y

config MBEDTLS_HEAP_SIZE
	int
	default 15360

# Disable not used shell modules
config SENSOR_SHELL
	bool
	default n

config DEVICE_SHELL
	bool
	default n

config DATE_SHELL
	bool
	default n

config DEVMEM_SHELL
	bool
	default n

config MCUBOOT_SHELL
	bool
	default n

config FLASH_SHELL
	bool
	default n

endif # CHIP
```

## config/zephyr/chip-module/Kconfig.features
```kconfig
#
#   Copyright (c) 2022 Project CHIP Authors
#
#   Licensed under the Apache License, Version 2.0 (the "License");
#   you may not use this file except in compliance with the License.
#   You may obtain a copy of the License at
#
#       http://www.apache.org/licenses/LICENSE-2.0
#
#   Unless required by applicable law or agreed to in writing, software
#   distributed under the License is distributed on an "AS IS" BASIS,
#   WITHOUT WARRANTIES OR CONDITIONS OF ANY KIND, either express or implied.
#   See the License for the specific language governing permissions and
#   limitations under the License.
#

# The purpose of this file is to define Kconfig options enabling specific features.
# Feature options will define defaults for settings that are related to the specific feature.

if CHIP

# MCU Manager and SMP configuration
config MCUMGR
	bool
	default y

config MCUMGR_GRP_IMG
	bool
	default y

config MCUMGR_GRP_OS
	bool
	default y

config MCUMGR_TRANSPORT_BT
	bool
	default y

choice MCUMGR_TRANSPORT_BT_PERM
	default MCUMGR_TRANSPORT_BT_PERM_RW
endchoice

config MCUMGR_TRANSPORT_NETBUF_COUNT
	int
	default 6

# Increase BT MTU and RX buffer for big size DFU messages
config BT_L2CAP_TX_MTU
	int
	default 498

config BT_BUF_ACL_RX_SIZE
	int
	default 502

# Increase MCUMGR_TRANSPORT_NETBUF_SIZE, as it must be big enough to fit MAX MTU + overhead and for single-image DFU default is 384 B
config MCUMGR_TRANSPORT_NETBUF_SIZE
	int
	default 1024

# Increase system workqueue size, as SMP is processed within it
config SYSTEM_WORKQUEUE_STACK_SIZE
	int
	default 2800

endif # CHIP_DFU_OVER_BT_SMP

endif # CHIP
```

## config/zephyr/chip-module/Kconfig.logging
```kconfig
#
#   Copyright (c) 2021 Project CHIP Authors
#
#   Licensed under the Apache License, Version 2.0 (the "License");
#   you may not use this file except in compliance with the License.
#   You may obtain a copy of the License at
#
#       http://www.apache.org/licenses/LICENSE-2.0
#
#   Unless required by applicable law or agreed to in writing, software
#   distributed under the License is distributed on an "AS IS" BASIS,
#   WITHOUT WARRANTIES OR CONDITIONS OF ANY KIND, either express or implied.
#   See the License for the specific language governing permissions and
#   limitations under the License.
#

config LOG
    default y

if LOG

choice LOG_MODE
    default LOG_MODE_MINIMAL
endchoice

choice MATTER_LOG_LEVEL_CHOICE
    default MATTER_LOG_LEVEL_DBG
endchoice

config CHIP_APP_LOG_LEVEL
    default 4 # debug

config LOG_DEFAULT_LEVEL
    default 1 # error

# disable synchronous printk to avoid blocking IRQs which
# may affect time sensitive components
config PRINTK_SYNC
    default n

endif # LOG
```

## config/zephyr/chip-module/Kconfig.mbedtls
```kconfig
#
#   Copyright (c) 2021 Project CHIP Authors
#
#   Licensed under the Apache License, Version 2.0 (the "License");
#   you may not use this file except in compliance with the License.
#   You may obtain a copy of the License at
#
#       http://www.apache.org/licenses/LICENSE-2.0
#
#   Unless required by applicable law or agreed to in writing, software
#   distributed under the License is distributed on an "AS IS" BASIS,
#   WITHOUT WARRANTIES OR CONDITIONS OF ANY KIND, either express or implied.
#   See the License for the specific language governing permissions and
#   limitations under the License.
#

if CHIP

config MBEDTLS
    default y

config MBEDTLS_ENTROPY_ENABLED
    default y

config MBEDTLS_ZEPHYR_ENTROPY
    default y

config MBEDTLS_ENABLE_HEAP
    default y

config MBEDTLS_KEY_EXCHANGE_ECDHE_ECDSA_ENABLED
    default y

config MBEDTLS_ECP_ALL_ENABLED
    default y

config MBEDTLS_ECP_C
    default y 

config MBEDTLS_PKCS5_C
    default y

config MBEDTLS_HKDF_C
    default y

config MBEDTLS_CIPHER_CCM_ENABLED
    default y

config MBEDTLS_CTR_DRBG_ENABLED
    default y 

config MBEDTLS_CIPHER_AES_ENABLED
    default y

config MBEDTLS_ECDH_C
    default y

config MBEDTLS_ECDSA_C
    default y

config MBEDTLS_X509_CSR_WRITE_C
    default y

config MBEDTLS_PK_WRITE_C
    default y

endif #CHIP
```

## config/zephyr/chip-module/Kconfig.mcuboot.defaults
```kconfig
#
#   Copyright (c) 2022 Project CHIP Authors
#
#   Licensed under the Apache License, Version 2.0 (the "License");
#   you may not use this file except in compliance with the License.
#   You may obtain a copy of the License at
#
#       http://www.apache.org/licenses/LICENSE-2.0
#
#   Unless required by applicable law or agreed to in writing, software
#   distributed under the License is distributed on an "AS IS" BASIS,
#   WITHOUT WARRANTIES OR CONDITIONS OF ANY KIND, either express or implied.
#   See the License for the specific language governing permissions and
#   limitations under the License.
#

# The purpose of this file is to define new default values of settings used when building mcuboot child image for Matter samples.

config MAIN_STACK_SIZE
	int
	default 10240

config BOOT_SWAP_SAVE_ENCTLV
	bool
	default n

config BOOT_ENCRYPT_RSA
	bool
	default n

config BOOT_ENCRYPT_EC256
	bool
	default n

config BOOT_ENCRYPT_X25519
	bool
	default n

config BOOT_BOOTSTRAP
	bool
	default n

config PM
	bool
	default n

config FLASH
	bool
	default y

config FPROTECT
	bool
	default y

config BOOT_MAX_IMG_SECTORS
	int
	default 256

config LOG
	bool
	default n

config CONSOLE_HANDLER
	bool
	default n

config BOOT_BANNER
	bool
	default n

config TIMESLICING
	bool
	default n

config RESET_ON_FATAL_ERROR
	bool
	default n

config MULTITHREADING
	bool
	default n

config TICKLESS_KERNEL
	bool
	default n

config TIMEOUT_64BIT
	bool
	default n
```

## config/zephyr/chip-module/Kconfig.multiprotocol_rpmsg.defaults
```kconfig
#
#   Copyright (c) 2022 Project CHIP Authors
#
#   Licensed under the Apache License, Version 2.0 (the "License");
#   you may not use this file except in compliance with the License.
#   You may obtain a copy of the License at
#
#       http://www.apache.org/licenses/LICENSE-2.0
#
#   Unless required by applicable law or agreed to in writing, software
#   distributed under the License is distributed on an "AS IS" BASIS,
#   WITHOUT WARRANTIES OR CONDITIONS OF ANY KIND, either express or implied.
#   See the License for the specific language governing permissions and
#   limitations under the License.
#

# The purpose of this file is to define new default values of settings used when building multiprotocol_rpmsg child image for Matter samples.

config LOG
	bool
	default n

config HEAP_MEM_POOL_SIZE
	int
	default 8192

config MAIN_STACK_SIZE
	int
	default 2048

config SYSTEM_WORKQUEUE_STACK_SIZE
	int
	default 2048

config BT
	bool
	default y

config BT_HCI_RAW
	bool
	default y

config BT_MAX_CONN
	int
	default 1

config BT_PERIPHERAL
	bool
	default y

config BT_CENTRAL
	bool
	default n

config BT_BUF_ACL_RX_SIZE
	int
	default 502

config BT_BUF_ACL_TX_SIZE
	int
	default 251

config BT_CTLR_DATA_LENGTH_MAX
	int
	default 251

config BT_CTLR_ASSERT_HANDLER
	bool
	default y

config BT_HCI_RAW_RESERVE
	int
	default 1

# Workaround: Unable to allocate command buffer when using K_NO_WAIT since
# Host number of completed commands does not follow normal flow control.
config BT_BUF_CMD_TX_COUNT
	int
	default 10

config ASSERT
	bool
	default y

config DEBUG_INFO
	bool
	default y

config EXCEPTION_STACK_TRACE
	bool
	default y
```

## examples/all-clusters-app/esp32/main/Kconfig.projbuild
```kconfig
#
#    Copyright (c) 2022 Project CHIP Authors
#    All rights reserved.
#
#    Licensed under the Apache License, Version 2.0 (the "License");
#    you may not use this file except in compliance with the License.
#    You may obtain a copy of the License at
#
#        http://www.apache.org/licenses/LICENSE-2.0
#
#    Unless required by applicable law or agreed to in writing, software
#    distributed under the License is distributed on an "AS IS" BASIS,
#    WITHOUT WARRANTIES OR CONDITIONS OF ANY KIND, either express or implied.
#    See the License for the specific language governing permissions and
#    limitations under the License.
#
#    Description:
#      Configuration options CHIP ESP32 demo application.
#

menu "Demo"

    choice
        prompt "Device Type"
        default DEVICE_TYPE_ESP32_DEVKITC if IDF_TARGET_ESP32
        default DEVICE_TYPE_ESP32_C3_DEVKITM if IDF_TARGET_ESP32C3
        help
            Specifies the type of ESP32 device.

            Note that the "ESP32-DevKitC" choice is compatible with a number of clone devices
            available from third-party manufacturers.

        config DEVICE_TYPE_ESP32_DEVKITC
            bool "ESP32-DevKitC"
            depends on IDF_TARGET_ESP32
        config DEVICE_TYPE_ESP32_WROVER_KIT
            bool "ESP32-WROVER-KIT_V4.1"
            depends on IDF_TARGET_ESP32
        config DEVICE_TYPE_M5STACK
            bool "M5Stack"
            depends on IDF_TARGET_ESP32
        config DEVICE_TYPE_ESP32_C3_DEVKITM
            bool "ESP32C3-DevKitM"
            depends on IDF_TARGET_ESP32C3
        config DEVICE_TYPE_ESP32_ETHERNET_KIT
            bool "ESP32-Ethernet-Kit_A_V1.0"
            select ENABLE_ETHERNET_TELEMETRY
            depends on IDF_TARGET_ESP32
    endchoice

    choice
      prompt "Rendezvous Mode"
      default RENDEZVOUS_MODE_BLE if BT_ENABLED
      default RENDEZVOUS_MODE_SOFTAP
      help
          Specifies the Rendezvous mode of the peripheral.

      config RENDEZVOUS_MODE_SOFTAP
          bool "Soft-AP"
          select ESP_WIFI_SOFTAP_SUPPORT
      config RENDEZVOUS_MODE_BLE
          bool "BLE"
          depends on BT_ENABLED
      config RENDEZVOUS_MODE_ON_NETWORK
          bool "On-Network"
      config RENDEZVOUS_MODE_SOFTAP_ON_NETWORK
          bool "Soft-AP / On-Network"
          select ESP_WIFI_SOFTAP_SUPPORT
      config RENDEZVOUS_MODE_BLE_ON_NETWORK
          bool "BLE / On-Network"
    endchoice

    # NOTE: This config is not displayed as a input in the Kconfig menu, as its value is
    # entirely derived from the Device Type choice.  However the CONFIG_EXAMPLE_DISPLAY_TYPE
    # define that is produced is needed to configure the TFT library correctly.
    config TFT_PREDEFINED_DISPLAY_TYPE
        int
        range 0 5
        default 0 if DEVICE_TYPE_ESP32_DEVKITC
        default 0 if DEVICE_TYPE_ESP32_C3_DEVKITM
        default 3 if DEVICE_TYPE_M5STACK
        default 4 if DEVICE_TYPE_ESP32_WROVER_KIT

    config RENDEZVOUS_MODE
       int
       range 0 8
       default 1 if RENDEZVOUS_MODE_SOFTAP
       default 2 if RENDEZVOUS_MODE_BLE
       default 4 if RENDEZVOUS_MODE_ON_NETWORK
       default 5 if RENDEZVOUS_MODE_SOFTAP_ON_NETWORK
       default 6 if RENDEZVOUS_MODE_BLE_ON_NETWORK

    config DISPLAY_AUTO_OFF
        bool "Automatically turn off the M5Stack's Display after a few seconds"
        default "y"
        depends on DEVICE_TYPE_M5STACK
        help
            To reduce wear and heat the M5Stack's Display is automatically switched off after a few seconds

    config STATUS_LED_GPIO_NUM
        int 
        range 0 40
        default 2 if DEVICE_TYPE_ESP32_DEVKITC         #Use LED1 (blue LED) as status LED on DevKitC      
        default 2 if DEVICE_TYPE_ESP32_ETHERNET_KIT
        default 8 if DEVICE_TYPE_ESP32_C3_DEVKITM
        default 26 if DEVICE_TYPE_ESP32_WROVER_KIT     
        default 40 if DEVICE_TYPE_M5STACK
        help
            Each board has a status led, define its pin number.

endmenu

menu "PW RPC Debug channel"
depends on ENABLE_PW_RPC
    config EXAMPLE_UART_PORT_NUM
        int "UART port number"
        range 0 2 if IDF_TARGET_ESP32
        range 0 1 if IDF_TARGET_ESP32C3
        default 0
        help
            UART communication port number for the example.
            See UART documentation for available port numbers.

    config EXAMPLE_UART_BAUD_RATE
        int "UART communication speed"
        range 1200 115200
        default 115200
        help
            UART communication speed for Modbus example.

    config EXAMPLE_UART_RXD
        int "UART RXD pin number"
        range 0 34 if IDF_TARGET_ESP32
        range 0 19 if IDF_TARGET_ESP32C3
        default 5
        help
            GPIO number for UART RX pin. See UART documentation for more information
            about available pin numbers for UART.

    config EXAMPLE_UART_TXD
        int "UART TXD pin number"
        range 0 34 if IDF_TARGET_ESP32
        range 0 19 if IDF_TARGET_ESP32C3
        default 4
        help
            GPIO number for UART TX pin. See UART documentation for more information
            about available pin numbers for UART.

endmenu
```
