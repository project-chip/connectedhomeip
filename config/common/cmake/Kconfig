## config/nrfconnect/Kconfig
```kconfig
#
#   Copyright (c) 2020 Project CHIP Authors
#
#   Licensed under the Apache License, Version 2.0 (the "License");
#   you may not use this file except in compliance with the License.
#   You may obtain a copy of the License at
#
#       http://www.apache.org/licenses/LICENSE-2.0
#
#   Unless required by applicable law or agreed to in writing, software
#   distributed under the License is distributed on an "AS IS" BASIS,
#   WITHOUT WARRANTIES OR CONDITIONS OF ANY KIND, either express or implied.
#   See the License for the specific language governing permissions and
#   limitations under the License.
#

mainmenu "CHIP application"

source "Kconfig.zephyr"

config CHIP
	bool "Enable CHIP"
	default n
	select CPLUSPLUS
	imply LIB_CPLUSPLUS
	imply REBOOT
	select ENTROPY_GENERATOR
	imply NET_UDP
	imply NET_IPV6
	imply NET_CONFIG_NEED_IPV6
	imply NET_SOCKETS
	imply MULTIPROTOCOL
	help
	  Use the CHIP protocol.

config CHIP_LIB_SHELL
	bool "Enable CHIP's shell library"
	help
	  Link the application with the library containing CHIP shell commands

config MULTIPROTOCOL
	bool "Enable multiprotocol support"
	select NRF_802154_MULTIPROTOCOL_SUPPORT
	depends on BT && NET_L2_OPENTHREAD
	help
	  Enable multiprotocol in the nRF 802.15.4 radio driver

config CHIP_DISABLE_CHIPOBLE_ADVERTISING_WHEN_PROVISIONED
	bool "Disable CHIPoBLE advertising when device is fully provisioned"
	default n
	help
	  Enables CHIPoBLE advertising disabling when the device achieves a fully provisioned state.

config CHIP_DISABLE_ACCOUNT_PAIRING
	bool "Disable Account Pairing"
	default n
	help
	  Disables sending the PairDeviceToAccount request to the service during a RegisterServicePairAccount
	  operation.  When this option is enabled, the device will perform all local operations associated
	  with registering a service, but will not request the service to add the device to the user's account.

config CHIP_DISABLE_FABRIC_MEMBER
	bool "Disable Fabric Member device checks"
	default n
	help
	  Disables checking if device is fabric member in order to allow testing some of communication
	  functionalities on development kits and other non-production boards.
```
