## config/nxp/chip-cmake-freertos/Kconfig
```kconfig
#
#   Copyright (c) 2024-2025 Project CHIP Authors
#
#   Licensed under the Apache License, Version 2.0 (the "License");
#   you may not use this file except in compliance with the License.
#   You may obtain a copy of the License at
#
#       http://www.apache.org/licenses/LICENSE-2.0
#
#   Unless required by applicable law or agreed to in writing, software
#   distributed under the License is distributed on an "AS IS" BASIS,
#   WITHOUT WARRANTIES OR CONDITIONS OF ANY KIND, either express or implied.
#   See the License for the specific language governing permissions and
#   limitations under the License.
#

rsource "../../common/cmake/Kconfig"
rsource "../cmake/Kconfig.matter.nxp"
rsource "Kconfig.openthread.common"
rsource "../../../third_party/nxp/nxp_matter_support/cmake/Kconfig"

# See config/common/cmake/Kconfig for full definition
config CHIP
	select CHIP_SDK_DEPENDENCIES

if CHIP

choice CHIP_NXP_PLATFORM_SELECTION
	prompt "CHIP NXP platform selection"
	config CHIP_NXP_PLATFORM_RW61X
		bool "RW61x platform"
		depends on MCUX_HW_DEVICE_RW612 || MCUX_HW_DEVICE_RW610
		help
			NXP RW61x platform.

	config CHIP_NXP_PLATFORM_RT1170
		bool "RT1170 platform"
		depends on MCUX_HW_DEVICE_MIMXRT1171 || MCUX_HW_DEVICE_MIMXRT1172 || MCUX_HW_DEVICE_MIMXRT1173 || MCUX_HW_DEVICE_MIMXRT1175 || MCUX_HW_DEVICE_MIMXRT1176
		help
			NXP RT1170 platform.

	config CHIP_NXP_PLATFORM_RT1060
		bool "RT1060 platform"
		depends on MCUX_HW_DEVICE_MIMXRT1061 || MCUX_HW_DEVICE_MIMXRT1062
		help
			NXP RT1060 platform.

	config CHIP_NXP_PLATFORM_MCXW72
		bool "mcxw72 platform"
		depends on MCUX_HW_DEVICE_MCXW727C
		help
			NXP mcxw72 platform.

endchoice # CHIP_NXP_PLATFORM_SELECTION

config CHIP_NXP_PLATFORM_FOLDER_NAME
	string "NXP platform folder name"
	default "rt/rw61x" if CHIP_NXP_PLATFORM_RW61X
	default "rt/rt1170" if CHIP_NXP_PLATFORM_RT1170
	default "rt/rt1060" if CHIP_NXP_PLATFORM_RT1060
	default "mcxw72" if CHIP_NXP_PLATFORM_MCXW72
	default "not specified"
	help
		Defines the platform folder name to be used.

config CHIP_NXP_DEVICE_LAYER
	string "NXP device layer"
	default "nxp/common"

# Invisible symbol to get the platform family name
config CHIP_NXP_PLATFORM_FAMILY
	string
	default "mcxw72" if CHIP_NXP_PLATFORM_MCXW72
	default "rt" if CHIP_NXP_PLATFORM_RW61X || CHIP_NXP_PLATFORM_RT1060 || CHIP_NXP_PLATFORM_RT1170

choice CHIP_NVM_COMPONENT
	prompt "NVM component selection"
	default CHIP_NVM_COMPONENT_NVS

	config CHIP_NVM_COMPONENT_NVS
		bool "NVS"
		help
			Use NVS component to store CHIP data.

	config CHIP_NVM_COMPONENT_LITTLEFS
		bool "LittleFS"
		help
			Use LittleFS component to store CHIP data.

	config CHIP_NVM_COMPONENT_KEYSTORAGE
		bool "Key Storage"
		help
			Use the KeyStorage component to store CHIP data.

	config CHIP_NVM_COMPONENT_NVMFWK
		bool "NVM Framework"
		help
			Use the NVM Framework component to store CHIP data.
endchoice

config CHIP_USE_GENERATED_CONFIG
	bool "Use generated config"
	default y
	help
		Use the generated macro configs for CHIP configuration.

# Define BT config for FreeRTOS compatibility with Zephyr (already defined in Zephyr module)
# to enable shared code and Kconfig across both platforms.
config BT
	bool "Enable BLE"
	default y
	help
		Enable BLE support.

config CHIP_DEVICE_USE_ZEPHYR_BLE
	bool "Use Zephyr BLE implementation"
	depends on BT
	default y if CHIP_NXP_PLATFORM_RW61X || CHIP_NXP_PLATFORM_RT1060 || CHIP_NXP_PLATFORM_RT1170
	help
		Use Zephyr implementation for BLE manager.

# Secure Element Configurations

config CHIP_OTA_POSTED_OPERATIONS_IN_IDLE
	bool "Use Posted Operations in Idle task for OTA Image Processing"
	default y if CHIP_NXP_PLATFORM_RW61X || CHIP_NXP_PLATFORM_RT1060 || CHIP_NXP_PLATFORM_RT1170
	depends on CHIP_OTA_REQUESTOR
	help
		When processing the OTA image, the write/erase operations will be posted and only resumed in the context of the Idle task.

if CHIP_OTA_REQUESTOR

config CHIP_OTA_ENCRYPTION
	bool "OTA with encryption"
	help
		When enabled, the OTA image processor expects the image to be encrypted with AES,
		so it will attempt to decrypt each block before storing it in flash.

config CHIP_OTA_ENCRYPTION_KEY
	string "OTA encryption key"
	depends on CHIP_OTA_ENCRYPTION
	default "1234567890ABCDEFA1B2C3D4E5F6F1B4"
	help
		Defines the key used for encrypting the OTA image.
		This key is reused to perform an AES decryption of the OTA image.

endif # CHIP_OTA_REQUESTOR

if CHIP_BUILD_TESTS

config NXP_CUSTOM_UNIT_TESTS_DIR
	string "Path to custom NXP test directory"
	help
	Provide a path to the location of NXP custom Matter tests

endif # CHIP_BUILD_TESTS

# Define Debug config for FreeRTOS compatibility with Zephyr (already defined in Zephyr module)
# to enable shared code and Kconfig across both platforms.
config DEBUG
	bool "Build Matter stack with debugging enabled"
	help
		Build Matter stack with debugging enabled.

config CHIP_NXP_MULTIPLE_BLE_CONNECTIONS
	bool "Use Multiple BLE connections after commissioning"
	depends on CHIP_NXP_PLATFORM_MCXW72
	help
	  Enable app usage of Multiple BLE connections after commissioning.

config CHIP_NXP_BLE_PAIRING
	bool "Enable BLE Pairing"
	default y if CHIP_NXP_MULTIPLE_BLE_CONNECTIONS
	help
	  Enable BLE Pairing for Multiple BLE connections after commissioning.

config CHIP_NXP_BLE_BONDING
	bool "Enable BLE Bonding"
	default y if CHIP_NXP_MULTIPLE_BLE_CONNECTIONS
	help
	  Enable BLE Bonding for Multiple BLE connections after commissioning.

config NXP_USE_SMU2_STATIC
	bool "Use SMU2"
	depends on CHIP_NXP_PLATFORM_MCXW72
	help
	  Enable app usage of SMU2.

config NXP_USE_SMU2_DYNAMIC
	bool "Use extra SMU2 after commissioning"
	depends on CHIP_NXP_PLATFORM_MCXW72
	help
	  Enable app usage of extra SMU2 after commissioning.

config NXP_USE_LOW_POWER
	bool "Enable low power support"
	help
	  Enables low power support

if NXP_USE_LOW_POWER

config NXP_USE_POWER_DOWN
	bool "Use PowerDown to reduce power consumption"
	help
	  Uses PowerDown to reduce power consumption during idle times

if NXP_USE_POWER_DOWN

config NXP_POWER_DOWN_POLL_THRESHOLD
	int "Data poll interval threshold, in seconds, for power down"
	depends on NXP_USE_POWER_DOWN
	range 1 60
	help
	  Minimum data poll interval, in seconds, from which the device will
	  start using power down as a low power state, instead of deep sleep

endif # NXP_USE_POWER_DOWN

endif # NXP_USE_LOW_POWER

config NXP_USE_PLAIN_DAC_KEY
	bool "Store DAC private key in plaintext"
	help
	  Store DAC private key in plaintext.

endif # CHIP
```

## config/nxp/chip-cmake-freertos/Kconfig.defaults
```kconfig
#
#   Copyright (c) 2024-2025 Project CHIP Authors
#
#   Licensed under the Apache License, Version 2.0 (the "License");
#   you may not use this file except in compliance with the License.
#   You may obtain a copy of the License at
#
#       http://www.apache.org/licenses/LICENSE-2.0
#
#   Unless required by applicable law or agreed to in writing, software
#   distributed under the License is distributed on an "AS IS" BASIS,
#   WITHOUT WARRANTIES OR CONDITIONS OF ANY KIND, either express or implied.
#   See the License for the specific language governing permissions and
#   limitations under the License.
#

# The purpose of this file is to define new default values of settings used when building Matter samples.
# This file only changes defaults and thus all symbols here must be promptless
# and safeguarded so that they only are applied when building Matter.

if CHIP

config CHIP_WIFI
	default y if CHIP_NXP_PLATFORM_RW61X || CHIP_NXP_PLATFORM_RT1170 || CHIP_NXP_PLATFORM_RT1060

config CHIP_NET_L2_OPENTHREAD
	default y if CHIP_NXP_PLATFORM_MCXW71 || CHIP_NXP_PLATFORM_K32W1 || CHIP_NXP_PLATFORM_MCXW72

config CHIP_OPERATIONAL_TIME_SAVE_INTERVAL
	default 1

config CHIP_DEVICE_CONFIG_ENABLE_SED
	default y if CHIP_NXP_PLATFORM_MCXW71 || CHIP_NXP_PLATFORM_K32W1 || CHIP_NXP_PLATFORM_MCXW72

config CHIP_ENABLE_ICD_SUPPORT
	default y if CHIP_NXP_PLATFORM_MCXW71 || CHIP_NXP_PLATFORM_K32W1 || CHIP_NXP_PLATFORM_MCXW72

config CHIP_LIB_SHELL
	default y if CHIP_NXP_PLATFORM_MCXW72
	default n

if CHIP_FACTORY_DATA

config CHIP_DEVICE_DISCRIMINATOR
	default 2560 #0xA00

config CHIP_DEVICE_SPAKE2_PASSCODE
	default 14014

config CHIP_DEVICE_VENDOR_ID
	default 4151 # 0x1037

config CHIP_DEVICE_MANUFACTURING_DATE
	default "2023-01-01"

config CHIP_DEVICE_PRODUCT_ID
	default 41510 if CHIP_NXP_PLATFORM_RW61X
	default 41511 if CHIP_NXP_PLATFORM_RT1170
	default 41505 if CHIP_NXP_PLATFORM_K32W1
	default 41985 if CHIP_NXP_PLATFORM_MCXW71 
	default 42241 if CHIP_NXP_PLATFORM_MCXW72

config CHIP_DEVICE_ROTATING_DEVICE_UID
	default "00112233445566778899aabbccddeeff"

config CHIP_DEVICE_SERIAL_NUMBER
	default "12345678"

config CHIP_DEVICE_PRODUCT_COLOR
	default "Green"

config CHIP_DEVICE_PRODUCT_FINISH
	default "Matte"

config CHIP_DEVICE_PRODUCT_URL
	default "https://www.nxp.com/products/wireless/wi-fi-plus-bluetooth-plus-802-15-4/wireless-mcu-with-integrated-tri-radiobr1x1-wi-fi-6-plus-bluetooth-low-energy-5-3-802-15-4:RW612" if CHIP_NXP_PLATFORM_RW61X
	default "https://www.nxp.com/products/processors-and-microcontrollers/arm-microcontrollers/i-mx-rt-crossover-mcus/i-mx-rt1170-1-ghz-crossover-mcu-with-arm-cortex-cores:i.MX-RT1170" if CHIP_NXP_PLATFORM_RT1170
	default "https://www.nxp.com/products/i.MX-RT1060" if CHIP_NXP_PLATFORM_RT1060
	default "https://www.nxp.com/products/K32W148" if CHIP_NXP_PLATFORM_K32W1
	default "https://www.nxp.com/products/MCX-W71X" if CHIP_NXP_PLATFORM_MCXW71
	default "https://www.nxp.com/products/MCX-W72X" if CHIP_NXP_PLATFORM_MCXW72


config CHIP_DEVICE_PRODUCT_LABEL
	default "RW612" if CHIP_NXP_PLATFORM_RW61X
	default "RT1170" if CHIP_NXP_PLATFORM_RT1170
	default "RT1060" if CHIP_NXP_PLATFORM_RT1060
	default "K32W148" if CHIP_NXP_PLATFORM_K32W1
	default "MCXW71X" if CHIP_NXP_PLATFORM_MCXW71
	default "MCXW72X" if CHIP_NXP_PLATFORM_MCXW72

config CHIP_DEVICE_PART_NUMBER
	default "RW612" if CHIP_NXP_PLATFORM_RW61X
	default "RT1170" if CHIP_NXP_PLATFORM_RT1170
	default "RT1060" if CHIP_NXP_PLATFORM_RT1060
	default "K32W148" if CHIP_NXP_PLATFORM_K32W1
	default "MCXW71X" if CHIP_NXP_PLATFORM_MCXW71
	default "MCXW72X" if CHIP_NXP_PLATFORM_MCXW72

endif # CHIP_FACTORY_DATA

config CHIP_LOG_SIZE_OPTIMIZATION
	default y

# Enable extended discovery
config CHIP_EXTENDED_DISCOVERY
	default y

config HAVE_LWIP
	default n if CHIP_NXP_PLATFORM_K32W1 || CHIP_NXP_PLATFORM_MCXW71 || CHIP_NXP_PLATFORM_MCXW72

config CHIP_ENABLE_PAIRING_AUTOSTART
	default n if CHIP_NXP_PLATFORM_K32W1 || CHIP_NXP_PLATFORM_MCXW71 || CHIP_NXP_PLATFORM_MCXW72

if CHIP_OTA_REQUESTOR

config CHIP_OTA_IMAGE_BUILD
	default y if CHIP_NXP_PLATFORM_RW61X || CHIP_NXP_PLATFORM_RT1060 || CHIP_NXP_PLATFORM_RT1170

endif # CHIP_OTA_REQUESTOR

# Include defaults for SDK Kconfig
rsource "../../../third_party/nxp/nxp_matter_support/cmake/Kconfig.defconfig"

endif # CHIP
```
