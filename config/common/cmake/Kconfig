## config/nrfconnect/chip-module/Kconfig.features
```kconfig
#
#   Copyright (c) 2022 Project CHIP Authors
#
#   Licensed under the Apache License, Version 2.0 (the "License");
#   you may not use this file except in compliance with the License.
#   You may obtain a copy of the License at
#
#       http://www.apache.org/licenses/LICENSE-2.0
#
#   Unless required by applicable law or agreed to in writing, software
#   distributed under the License is distributed on an "AS IS" BASIS,
#   WITHOUT WARRANTIES OR CONDITIONS OF ANY KIND, either express or implied.
#   See the License for the specific language governing permissions and
#   limitations under the License.
#

# The purpose of this file is to define Kconfig options enabling specific features.
# Feature options will define defaults for settings that are related to the specific feature.

if CHIP

config CHIP_WIFI
	bool "Enable nrfconnect Wi-Fi support"
	default y if SHIELD_NRF7002EK || BOARD_NRF7002DK_NRF5340_CPUAPP || SHIELD_NRF7002EB || BOARD_NRF7002DK_NRF7001_NRF5340_CPUAPP
	select WIFI_NRF70
	select WIFI
	select WIFI_NM_WPA_SUPPLICANT
	imply NORDIC_SECURITY_BACKEND
	imply MBEDTLS_ENTROPY_C
	imply MBEDTLS_PSA_CRYPTO_C
	imply NET_STATISTICS
	imply NET_L2_ETHERNET
	imply NET_PKT_TXTIME
	imply NET_PKT_TIMESTAMP
	imply MBEDTLS_PROMPTLESS
	imply BUILD_OUTPUT_META
	imply USE_DT_CODE_PARTITION # might be removed when the OTA is enabled
	imply NET_IPV6_ND # enable Neighbor Discovery to handle Router Advertisements
	imply NET_IPV6_NBR_CACHE
	imply NET_STATISTICS_IPV6
	imply NET_STATISTICS_USER_API

config CHIP_QSPI_NOR
	bool "Enable QSPI NOR feature set"
	imply NORDIC_QSPI_NOR
	help
	  Enables QSPI NOR flash with a set of options for configuring pages and
	  buffer sizes.

if CHIP_QSPI_NOR

config NORDIC_QSPI_NOR_STACK_WRITE_BUFFER_SIZE
	default 16

endif # CHIP_QSPI_NOR

config CHIP_SPI_NOR
	bool "Enable SPI NOR feature set"
	imply SPI
	imply SPI_NOR
	imply MULTITHREADING
	imply PM_OVERRIDE_EXTERNAL_DRIVER_CHECK
	imply MCUMGR_GRP_IMG_ALLOW_ERASE_PENDING
	help
	  Enables SPI NOR flash with a set of options for configuring pages and
	  buffer sizes.

if CHIP_SPI_NOR

config SPI_NOR_FLASH_LAYOUT_PAGE_SIZE
	default 4096

endif # CHIP_SPI_NOR

config CHIP_MEMORY_PROFILING
	bool "Enable features for tracking memory usage"
	# Matter stack
	select CHIP_STATISTICS
	# Heap
	select CHIP_MALLOC_SYS_HEAP_WATERMARKS_SUPPORT if CHIP_MALLOC_SYS_HEAP
	select SYS_HEAP_RUNTIME_STATS if CHIP_MALLOC_SYS_HEAP	
	# Crypto
	select MBEDTLS_MEMORY_DEBUG if !CHIP_CRYPTO_PSA
	# Network
	select NET_STATISTICS
	select NET_SHELL
	select NET_BUF_POOL_USAGE
	select OPENTHREAD_SHELL if !CHIP_WIFI
	# Settings
	select SETTINGS_SHELL
	# Zephyr
	select KERNEL_SHELL
	help
	  Enables features for tracking memory usage in Matter.

config CHIP_NUS
	bool "Enable Nordic UART service for Matter purposes"
	select BT_NUS
	select BT_SMP
	select BT_NUS_AUTHEN
	help
	  Enables Nordic UART service (NUS) for Matter samples.
	  Using NUS service you can control a Matter sample using pre-defined BLE commands 
	  and do defined operations. The CHIP NUS service can be useful to keep communication
	  with a smart home device when a connection within Matter network is lost.

if CHIP_NUS

# Requires providing a PIN for each pair request
config BT_BONDABLE
	default n

config BT_RX_STACK_SIZE
	default 1536

config SYSTEM_WORKQUEUE_STACK_SIZE
	default 2048

config BT_DEVICE_APPEARANCE
	default 833

if !LOG

config BT_FIXED_PASSKEY
	default y

endif

config CHIP_NUS_MAX_COMMAND_LEN
	int "Maximum length of single command in Bytes"
	default 10
	help
	  Maximum length of single command. This command will be send via Bluetooth LE to
	  a paired smart home device.

config CHIP_NUS_FIXED_PASSKEY
	int "Define the default passkey for NUS"
	depends on BT_FIXED_PASSKEY
	default 123456
	help
	  Define the default password for pairing with the Bluetooth LE device.

config CHIP_NUS_MAX_COMMANDS
	int "Define maximum NUS commands amount"
	default 2
	help
	  Define the maximum number of NUS commands to declare by user.

endif


config CHIP_DFU_OVER_BT_SMP
	bool "Enable DFU over Bluetooth LE SMP feature set"
	imply CHIP_QSPI_NOR if BOARD_NRF5340DK_NRF5340_CPUAPP || BOARD_NRF52840DK_NRF52840
	imply CHIP_SPI_NOR if BOARD_NRF7002DK_NRF5340_CPUAPP || BOARD_NRF7002DK_NRF7001_NRF5340_CPUAPP || BOARD_NRF54L15DK
	imply BOOTLOADER_MCUBOOT
	select MCUMGR
	select MCUMGR_TRANSPORT_BT
	select IMG_MANAGER
	select STREAM_FLASH
	select ZCBOR
	select MCUMGR_GRP_IMG
	select MCUMGR_GRP_OS
	select MCUMGR_GRP_IMG_STATUS_HOOKS
	# Enable custom SMP request to erase settings partition.
	select MCUMGR_GRP_ZBASIC
	select MCUMGR_GRP_ZBASIC_STORAGE_ERASE
	select MCUMGR_TRANSPORT_BT_REASSEMBLY
	help
	  Enables Device Firmware Upgrade over Bluetooth LE with SMP and configures
	  the set of options related to that feature.

if CHIP_DFU_OVER_BT_SMP

# MCU Manager and SMP configuration
choice MCUMGR_TRANSPORT_BT_PERM
	default MCUMGR_TRANSPORT_BT_PERM_RW
endchoice

config MCUMGR_TRANSPORT_NETBUF_COUNT
	default 6

config MCUMGR_MGMT_NOTIFICATION_HOOKS
	bool
	default y

config MCUMGR_GRP_IMG_UPLOAD_CHECK_HOOK
	bool
	default y

config MCUMGR_SMP_COMMAND_STATUS_HOOKS
	bool
	default y

# Increase BT MTU and RX buffer for big size DFU messages
config BT_L2CAP_TX_MTU
	default 498

config BT_BUF_ACL_RX_SIZE
	default 502

# Increase MCUMGR_TRANSPORT_NETBUF_SIZE, as it must be big enough to fit MAX MTU + overhead and for single-image DFU default is 384 B
config MCUMGR_TRANSPORT_NETBUF_SIZE
	default 1024

# Increase system workqueue size, as SMP is processed within it
config SYSTEM_WORKQUEUE_STACK_SIZE
	default 2800

if SOC_SERIES_NRF53X

# Enable custom SMP request to erase settings partition.
config MCUMGR_GRP_ZBASIC
	default y

config MCUMGR_GRP_ZBASIC_STORAGE_ERASE
	default y

endif # SOC_SERIES_NRF53X

endif # CHIP_DFU_OVER_BT_SMP

config CHIP_WIFI_CONNECTION_RECOVERY_MINIMUM_INTERVAL
	int "Define the minimum connection recovery time interval in milliseconds"
	depends on CHIP_WIFI
	default 500
	help
	  Specifies the minimum connection recovery interval (in milliseconds).

config CHIP_WIFI_CONNECTION_RECOVERY_MAXIMUM_INTERVAL
	int "Define the maximum connection recovery time interval in milliseconds"
	depends on CHIP_WIFI
	default 3600000 # 1 hour
	help
	  Specifies the maximum connection recovery interval (in milliseconds).

config CHIP_WIFI_CONNECTION_RECOVERY_MAX_RETRIES_NUMBER
	int "Define the maximum amount of connection recovery occurrences"
	depends on CHIP_WIFI
	default 0
	help
	  Specifies the maximum number of connection recovery attempts.
	  If set to 0, no limitation is applied and attempts
	  to recover the connection are performed indefinitely.

config CHIP_WIFI_CONNECTION_RECOVERY_JITTER
	int "Define the connection recovery jitter in milliseconds"
	depends on CHIP_WIFI
	default 2000
	help
	  Specifies the maximum connection recovery jitter interval (in milliseconds).
	  Once the wait time reaches the current maximum value (defined by CHIP_WIFI_CONNECTION_RECOVERY_MAXIMUM_INTERVAL),
	  a random jitter interval is added to it to avoid periodicity. The random jitter is selected
	  within range [-JITTER; +JITTER].

choice CHIP_LAST_FABRIC_REMOVED_ACTION
	prompt "An action to perform after removing the last fabric"
	default CHIP_LAST_FABRIC_REMOVED_ERASE_AND_REBOOT

	config CHIP_LAST_FABRIC_REMOVED_NONE
	bool "After removing the last fabric do not perform any action"
	help
	  After removing the last fabric the device will not perform factory reset
	  or reboot. The current state will be left as it is and the BLE advertising
	  will not start automatically.

	config CHIP_LAST_FABRIC_REMOVED_ERASE_AND_REBOOT
	bool "After removing the last fabric erase NVS and reboot"
	help
	  After removing the last fabric the device will perform the factory reset and
	  then reboot. The current RAM state will be removed and the new commissioning to
	  the new fabric will use the initial fabric index. This option is the most safe.

	config CHIP_LAST_FABRIC_REMOVED_ERASE_AND_PAIRING_START
	bool "After removing the last fabric erase NVS and start Bluetooth LE advertising"
	help
	  After removing the last fabric the device will perform the factory reset without 
	  rebooting and start the Bluetooth LE advertisement automatically.
	  The current RAM state will be saved and the new commissioning to the next 
	  fabric will use the next possible fabric index. This option should not be used for
	  devices that normally do not advertise Bluetooth LE on boot to keep their original 
	  behavior.

	config CHIP_LAST_FABRIC_REMOVED_ERASE_ONLY
	bool "After removing the last fabric erase NVS only"
	help
	  After removing the last fabric the device will perform the factory reset only without
	  rebooting. The current RAM state will be saved and the new commissioning to the next 
	  fabric will use the next possible fabric index.

endchoice

config CHIP_LAST_FABRIC_REMOVED_ACTION_DELAY
	int "After removing the last fabric wait defined time [in milliseconds] to perform an action"
	depends on !CHIP_LAST_FABRIC_REMOVED_NONE
	default 1000
	help
	  After removing the last fabric the device will wait for the defined time and then perform
	  an action chosen by the CHIP_LAST_FABRIC_REMOVED_ACTION option. This schedule will allow for
	  avoiding race conditions before the device removes non-volatile data.

endif # CHIP
```

## config/nrfconnect/chip-module/Kconfig.hci_ipc.defaults
```kconfig
#
#   Copyright (c) 2022 Project CHIP Authors
#
#   Licensed under the Apache License, Version 2.0 (the "License");
#   you may not use this file except in compliance with the License.
#   You may obtain a copy of the License at
#
#       http://www.apache.org/licenses/LICENSE-2.0
#
#   Unless required by applicable law or agreed to in writing, software
#   distributed under the License is distributed on an "AS IS" BASIS,
#   WITHOUT WARRANTIES OR CONDITIONS OF ANY KIND, either express or implied.
#   See the License for the specific language governing permissions and
#   limitations under the License.
#

# The purpose of this file is to define new default values of settings used when building hci_ipc child image for Matter samples.

config LOG
    default n

config HEAP_MEM_POOL_SIZE
    default 8192

config MAIN_STACK_SIZE
    default 2048

config SYSTEM_WORKQUEUE_STACK_SIZE
    default 2048

config BT
    default y

config BT_HCI_RAW
    default y

config BT_MAX_CONN
    default 1

config BT_PERIPHERAL
    default y

config BT_CENTRAL
    default n

config BT_BUF_ACL_RX_SIZE
    default 502

config BT_BUF_ACL_TX_SIZE
    default 251

config BT_CTLR_DATA_LENGTH_MAX
    default 251

config BT_CTLR_ASSERT_HANDLER
    default y

config BT_HCI_RAW_RESERVE
    default 1

# Disable 2M PHY due to interoperability issues.
config BT_CTLR_PHY_2M
    default n

# Workaround: Unable to allocate command buffer when using K_NO_WAIT since
# Host number of completed commands does not follow normal flow control.
config BT_BUF_CMD_TX_COUNT
    default 10

config ASSERT
    default y

config DEBUG_INFO
    default y

config EXCEPTION_STACK_TRACE
    default y

config IPC_SERVICE
    default y

config MBOX
    default y
```

## config/nrfconnect/chip-module/Kconfig.hci_rpmsg.root
```kconfig
#
# SPDX-FileCopyrightText: 2022 Project CHIP Authors
#
# SPDX-License-Identifier: Apache-2.0
#

# The purpose of this file is to create a wrapper Kconfig file that will be set as
# hci_rpmsg_KCONFIG_ROOT and processed before any other Kconfig for hci_rpmsg child image.

rsource "Kconfig.hci_rpmsg.defaults"
source "Kconfig.zephyr"
```

## config/nrfconnect/chip-module/Kconfig.mcuboot.defaults
```kconfig
#
#   Copyright (c) 2022 Project CHIP Authors
#
#   Licensed under the Apache License, Version 2.0 (the "License");
#   you may not use this file except in compliance with the License.
#   You may obtain a copy of the License at
#
#       http://www.apache.org/licenses/LICENSE-2.0
#
#   Unless required by applicable law or agreed to in writing, software
#   distributed under the License is distributed on an "AS IS" BASIS,
#   WITHOUT WARRANTIES OR CONDITIONS OF ANY KIND, either express or implied.
#   See the License for the specific language governing permissions and
#   limitations under the License.
#

# The purpose of this file is to define new default values of settings used when building mcuboot child image for Matter samples.

config MAIN_STACK_SIZE
    default 10240

config BOOT_SWAP_SAVE_ENCTLV
    default n

config BOOT_ENCRYPT_RSA
    default n

config BOOT_ENCRYPT_EC256
    default n

config BOOT_ENCRYPT_X25519
    default n

config BOOT_BOOTSTRAP
    default n

config PM
    default n

config FLASH
    default y

config FPROTECT
    default y

choice LIBC_IMPLEMENTATION
    default MINIMAL_LIBC
endchoice

# nRF7002DK uses SPI NOR external flash
if BOARD_NRF7002DK_NRF5340_CPUAPP

config SPI
    default y

config SPI_NOR
    default y

choice SPI_NOR_SFDP
	default SPI_NOR_SFDP_DEVICETREE
endchoice

config SPI_NOR_FLASH_LAYOUT_PAGE_SIZE
    default 4096

config MULTITHREADING
    default y

config PM_OVERRIDE_EXTERNAL_DRIVER_CHECK
    default y

endif

# All boards beside nRF7002DK use QSPI NOR external flash
if BOARD_NRF5340DK_NRF5340_CPUAPP || BOARD_NRF52840DK_NRF52840

config NORDIC_QSPI_NOR
    default y

config NORDIC_QSPI_NOR_FLASH_LAYOUT_PAGE_SIZE
    default 4096

config NORDIC_QSPI_NOR_STACK_WRITE_BUFFER_SIZE
    default 16

endif

config BOOT_MAX_IMG_SECTORS
    default 256

config LOG
    default n

config CONSOLE_HANDLER
    default n

config BOOT_BANNER
    default n

config TIMESLICING
    default n

config RESET_ON_FATAL_ERROR
    default n

config MULTITHREADING
    default n

config TICKLESS_KERNEL
    default n

config TIMEOUT_64BIT
    default n

config NRF_ENABLE_ICACHE
    default n

if SOC_SERIES_NRF53X

# The following configurations are required to support simultaneous multi image update
config PCD_APP
    default y

config UPDATEABLE_IMAGE_NUMBER
    default 2

# Multi-image updates do not support image swapping yet.
choice BOOT_IMAGE_UPGRADE_MODE
    default BOOT_UPGRADE_ONLY
endchoice

# The network core cannot access external flash directly. The flash simulator must be used to
# provide a memory region that is used to forward the new firmware to the network core.
config FLASH_SIMULATOR
    default y

config FLASH_SIMULATOR_DOUBLE_WRITES
    default y

config FLASH_SIMULATOR_STATS
    default n

# Enable custom command to erase settings partition.
config ENABLE_MGMT_PERUSER
    default y

config ZCBOR
    default y

config BOOT_MGMT_CUSTOM_STORAGE_ERASE
    default y

endif # SOC_SERIES_NRF53X
```

## config/nrfconnect/chip-module/Kconfig.mcuboot.root
```kconfig
#
# SPDX-FileCopyrightText: 2022 Project CHIP Authors
#
# SPDX-License-Identifier: Apache-2.0
#

# The purpose of this file is to create a wrapper Kconfig file that will be set as
# mcuboot_KCONFIG_ROOT and processed before any other Kconfig for mcuboot child image.

rsource "Kconfig.mcuboot.defaults"
source "${ZEPHYR_BASE}/../bootloader/mcuboot/boot/zephyr/Kconfig"
```

## config/nrfconnect/chip-module/Kconfig.multiprotocol_rpmsg.root
```kconfig
#
# SPDX-FileCopyrightText: 2022 Project CHIP Authors
#
# SPDX-License-Identifier: Apache-2.0
#

# The purpose of this file is to create a wrapper Kconfig file that will be set as
# multiprotocol_rpmsg_KCONFIG_ROOT and processed before any other Kconfig for multiprotocol_rpmsg child image.

rsource "Kconfig.multiprotocol_rpmsg.defaults"
source "Kconfig.zephyr"
```
