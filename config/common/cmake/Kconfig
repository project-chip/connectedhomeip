## config/nxp/chip-cmake-freertos/Kconfig.openthread.common
```kconfig
#
#   Copyright (c) 2024-2025 Project CHIP Authors
#
#   Licensed under the Apache License, Version 2.0 (the "License");
#   you may not use this file except in compliance with the License.
#   You may obtain a copy of the License at
#
#       http://www.apache.org/licenses/LICENSE-2.0
#
#   Unless required by applicable law or agreed to in writing, software
#   distributed under the License is distributed on an "AS IS" BASIS,
#   WITHOUT WARRANTIES OR CONDITIONS OF ANY KIND, either express or implied.
#   See the License for the specific language governing permissions and
#   limitations under the License.
#

# Define NET_L2_OPENTHREAD config for FreeRTOS compatibility with Zephyr (already defined in Zephyr module)
# to enable shared code and Kconfig across both platforms.
config NET_L2_OPENTHREAD
	bool "Enable Thread support"
	help
	  Enable OT support.

if NET_L2_OPENTHREAD

config OT_ROOT
	string "OT root path"
	default "third_party/openthread/ot-nxp/openthread"
	help
	  OT root path relative to Matter root

config OT_EXTERNAL_MBEDTLS
	string "Mbedtls gn target used by OT gn build system"
	default "nxp_mbedtls"
	help
	  Use "${nxp_sdk_build_root}:nxp_mbedtls" by default.
	  The full path is handled in common.cmake. If blank,
	  OT will use internal mbedtls.

config OT_EXTERNAL_PLATFORM
	string "OT external platform target used by OT gn build system"
	default "libopenthread-mcxw71" if CHIP_NXP_PLATFORM_MCXW71
	default "libopenthread-mcxw72" if CHIP_NXP_PLATFORM_MCXW72
	default "libopenthread-rw61x" if CHIP_NXP_PLATFORM_RW61X
	default "libopenthread-rt1060" if CHIP_NXP_PLATFORM_RT1060
	default "libopenthread-rt1170" if CHIP_NXP_PLATFORM_RT1170
	help
	  OT external platform target used by OT gn build system

config OT_PROJECT_CORE_CONFIG_FILE
	string "OT configuration file used by OT gn build system"
	default "$(CHIP_ROOT)/examples/platform/nxp/mcxw71/app/project_include/openthread/OpenThreadConfig.h" if CHIP_NXP_PLATFORM_MCXW71
	default "$(CHIP_ROOT)/third_party/nxp/nxp_matter_support/examples/platform/mcxw72/app/project_include/openthread/OpenThreadConfig.h" if CHIP_NXP_PLATFORM_MCXW72
	default "$(CHIP_ROOT)/third_party/nxp/nxp_matter_support/examples/platform/rt/rw61x/app/project_include/openthread/OpenThreadConfig.h" if CHIP_NXP_PLATFORM_RW61X
	default "$(CHIP_ROOT)/third_party/nxp/nxp_matter_support/examples/platform/rt/rt1060/app/project_include/openthread/OpenThreadConfig.h" if CHIP_NXP_PLATFORM_RT1060
	default "$(CHIP_ROOT)/third_party/nxp/nxp_matter_support/examples/platform/rt/rt1170/app/project_include/openthread/OpenThreadConfig.h" if CHIP_NXP_PLATFORM_RT1170
	help
	  OT configuration file used by OT gn build system.

config OT_PROJECT_LIB_CONFIG_FILE
	string "OT project lib config file"
	default "$(CHIP_ROOT)/third_party/nxp/nxp_matter_support/examples/platform/rt/rw61x/app/project_include/openthread/OpenThreadProjectLibConfig.h" if CHIP_NXP_PLATFORM_RW61X
	help
	  OT lib config file.

config OT_CORE_CONFIG_PLATFORM_CHECK_FILE
	string "OT core configuration check file used by OT gn build system"
	default "openthread-core-mcxw71-config-check.h" if CHIP_NXP_PLATFORM_MCXW71
	default "openthread-core-mcxw72-config-check.h" if CHIP_NXP_PLATFORM_MCXW72
	default "openthread-core-rw612-config-check.h" if CHIP_NXP_PLATFORM_RW61X
	default "openthread-core-rt1060-config-check.h" if CHIP_NXP_PLATFORM_RT1060
	default "openthread-core-rt1170-config-check.h" if CHIP_NXP_PLATFORM_RT1170
	help
	  OT core configuration check file used by OT gn build system

config OT_CORE_CONFIG_DEPS
	string "OT core configuration gn deps file used by OT gn build system"
	default "third_party/openthread/platforms/nxp/mcxw71:openthread_core_config_mcxw71" if CHIP_NXP_PLATFORM_MCXW71
    default "third_party/openthread/platforms/nxp/mcxw72:openthread_core_config_mcxw72" if CHIP_NXP_PLATFORM_MCXW72
	default "third_party/openthread/platforms/nxp/rt/rw61x:openthread_core_config_rw61x" if CHIP_NXP_PLATFORM_RW61X
	default "third_party/openthread/platforms/nxp/rt/rt1060:openthread_core_config_rt1060" if CHIP_NXP_PLATFORM_RT1060
	default "third_party/openthread/platforms/nxp/rt/rt1170:openthread_core_config_rt1170" if CHIP_NXP_PLATFORM_RT1170
	help
	  OT core configuration gn deps file used by OT gn build system

config OT_NXP_PLATFORM_FOLDER
	string "ot-nxp platform specific folder"
	default "src/mcxw71" if CHIP_NXP_PLATFORM_MCXW71
	default "src/mcxw72" if CHIP_NXP_PLATFORM_MCXW72
	help
	  ot-nxp platform specific folder (relative to ot-nxp root)

config OT_NXP_SPINEL_INTERFACE_LINK
	string "spinel interface link"
	default "hdlc" if CHIP_NXP_PLATFORM_RW61X
	default "spi"
	help
		Define the spinel interface used for host transceiver communication

choice THREAD_DEVICE_TYPE_SELECTION
	prompt "Thread device type selection based on ConnectivityManager::ThreadDeviceType enum"
	default ROUTER if CHIP_NXP_PLATFORM_RW61X || CHIP_NXP_PLATFORM_RT1170 || CHIP_NXP_PLATFORM_RT1060
	default FULL_END_DEVICE
	config ROUTER
		bool "Router"
	config FULL_END_DEVICE
		bool "Full end device"
	config MINIMAL_END_DEVICE
		bool "Minimal end device"
	config SLEEPY_END_DEVICE
		bool "Sleepy end device"
	config SYNCHRONIZED_SLEEPY_END_DEVICE
		bool "Synchronized sleepy end device"
endchoice

config THREAD_DEVICE_TYPE
	string "Thread device type registered with the connectivity manager"
	default "kThreadDeviceType_Router" if ROUTER
	default "kThreadDeviceType_FullEndDevice" if FULL_END_DEVICE
	default "kThreadDeviceType_MinimalEndDevice" if MINIMAL_END_DEVICE
	default "kThreadDeviceType_SleepyEndDevice" if SLEEPY_END_DEVICE
	default "kThreadDeviceType_SynchronizedSleepyEndDevice" if SYNCHRONIZED_SLEEPY_END_DEVICE
	help
		Thread device type registered with the connectivity manager

endif # NET_L2_OPENTHREAD
```

## config/nxp/chip-module/Kconfig
```kconfig
#
#   Copyright (c) 2024-2025 Project CHIP Authors
#
#   Licensed under the Apache License, Version 2.0 (the "License");
#   you may not use this file except in compliance with the License.
#   You may obtain a copy of the License at
#
#       http://www.apache.org/licenses/LICENSE-2.0
#
#   Unless required by applicable law or agreed to in writing, software
#   distributed under the License is distributed on an "AS IS" BASIS,
#   WITHOUT WARRANTIES OR CONDITIONS OF ANY KIND, either express or implied.
#   See the License for the specific language governing permissions and
#   limitations under the License.
#

if SOC_FAMILY_NXP_RW || SOC_FAMILY_MCXW

rsource "../cmake/Kconfig.matter.nxp"

# These options should be moved to a common application layer Kconfig file, which does not exist yet.
# For now, they are added here to avoid dupplication in the different application Kconfig files.
config CHIP_APP_IDENTIFY
    bool "App Identify"
    default y
    help
      Enable application common clusters implementation for the Identify cluster.
      Registers the Identify Clusters only for CHIP_APP_IDENTIFY_ENDPOINT.
      If needed, specific application code must register the cluster for the other endpoints.

config CHIP_APP_IDENTIFY_ENDPOINT
	int "Endpoint ID for Identify cluster"
	default 1
	help
      Set the endpoint ID for the Identify cluster implementation.

config CHIP_APP_OPERATIONAL_KEYSTORE
	bool "Use custom implementation of operational keystore"
	default y if CHIP_SE05X
	help
		Use custom implementation of operational keystore.

if CHIP_APP_OPERATIONAL_KEYSTORE
	choice CHIP_APP_OPERATIONAL_KEYSTORE_SELECTION
		prompt "Select Operation Keystore Implementation"
		default CHIP_APP_OPERATIONAL_KEYSTORE_SE05X if CHIP_SE05X

	config CHIP_APP_OPERATIONAL_KEYSTORE_SE05X
	bool "Operation Keystore SE05X"
	help
		Enable application Operational keystore SE05X implementation.

	endchoice # CHIP_APP_OPERATIONAL_KEYSTORE_SELECTION
endif # CHIP_APP_OPERATIONAL_KEYSTORE

endif # SOC_FAMILY_NXP_RW || SOC_FAMILY_MCXW
```

## config/nxp/chip-module/Kconfig.defaults
```kconfig
#
#   Copyright (c) 2024 Project CHIP Authors
#
#   Licensed under the Apache License, Version 2.0 (the "License");
#   you may not use this file except in compliance with the License.
#   You may obtain a copy of the License at
#
#       http://www.apache.org/licenses/LICENSE-2.0
#
#   Unless required by applicable law or agreed to in writing, software
#   distributed under the License is distributed on an "AS IS" BASIS,
#   WITHOUT WARRANTIES OR CONDITIONS OF ANY KIND, either express or implied.
#   See the License for the specific language governing permissions and
#   limitations under the License.
#

# The purpose of this file is to define new default values of settings used when building Matter samples.
# This file only changes defaults and thus all symbols here must be promptless
# and safeguarded so that they only are applied when building Matter.

if CHIP

config CHIP_OPERATIONAL_TIME_SAVE_INTERVAL
	default 1

if CHIP_FACTORY_DATA

config CHIP_DEVICE_VENDOR_ID
	default 4151 # 0x1037

config CHIP_DEVICE_MANUFACTURING_DATE
	default "2023-01-01"

config CHIP_DEVICE_PRODUCT_ID
	default 41510 if SOC_SERIES_RW6XX

endif # CHIP_FACTORY_DATA

config LOG
	default y

if LOG

choice LOG_MODE
	default LOG_MODE_MINIMAL
endchoice

choice MATTER_LOG_LEVEL_CHOICE
	default MATTER_LOG_LEVEL_DBG
endchoice

config CHIP_APP_LOG_LEVEL
	default 4 # debug

config LOG_DEFAULT_LEVEL
	default 1 # error

config CHIP_LOG_SIZE_OPTIMIZATION
	default y

endif

config PRINTK_SYNC
	default y

config ASSERT
	default y

config ASSERT_NO_COND_INFO
	default y

config ASSERT_NO_MSG_INFO
	default y

config HW_STACK_PROTECTION
	default y

config FPU
	default y

config SHELL
	default y

config PTHREAD_IPC
	bool
	default n

config POSIX_MAX_FDS
	int
	default 8

# Application stack size
config MAIN_STACK_SIZE
	default 3072

config INIT_STACKS
	default y

config NET_MGMT_EVENT_STACK_SIZE
	default 1024

config NET_MGMT_EVENT_QUEUE_SIZE
	default 20

config NET_IPV6_MLD
	default y

config NET_IF_MCAST_IPV6_ADDR_COUNT
	default 14

config NET_IF_MAX_IPV4_COUNT
	default 2

config NET_IF_MAX_IPV6_COUNT
	default 2

config NET_TC_TX_COUNT
	default 1

config NET_TC_RX_COUNT
	default 1

config NET_TC_THREAD_PRIO_CUSTOM
	default y

choice NET_TC_THREAD_TYPE
	default NET_TC_THREAD_PREEMPTIVE
endchoice

config NET_TCP_WORKER_PRIO
	default -16

config NET_TC_TX_THREAD_BASE_PRIO
	default 3

config NET_TC_RX_THREAD_BASE_PRIO
	default 3

config NET_TC_SKIP_FOR_HIGH_PRIO
	default y

config NET_CONTEXT_PRIORITY
	default y

# Network buffers
config NET_PKT_RX_COUNT
	default 14

config NET_PKT_TX_COUNT
	default 14

config NET_BUF_RX_COUNT
	default 36

config NET_BUF_TX_COUNT
	default 36

config NET_BUF_DATA_SIZE
	default 256

# Bluetooth Low Energy configs

config BT
	default y

config BT_PERIPHERAL
	default y

config BT_CENTRAL
	default n

config BT_PERIPHERAL_PREF_MIN_INT
	default 36

config BT_PERIPHERAL_PREF_MAX_INT
	default 36

# Increase BT timeout to 5 s to improve connection reliability and avoid fast drop outs.
config BT_PERIPHERAL_PREF_TIMEOUT
	default 500

config BT_GAP_AUTO_UPDATE_CONN_PARAMS
	default y

# Decrease connection parameters update time, as some Matter controllers request
# enabling IP networking faster than BT connection parameters are updated, what may result
# in commissioning instabilities.
config BT_CONN_PARAM_UPDATE_TIMEOUT
	default 1000

config BT_GATT_DYNAMIC_DB
	default y

config BT_DEVICE_NAME_DYNAMIC
	default y

config BT_DEVICE_NAME_MAX
	default 15

config BT_MAX_CONN
	default 1

config BT_L2CAP_TX_MTU
	default 247

config BT_BUF_ACL_RX_SIZE
	default 251

config BT_BUF_ACL_TX_SIZE
	default 251

config BT_RX_STACK_SIZE
	default 2048 if NO_OPTIMIZATIONS && DEBUG
	default 1700

config BT_LONG_WQ_STACK_SIZE
	default 1024

config BT_DEVICE_NAME_GATT_WRITABLE
	bool
	default n

config HCI_NXP_ENABLE_AUTO_SLEEP
	default n

config CHIP_OTA_REQUESTOR
	default n

config CHIP_DEVICE_SOFTWARE_VERSION
	default 1

# Enable extended discovery
config CHIP_EXTENDED_DISCOVERY
	default y

config NVS_LOOKUP_CACHE
	default y

config NVS_LOOKUP_CACHE_SIZE
	default 1024

if CHIP_WIFI

choice NXP_WIFI_PART
	default NXP_RW610 if SOC_SERIES_RW6XX
endchoice

config ZVFS_OPEN_MAX
	default 30

choice SCHED_ALGORITHM
	default SCHED_MULTIQ
endchoice

choice WIFI_NM_WPA_SUPPLICANT_LOG_LEVEL_CHOICE
	default WIFI_NM_WPA_SUPPLICANT_LOG_LEVEL_INF
endchoice

choice WIFI_NM_WPA_SUPPLICANT_CRYPTO_BACKEND
	default WIFI_NM_WPA_SUPPLICANT_CRYPTO_ALT
endchoice

config WIFI_NM_WPA_SUPPLICANT_THREAD_STACK_SIZE
	default 6144

config WIFI_NM_WPA_SUPPLICANT_WQ_STACK_SIZE
	default 5120

config WIFI_NM_WPA_SUPPLICANT_INF_MON
	default n

config SYSTEM_WORKQUEUE_STACK_SIZE
	default 2048

config NET_TCP_WORKQ_STACK_SIZE
	default 2048

# align these numbers to match the OpenThread config
config NET_IF_UNICAST_IPV6_ADDR_COUNT
	default 6

config NET_IF_MCAST_IPV6_ADDR_COUNT
	default 8

config NET_SOCKETS_POLL_MAX
	default 14

config NET_IPV4_FRAGMENT_MAX_COUNT
	default 3

config NET_IPV4_FRAGMENT_MAX_PKT
	default 7

config NET_IPV4_FRAGMENT_TIMEOUT
	default 3

config NET_IPV6_FRAGMENT_MAX_COUNT
	default 3

config NET_IPV6_FRAGMENT_MAX_PKT
	default 8

config NET_IPV6_FRAGMENT_TIMEOUT
	default 3

# options managed by IP4/IP6 simultaneous support
# aligned here to match OpenThread config
config NET_MAX_ROUTERS
	default 1

config NET_MAX_CONN
	default 10

config SHELL_STACK_SIZE
	default 2616

config HEAP_MEM_POOL_SIZE
	default 122880

config CHIP_MALLOC_SYS_HEAP_SIZE
	default 28672 # 28 kB

endif

if CHIP_ETHERNET || CHIP_WIFI

choice LIBC_IMPLEMENTATION
	default NEWLIB_LIBC
endchoice

endif

if CHIP_ETHERNET

choice NXP_ENET_DRIVER
	default ETH_NXP_ENET
endchoice

endif

# Configure MBEDTLS lib
config MBEDTLS
	default y

config MBEDTLS_CFG_FILE
	default "config-tls-generic.h"

config MBEDTLS_USER_CONFIG_ENABLE
    default y

config MBEDTLS_USER_CONFIG_FILE
    default "nxp-zephyr-mbedtls-config.h"

config MBEDTLS_ENTROPY_ENABLED
	default y

config MBEDTLS_ZEPHYR_ENTROPY
	default y

config MBEDTLS_SSL_MAX_CONTENT_LEN
	default 8192

config MBEDTLS_ENABLE_HEAP
	default y

config MBEDTLS_HEAP_SIZE
	default 15360

config MBEDTLS_CIPHER_AES_ENABLED
	default y

config MBEDTLS_CIPHER_CCM_ENABLED
	default y

config MBEDTLS_CTR_DRBG_ENABLED
	default y

config MBEDTLS_CIPHER_MODE_CBC_ENABLED
	default y

config MBEDTLS_ECP_C
	default y

config MBEDTLS_ECP_DP_SECP256R1_ENABLED
	default y

config CHIP_CRYPTO_PSA
	default y

if CHIP_CRYPTO_PSA

config MBEDTLS_PSA_CRYPTO_C
	default y

config WIFI_NM_WPA_SUPPLICANT_CRYPTO_MBEDTLS_PSA
	default y if WIFI_NM_WPA_SUPPLICANT

endif

config MCUX_ELS_PKC
	default y if SOC_SERIES_RW6XX

if MCUX_ELS_PKC

config MCUX_PSA_CRYPTO_DRIVER_ELS_PKC
	default y if CHIP_CRYPTO_PSA

config MCUX_PSA_CRYPTO_DRIVER_ELS_PKC_THREAD
	default y if CHIP_CRYPTO_PSA

config ENTROPY_GENERATOR
	default y

endif # MCUX_ELS_PKC


if SHELL

config KERNEL_SHELL
	default y

config DEVICE_SHELL
	default y

config REBOOT
	default y

# Disable not used shell modules
config SHELL_WILDCARD
	default n

config SHELL_VT100_COLORS
	default n

config SHELL_STATS
	default n

config SENSOR_SHELL
	default n

config DATE_SHELL
	default n

config DEVMEM_SHELL
	default n

config MCUBOOT_SHELL
	default n

config FLASH_SHELL
	default n

endif # SHELL

endif
```
