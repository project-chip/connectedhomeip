// Following device type map is updated from the matter_device_types_clusters_list
// to ensure that the device list gives meaningful device types lits  and that could be supported via Unify SDK.
#include <vector>
#include <map>
#include <string>
#include <app-common/zap-generated/ids/Clusters.h>
static const std::map<chip::DeviceTypeId, std::pair<std::vector<const char *>, const char *>> matter_device_type_vs_clusters_map = {
	//{ 0x0000, {{"Basic", "Identify"}, "onoffswitch"} }, 
	//{ 0x0001, {{"Basic", "Identify"}, "levelcontrolswitch"} }, 
	//{ 0x0002, {{"Basic", "Identify", "OnOff", "Scenes", "Groups"}, "onnoffoutput"} }, 
	//{ 0x0003, {{"Basic", "Identify", "OnOff", "Level", "Scenes", "Groups"}, "levelcontrollableoutput"} }, 
	//{ 0x0004, {{"Basic", "Identify"}, "sceneselector"} }, 
	//{ 0x0005, {{"Basic", "Identify"}, "configurationtool"} }, 
	//{ 0x0006, {{"Basic", "Identify"}, "remotecontrol"} }, 
	//{ 0x0007, {{"Basic", "Identify"}, "combinedinterface"} }, 
	//{ 0x0008, {{"Basic", "Identify"}, "rangeextender"} }, 
	//{ 0x0009, {{"Basic", "Identify", "OnOff", "Scenes", "Groups"}, "mainspoweroutlet"} }, 
	{ 0x000A, {{"Basic", "Identify", "DoorLock", "Scenes", "Groups"}, "doorlock"} }, 
	//{ 0x000B, {{"Basic", "Identify", "Time"}, "doorlockcontroller"} }, 
	{ 0x000C, {{"Basic", "Identify", "Binary Input (Basic)"}, "simplesensor"} }, 
	{ 0x000D, {{"Basic", "Identify", "Metering"}, "consumptionawarenessdevice"} }, 
	//{ 0x0050, {{"Basic", "Identify", "Time"}, "homegateway"} }, 
	{ 0x0051, {{"Basic", "Identify", "OnOff", "Metering"}, "smartplug"} }, 
	{ 0x0052, {{"Basic", "Identify", "Power Profile", "Appliance Statistics", "Appliance Control", "Appliance Identification", "Appliance Events and Alert"}, "whitegoods"} }, 
	{ 0x0053, {{"Basic", "Identify", "Metering", "Meter Identification"}, "meterinterface"} }, 
	{ 0x0200, {{"Basic", "Identify", "ShadeConfiguration", "OnOff", "Level", "Scenes", "Groups"}, "shade"} }, 
	//{ 0x0201, {{"Basic", "Identify"}, "shadecontroller"} }, 
	{ 0x0202, {{"Basic", "Identify", "WindowCovering", "Scenes", "Groups"}, "windowcovering"} }, 
	//{ 0x0203, {{"Basic", "Identify"}, "windowcoveringcontroller"} }, 
	//{ 0x0300, {{"Basic", "Identify", "OnOff", "Thermostat"}, "heatingcoolingunit"} }, 
	{ 0x0301, {{"Basic", "Identify", "Thermostat"}, "thermostat"} }, 
	{ 0x0302, {{"Basic", "Identify", "TemperatureMeasurement"}, "tempsensor"} }, 
	{ 0x0303, {{"Basic", "Identify", "PumpConfigurationAndControl", "OnOff", "Scenes", "Groups"}, "pump"} }, 
	//{ 0x0304, {{"Basic", "Identify"}, "pumpcontroller"} }, 
	{ 0x0305, {{"Basic", "Identify", "PressureMeasurement"}, "pressuresensor"} }, 
	{ 0x0306, {{"Basic", "Identify", "FlowMeasurement"}, "flowsensor"} }, 
	{ 0x0400, {{"Basic", "Identify", "IASACE"}, "iascie"} }, 
	//{ 0x0401, {{"Basic", "Identify", "IASZone"}, "iasace"} }, 
	{ 0x0402, {{"Basic", "Identify", "IASZone"}, "iaszone"} }, 
	{ 0x0403, {{"Basic", "Identify", "IASWD", "IASZone"}, "iasW"} }, 
	{ 0x0100, {{"Basic", "Identify", "Groups", "Scenes", "OnOff"}, "onofflight"} }, 
	{ 0x0101, {{"Basic", "Identify", "Groups", "Scenes", "OnOff", "Level"}, "dimmablelight"} }, 
	{ 0x0102, {{"Basic", "Identify", "Groups", "Scenes", "OnOff", "Level", "ColorControl"}, "colordimmablelight"} }, 
	//{ 0x0103, {{"Basic", "Identify"}, "onofflightswitch"} }, 
	//{ 0x0104, {{"Basic", "Identify"}, "dimmerswitch"} }, 
	//{ 0x0105, {{"Basic", "Identify"}, "colordimmerswitch"} }, 
	{ 0x0106, {{"Basic", "Identify", "IlluminanceMeasurement"}, "lightsensor"} }, 
	{ 0x0107, {{"Basic", "Identify", "OccupancySensing"}, "occupancysensor"} }, 
	{ 0x0108, {{"Basic", "PowerConfiguration", "DeviceTemperatureConfiguration", "Identify", "Groups", "Scenes", "OnOff", "BallastConfiguration"}, "onoffballast"} }, 
	{ 0x0109, {{"Basic", "PowerConfiguration", "DeviceTemperatureConfiguration", "Identify", "Groups", "Scenes", "OnOff", "BallastConfiguration", "Level"}, "dimmableballast"} }, 
	//{ 0x010A, {{"Basic", "Identify", "Groups", "Scenes", "OnOff"}, "onoffpluginunit"} }, 
	//{ 0x010B, {{"Basic", "Identify", "Groups", "Scenes", "OnOff", "Level"}, "dimmablepluginunit"} }, 
	//{ 0x010C, {{"Basic", "Identify", "Groups", "Scenes", "OnOff", "Level", "ColorControl"}, "colortemperaturelight"} }, 
	//{ 0x010D, {{"Basic", "Identify", "Groups", "Scenes", "OnOff", "Level", "ColorControl"}, "extendedcolorlight"} }, 
	{ 0x010E, {{"Basic", "Identify", "IlluminanceLevelSensing"}, "lightlevelsensor"} }, 
	//{ 0x0800, {{"Basic", "Identify"}, "colorcontroller"} }, 
	//{ 0x0810, {{"Basic", "Identify"}, "colorscenecontroller"} }, 
	//{ 0x0820, {{"Basic", "Identify"}, "noncolorcontroller"} }, 
	//{ 0x0830, {{"Basic", "Identify"}, "noncolorscenecontroller"} }, 
	//{ 0x0840, {{"Basic", "Identify"}, "controlbridge"} }, 
	//{ 0x0850, {{"Basic", "Identify"}, "onoffsensor"} }
};